// SPDX-License-Identifier: GPL-2.0
/*
 * Copyright (c) 2019 MediaTek Inc.
 */

/dts-v1/;
#include <generated/autoconf.h>

//#include <dt-bindings/clock/mt6890-clk.h>
#include <dt-bindings/clock/mt6990-clk.h>
#include <dt-bindings/interrupt-controller/arm-gic.h>
#include <dt-bindings/interrupt-controller/irq.h>
#include <dt-bindings/pinctrl/mt69xx-pinfunc.h>
#include <dt-bindings/memory/mt6880-larb-port.h>
//#include <dt-bindings/power/mt6890-power.h>
#include <dt-bindings/power/mt6990-power.h>
#include <dt-bindings/reset/ti-syscon.h>
#include <dt-bindings/soc/mediatek,boot-mode.h>
#include <dt-bindings/spmi/spmi.h>
#include <dt-bindings/gpio/gpio.h>
#include <dt-bindings/input/input.h>
#include <dt-bindings/phy/phy.h>
#include <dt-bindings/interconnect/mtk,mt6873-emi.h>
#include <dt-bindings/gce/mt6890-gce.h>
#include <dt-bindings/thermal/thermal.h>
#include <dt-bindings/mfd/mt6361.h>
#include <dt-bindings/regulator/mediatek,mt6361-regulator.h>
#include <dt-bindings/iio/mediatek,mt6361_adc.h>
/ {
	model = "MT6990";
	compatible = "mediatek,MT6990";
	interrupt-parent = <&gic>;
	#address-cells = <2>;
	#size-cells = <2>;

	/* chosen */
	chosen: chosen {
		bootargs = "console=tty0 console=ttyS0,921600n1 root=/dev/ram \
			vmalloc=400M slub_debug=OFZPU swiotlb=noforce \
			firmware_class.path=/vendor/firmware \
			page_owner=on";
	};

	srclken_rc: srclken-rc@1200d000 {
			compatible = "mediatek,srclken-rc";
			reg = <0 0x1200d000 0 0x100>,
				<0 0x1200d100 0 0x700>;
			mediatek,subsys-ctl = "suspend", "md1", "md2",
					"md3", "rf", "mmwave",
					"gps", "bt", "wifi",
					"conn_mcu", "co-ant", "nfc",
					"rsv", "ufs";
			suspend-ctl = "XO_BBCK1";
			md1-ctl = "XO_RFCK2A";
			mmw-ctl = "XO_RFCK1A";
			gps-ctl = "XO_RFCK2B";
			mcu-ctl = "XO_BBCK2";

			mediatek,srclken-rc-broadcast;
			mediatek,enable;
		};

	clock_buffer_ctrl: clock_buffer_ctrl {
			compatible = "mediatek,clock_buffer_ctrl";
			mediatek,xo-buf-hwbblpm-mask = <1 0 0 0 0>,
						<0 0 0>,
						<0 0 0>,
						<0 0>;
			mediatek,xo-buf-hwbblpm-bypass = <0 0 0 0 0>,
						<0 0 0>,
						<0 0 0>,
						<0 0>;

			mediatek,enable;

			pmif = <&spmi_bus 0>;
			srclken_rc = <&srclken_rc>;
			consys = <&consys>;
		};

	psci {
		compatible = "arm,psci-1.0";
		method = "smc";
	};

	gpio_leds {
		compatible = "gpio-leds";
		led0 {
			label = "5g_evb_sim";
			gpios = <&pio 18 GPIO_ACTIVE_HIGH>;
			linux,default-trigger = "none";
			default-state = "off";
		};
		//	modified by quectel,RG620T-SBK use gpio16 to control system led replace isink3
		led1 {
			label = "5g_evb_system";
			gpios = <&pio 16 GPIO_ACTIVE_HIGH>;
			linux,default-trigger = "none";
			default-state = "off";
		};
		led2 {
			label = "5g_evb_wifi_mesh";
			gpios = <&pio 19 GPIO_ACTIVE_HIGH>;
			linux,default-trigger = "none";
			default-state = "off";
		};
		led3 {
			label = "5g_evb_net_mode";
			gpios = <&pio 4 GPIO_ACTIVE_HIGH>;
			linux,default-trigger = "none";
			default-state = "off";
		};

	};

	pwmleds {
		compatible = "mediatek,pwm-leds";

		backlight {
			label = "lcd-backlight";
			pwms = <&disp_pwm 0 39385>;
			max-brightness = <255>;
			pwm-names = "lcd-backlight";
		};
	};

	cpus {
		#address-cells = <1>;
		#size-cells = <0>;

		cpu0: cpu@0 {
			device_type = "cpu";
			compatible = "arm,cortex-a55";
			reg = <0x0000>;
			enable-method = "psci";
			performance-domains = <&performance 0>;
			clock-frequency = <1701000000>;
			cpu-idle-states = <&cpuoff_l &clusteroff_l &mcusysoff>;
			#cooling-cells = <2>;
		};
		cpu1: cpu@001 {
			device_type = "cpu";
			compatible = "arm,cortex-a55";
			reg = <0x0100>;
			enable-method = "psci";
			performance-domains = <&performance 0>;
			clock-frequency = <1701000000>;
			cpu-idle-states = <&cpuoff_l &clusteroff_l &mcusysoff>;
			#cooling-cells = <2>;
		};

		cpu2: cpu@002 {
			device_type = "cpu";
			compatible = "arm,cortex-a55";
			reg = <0x0200>;
			enable-method = "psci";
			performance-domains = <&performance 0>;
			clock-frequency = <1701000000>;
			cpu-idle-states = <&cpuoff_l &clusteroff_l &mcusysoff>;
			#cooling-cells = <2>;
		};

		cpu3: cpu@003 {
			device_type = "cpu";
			compatible = "arm,cortex-a55";
			reg = <0x0300>;
			enable-method = "psci";
			performance-domains = <&performance 0>;
			clock-frequency = <1701000000>;
			cpu-idle-states = <&cpuoff_l &clusteroff_l &mcusysoff>;
			#cooling-cells = <2>;
		};

		cpu-map {
			cluster0 {
				core0 {
					cpu = <&cpu0>;
				};
				core1 {
					cpu = <&cpu1>;
				};
				core2 {
					cpu = <&cpu2>;
				};
				core3 {
					cpu = <&cpu3>;
				};
			};
		};


		idle-states {
			entry-method = "arm,psci";
			cpuoff_l: cpuoff_l {
					compatible = "arm,idle-state";
					arm,psci-suspend-param = <0x00010001>;
					local-timer-stop;
					entry-latency-us = <50>;
					exit-latency-us = <100>;
					min-residency-us = <1600>;
			};
			clusteroff_l: clusteroff_l {
					compatible = "arm,idle-state";
					arm,psci-suspend-param = <0x01010001>;
					local-timer-stop;
					entry-latency-us = <100>;
					exit-latency-us = <250>;
					min-residency-us = <2100>;
			};
			mcusysoff: mcusysoff {
					compatible = "arm,idle-state";
					arm,psci-suspend-param = <0x01010002>;
					local-timer-stop;
					entry-latency-us = <450>;
					exit-latency-us = <600>;
					min-residency-us = <4000>;
			};
		};

	};

	mtk_lpm: mtk_lpm {
		compatible = "mediatek,mtk-lpm";
		#address-cells = <2>;
		#size-cells = <2>;
		ranges;
		suspend-method = "enable";

		logger-enable-states = "mcusysoff", "system_mem",
								"system_pll", "system_bus";

		mcusys-cnt-chk = <1>;

		irq-remain = <&edge_keypad &edge_mdwdt>;

		resource-ctrl = <&bus26m &infra &syspll>,
				<&dram_s0 &dram_s1>;
		constraints = <&rc_bus26m &rc_syspll &rc_dram>,
						<&rc_cpu_buck_ldo>;
		spm-cond = <&spm_cond_cg &spm_cond_pll>;
		cg-shift = <0>; /* cg blocking index */
		pll-shift = <16>; /* pll blocking index */

		power-gs = <&gs_6361>;

		cpupm_sysram: cpupm-sysram@0011b000 {
			compatible = "mediatek,cpupm-sysram";
			reg = <0 0x0011b000 0 0x500>;
		};

		mcusys_ctrl: mcusys-ctrl@0c53a000 {
				compatible = "mediatek,mcusys-ctrl";
				reg = <0 0x0c53a000 0 0x1000>;
		};
		lpm_sysram: lpm_sysram@0011b500 {
			compatible = "mediatek,lpm-sysram";
			reg = <0 0x0011b500 0 0x300>;
		};

		irq-remain-list {
			edge_keypad: edge_keypad {
				target = <&keypad>;
				value = <1 0 0 0x4>;
			};
			edge_mdwdt: edge_mdwdt {
				target = <&mddriver>;
				value = <1 0 0 0x02000000>;
			};
		};
		resource-ctrl-list {
			bus26m: bus26m {
				id = <0x00000000>;
				value = <0>;
			};
			infra: infra {
				id = <0x00000001>;
				value = <0>;
			};
			syspll: syspll {
				id = <0x00000002>;
				value = <0>;
			};
			dram_s0: dram_s0 {
				id = <0x00000003>;
				value = <0>;
			};
			dram_s1: dram_s1 {
				id = <0x00000004>;
				value = <0>;
			};
		};
		constraint-list {
			rc_bus26m: rc_bus26m {
				rc-name = "bus26m";
				id = <0x00000000>;
				value = <1>;
				cond-info = <1>;
			};
			rc_syspll: rc_syspll {
				rc-name = "syspll";
				id = <0x00000001>;
				value = <1>;
				cond-info = <1>;
			};
			rc_dram: rc_dram {
				rc-name = "dram";
				id = <0x00000002>;
				value = <1>;
				cond-info = <1>;
			};
			rc_cpu_buck_ldo: rc_cpu_buck_ldo{
				rc-name = "cpu-buck-ldo";
				id = <0x00000003>;
				value = <1>;
				cond-info = <0>;
			};
		};
		spm-cond-list {
			spm_cond_cg: spm_cond_cg {
				cg-name = "MTCMOS_0",
					"MTCMOS_1",
					"INFRA_0",
					"INFRA_1",
					"INFRA_2",
					"INFRA_3",
					"INFRA_4",
					"INFRA_5",
					"PERI_0",
					"PERI_1",
					"PERI_2",
					"MMSYS_0";
			};
			spm_cond_pll: spm_cond_pll {
				pll-name = "UNIVPLL",
					"MFGPLL",
					"MSDCPLL",
					"MMPLL",
					"NET1PLL",
					"NET2PLL",
					"WEDMCUPLL",
					"MEDMCUPLL",
					"SGMIIPLL",
					"APLL1",
					"APLL2";
			};
		};
		power-gs-list {
			gs_6361: gs_6361 {
				target = <&pmic>;
				value = "mediatek,mt6361-regulator";
			};
		};
	};

	pmu {
		compatible = "arm,armv8-pmuv3";
		interrupt-parent = <&gic>;
		interrupts = <GIC_PPI 7 IRQ_TYPE_LEVEL_HIGH>;
	};

	dsu-pmu-0 {
		compatible = "arm,dsu-pmu";
		interrupts = <GIC_SPI 18 IRQ_TYPE_LEVEL_HIGH>;
		cpus = <&cpu0>, <&cpu1>, <&cpu2>, <&cpu3>;
	};

	performance: performance-controller@0011bc00 {
		compatible = "mediatek,cpufreq-hw";
		reg = <0 0x0011bc10 0 0x120>;
		#performance-domain-cells = <1>;
	};

	dvfsp: dvfsp@0011bc00 {
                compatible = "mediatek,mcupm-dvfsp";
                reg = <0 0x0011bc00 0 0x1400>;
		nvmem = <&efuse>;
                nvmem-names = "mtk_efuse";
                nvmem-cells = <&efuse_segment>;
                nvmem-cell-names = "efuse_segment_cell";
        };

	leakage {
		compatible = "mediatek,mtk-static-power";
		nvmem = <&efuse>;
		nvmem-names = "mtk_efuse";
		nvmem-cells = <&efuse_segment>;
		nvmem-cell-names = "efuse_segment_cell";
		n-domain = <7>;
		domain = "VPROC_L", "VCORE_OFF", "VCORE", "MODEM", "VSRAM_VPROC_L", "VSRAM_VCORE_PLUS_VLPAO", "VSRAM_MODEM";
		VPROC_L = <0x218 0xff0000 900 30 1 0>;
		VCORE_OFF = <0x218 0xff00 750 30 1 0>;
		VCORE = <0x218 0xff 750 30 1 0>;
		MODEM = <0x21C 0xff 800 30 1 0>;
		VSRAM_VPROC_L = <0x220 0xff000000 900 30 1 0>;
		VSRAM_VCORE_PLUS_VLPAO = <0x220 0xff00 750 30 1 0>;
		VSRAM_MODEM = <0x224 0xff 800 30 1 0>;
	};

	lastbus: lastbus {
		compatible = "mediatek,lastbus";
		enabled = <1>;
		sw_version = <1>;
		timeout_ms = <200>;
		timeout_type = <0>;
		monitors {
			monitor1 {
				monitor_name = "debug_ctrl_ao_INFRA_AO";
				base = <0x10030000>;
				num_ports = <93>;
				bus_freq_mhz = <78>;
			};
			monitor2 {
				monitor_name = "debug_ctrl_ao_PERI_AO";
				base = <0x10050000>;
				num_ports = <39>;
				bus_freq_mhz = <78>;
			};
			monitor3 {
				monitor_name = "debug_ctrl_ao_PERI_AO2";
				base = <0x10051000>;
				num_ports = <16>;
				bus_freq_mhz = <78>;
			};
			monitor4 {
				monitor_name = "debug_ctrl_ao_PERI_PAR_AO";
				base = <0x10052000>;
				num_ports = <11>;
				bus_freq_mhz = <78>;
			};
			monitor5 {
				monitor_name = "debug_ctrl_ao_FMEM_AO";
				base = <0x10033000>;
				num_ports = <18>;
				bus_freq_mhz = <78>;
			};
		};
	};

	memory {
		device_type = "memory";
		reg = <0 0x80000000 0 0x3e605000>;
	};

	wed: wed@15010000 {
		compatible = "mediatek,wed";
		wed_num = <3>;
		/* add this property for wed get the pci slot number. */
		pci_slot_map = <0>, <1>, <2>;
		reg = <0 0x15010000 0 0x1000>,
			<0 0x15011000 0 0x1000>,
			<0 0x15012000 0 0x1000>;
		interrupt-parent = <&gic>;
		interrupts = <GIC_SPI 416 IRQ_TYPE_LEVEL_HIGH>,
				<GIC_SPI 417 IRQ_TYPE_LEVEL_HIGH>,
				<GIC_SPI 448 IRQ_TYPE_LEVEL_HIGH>;
	};

	wed2: wed2@15011000 {
		compatible = "mediatek,wed2";
		wed_num = <3>;
		reg = <0 0x15010000 0 0x1000>,
				<0 0x15011000 0 0x1000>,
				<0 0x15012000 0 0x1000>;
		interrupt-parent = <&gic>;
		interrupts = <GIC_SPI 416 IRQ_TYPE_LEVEL_HIGH>,
				<GIC_SPI 417 IRQ_TYPE_LEVEL_HIGH>,
				<GIC_SPI 448 IRQ_TYPE_LEVEL_HIGH>;
	};

	wed3: wed3@15012000 {
		compatible = "mediatek,wed3";
		wed_num = <3>;
		reg = <0 0x15010000 0 0x1000>,
			<0 0x15011000 0 0x1000>,
			<0 0x15012000 0 0x1000>;
		interrupt-parent = <&gic>;
		interrupts = <GIC_SPI 416 IRQ_TYPE_LEVEL_HIGH>,
				<GIC_SPI 417 IRQ_TYPE_LEVEL_HIGH>,
				<GIC_SPI 448 IRQ_TYPE_LEVEL_HIGH>;
	};

	wdma: wdma@15104800 {
		compatible = "mediatek,wed-wdma";
		reg = <0 0x15104800 0 0x400>,
			<0 0x15104c00 0 0x400>,
			<0 0x15105000 0 0x400>;
        };

	ap2woccif: ap2woccif@151A5000 {
		compatible = "mediatek,ap2woccif";
		reg = <0 0x151A5000 0 0x1000>,
			<0 0x152A5000 0 0x1000>,
			<0 0x153A5000 0 0x1000>;
		interrupt-parent = <&gic>;
		interrupts = <GIC_SPI 422 IRQ_TYPE_LEVEL_HIGH>,
				<GIC_SPI 423 IRQ_TYPE_LEVEL_HIGH>,
				<GIC_SPI 450 IRQ_TYPE_LEVEL_HIGH>;
	};

	wocpu_ilm: wocpu_ilm@151E0000 {
		compatible = "mediatek,wocpu_ilm";
		reg = <0 0x151E0000 0 0x8000>,
			<0 0x152E0000 0 0x8000>,
			<0 0x153E0000 0 0x8000>;
	};

	wocpu_dlm: wocpu_dlm@151E8000 {
		compatible = "mediatek,wocpu_dlm";
		reg = <0 0x151E8000 0 0x2000>,
			<0 0x152E8000 0 0x2000>,
			<0 0x153E8000 0 0x2000>;

		resets = <&ethsysrst 0>;
		reset-names = "wocpu_rst";
	};

	cpu_boot: wocpu_boot@15194000 {
		compatible = "mediatek,wocpu_boot";
		reg = <0 0x15194000 0 0x1000>,
			<0 0x15294000 0 0x1000>,
			<0 0x15394000 0 0x1000>;
	};

        pcie_mirror: pcie_mirror@10201000 {
                compatible = "mediatek,pcie-mirror";
                reg = <0 0x10201000 0 0x1000>;
        };

	reserved_memory: reserved-memory {
		#address-cells = <2>;
		#size-cells = <2>;
		ranges;
/*
		reserve-memory-medmcu_share {
			compatible = "mediatek,reserve-memory-medmcu_share";
			no-map;
			size = <0 0x00338D80>;
			alignment = <0 0x1000000>;
			alloc-ranges = <0 0x90000000 0 0x10000000>;
		};

		reserve-memory-medmcu_emu_share {
			compatible = "mediatek,reserve-memory-medmcu_emu_share";
			no-map;
			size = <0 0x032A0F80>;
			alignment = <0 0x1000000>;
			alloc-ranges = <0 0x90000000 0 0x10000000>;
		};
*/

		gps_mem: gps-reserve-memory {
			compatible = "mediatek,gps-reserve-memory";
			no-map;
			size = <0 0x60000>; /* 384KB */
			alignment = <0 0x10000>;
			alloc-ranges = <0 0x40000000 0 0x80000000>;
		};

		wocpu0_emi: wocpu0_emi@A1BE0000 {
			compatible = "mediatek,wocpu0_emi";
			no-map;
			reg = <0 0xA1BE0000 0 0x40000>;
			shared = <0>;
		};

		wocpu1_emi: wocpu1_emi@A1C20000 {
			compatible = "mediatek,wocpu1_emi";
			no-map;
			reg = <0 0xA1C20000 0 0x40000>;
			shared = <0>;
		};

		wocpu2_emi: wocpu2_emi@A1C60000 {
			compatible = "mediatek,wocpu2_emi";
			no-map;
			reg = <0 0xA1C60000 0 0x40000>;
			shared = <0>;
		};

		wocpu_data: wocpu_data@A30A0000 {
			compatible = "mediatek,wocpu_data";
			no-map;
			reg = <0 0xA30A0000 0 0x800000>;
			shared = <1>;
		};
	};

	cache_parity {
		compatible = "mediatek,mt6890-cache-parity";
		arm_dsu_ecc_hwirq = <32>;
		interrupts = <GIC_SPI 0 IRQ_TYPE_LEVEL_HIGH>,
			     <GIC_SPI 1 IRQ_TYPE_LEVEL_HIGH>,
			     <GIC_SPI 2 IRQ_TYPE_LEVEL_HIGH>,
			     <GIC_SPI 3 IRQ_TYPE_LEVEL_HIGH>,
			     <GIC_SPI 4 IRQ_TYPE_LEVEL_HIGH>;
	};

	gic: interrupt-controller {
		compatible = "arm,gic-v3";
		#interrupt-cells = <3>;
		#address-cells = <2>;
		#size-cells = <2>;
		#redistributor-regions = <1>;
		interrupt-parent = <&gic>;
		interrupt-controller;
		reg = <0 0x0c000000 0 0x40000>, // distributor
		      <0 0x0c040000 0 0x200000>; // redistributor
		interrupts = <GIC_PPI 9 IRQ_TYPE_LEVEL_HIGH>;
	};

	clkitg: clkitg {
		compatible = "simple-bus";
		scpsys = <&scpsys>;
	};

	disable_unused: disable_unused {
		compatible = "simple-bus";
	};

	clocks {
		clk_null: clk_null {
			compatible = "fixed-clock";
			#clock-cells = <0>;
			clock-frequency = <0>;
		};

		clk10m: clk10m {
			compatible = "fixed-clock";
			#clock-cells = <0>;
			clock-frequency = <10000000>;
		};

		clk26m: clk26m {
			compatible = "fixed-clock";
			#clock-cells = <0>;
			clock-frequency = <26000000>;
		};

		clk12m: clk12m {
			compatible = "fixed-clock";
			#clock-cells = <0>;
			clock-frequency = <12000000>;
		};

		clk32k: clk32k {
			compatible = "fixed-clock";
			#clock-cells = <0>;
			clock-frequency = <32000>;
		};

		clk13m: clk13m {
			compatible = "fixed-clock";
			#clock-cells = <0>;
			clock-frequency = <13000000>;
		};

		ulposc: ulposc {
			compatible = "fixed-clock";
			#clock-cells = <0>;
			clock-frequency = <260000000>;
		};
	};

	topckgen_clk: syscon@10000000 {
		compatible = "mediatek,mt6990-topckgen", "syscon";
		reg = <0 0x10000000 0 0x1000>;
		#clock-cells = <1>;
		hw-voter-regmap = <&hwv>;
	};

	vlp_cksys_clk: syscon@12013000 {
		compatible = "mediatek,mt6990-vlp_cksys", "syscon";
		reg = <0 0x12013000 0 0x1000>;
		#clock-cells = <1>;
	};

	vlpcfg_clk: syscon@1200C000 {
		compatible = "mediatek,mt6990-vlpcfg", "syscon";
		reg = <0 0x1200C000 0 0x1000>;
		#clock-cells = <1>;
	};

	apmixedsys_clk: syscon@10010000 {
		compatible = "mediatek,mt6990-apmixedsys", "syscon";
		reg = <0 0x10010000 0 0xe00>;
		#clock-cells = <1>;
	};

	afe_clk: syscon@11210000 {
		compatible = "mediatek,mt6990-afe", "syscon";
		reg = <0 0x11210000 0 0x1000>;
		#clock-cells = <1>;
	};

	dbgao_clk: syscon@d010000 {
		compatible = "mediatek,mt6990-dbgao", "syscon";
		reg = <0 0xd010000 0 0x1000>;
		#clock-cells = <1>;
	};

	dem_clk: syscon@d0a0000 {
		compatible = "mediatek,mt6990-dem", "syscon";
		reg = <0 0xd0a0000 0 0x1000>;
		#clock-cells = <1>;
	};

	gce_clk: syscon@10228000 {
		compatible = "mediatek,mt6990-gce", "syscon";
		reg = <0 0x10228000 0 0x1000>;
		#clock-cells = <1>;
	};

	imp_iic_top_wrap_clk: syscon@11000000 {
		compatible = "mediatek,mt6990-imp_iic_top_wrap", "syscon";
		reg = <0 0x11000000 0 0x1000>;
		#clock-cells = <1>;
	};

	infracfg_ao_clk: syscon@10001000 {
		compatible = "mediatek,mt6990-infracfg_ao", "syscon";
		reg = <0 0x10001000 0 0x1000>;
		#clock-cells = <1>;
	};

	mdpsys_config_clk: syscon@14000000 {
		compatible = "mediatek,mt6990-mdpsys", "syscon";
		reg = <0 0x14000000 0 0x1000>;
		#clock-cells = <1>;
	};

	mfg_top_clk: syscon@13fbf000 {
		compatible = "mediatek,mt6990-mfg_top", "syscon";
		reg = <0 0x13fbf000 0 0x1000>;
		#clock-cells = <1>;
	};

	msdc0_clk: syscon@11230000 {
		compatible = "mediatek,mt6990-msdc0", "syscon";
		reg = <0 0x11230000 0 0x1000>;
		#clock-cells = <1>;
	};

	msdc1_clk: syscon@11240000 {
		compatible = "mediatek,mt6990-msdc1", "syscon";
		reg = <0 0x11240000 0 0x1000>;
		#clock-cells = <1>;
	};

	pericfg_ao_clk: syscon@11036000 {
		compatible = "mediatek,mt6990-pericfg_ao", "syscon";
		reg = <0 0x11036000 0 0x1000>;
		#clock-cells = <1>;
	};

	sspm_cfg_clk: syscon@12300000 {
		compatible = "mediatek,mt6990-sspm_cfg", "syscon";
		reg = <0 0x12300000 0 0x1000>;
		#clock-cells = <1>;
	};

	ssusb_sifslv_ippc_clk: syscon@11203e00 {
		compatible = "mediatek,mt6990-ssusb", "syscon";
		reg = <0 0x11203e00 0 0x1000>;
		#clock-cells = <1>;
	};

	ssusb_usb20_phy_t5ff_clk: syscon@11ec0300 {
		compatible = "mediatek,mt6990-ssusb_phy", "syscon";
		reg = <0 0x11ec0300 0 0x1000>;
		#clock-cells = <1>;
	};

	scpsys: power-controller@12001000 {
		compatible = "mediatek,mt6990-scpsys", "syscon";
		reg = <0 0x12001000 0 0x1000>;
		#power-domain-cells = <1>;
		infracfg = <&infracfg_ao_clk>;
		vlpcfg = <&vlp_cksys_clk>;
		pericfg = <&pericfg_ao_clk>;
		clocks = <&topckgen_clk CLK_TOP_MM_SEL>,
			<&topckgen_clk CLK_TOP_NETSYS_SEL>,
			<&topckgen_clk CLK_TOP_NETSYS_WED_MCU_SEL>,
			<&topckgen_clk CLK_TOP_NETSYS_MED_MCU_SEL>,
			<&topckgen_clk CLK_TOP_NETSYS_500M_SEL>,
			<&topckgen_clk CLK_TOP_NETSYS_2X_SEL>,
			<&mdpsys_config_clk CLK_MDP_SMI_COMMON>,
			<&topckgen_clk CLK_TOP_ETH_312P5M_SEL>,
			<&topckgen_clk CLK_TOP_SNPS_ETH_250M_SEL>,
			<&topckgen_clk CLK_TOP_SNPS_ETH_62P4M_PTP_SEL>,
			<&topckgen_clk CLK_TOP_SNPS_ETH_50M_RMII_SEL>,
			<&vlpcfg_clk CLK_VLPCFG_PCIE_SRAM_26M>;
		clock-names = "disp",
			"netsys",
			"wedsys",
			"medsys",
			"net500",
			"net2x",
			"disp-0",
			"eth1",
 			"eth2",
			"eth3",
			"eth4",
			"pcie0";
		/*status="disabled";*/
	};

	hwv: syscon@1031C000 {
		compatible = "mediatek,mt6895-hwv", "syscon";
		reg = <0 0x1031C000 0 0x2000>;
	};

/* old

	audsys_clk: syscon@11210000 {
		compatible = "mediatek,mt6890-audsys", "syscon";
		reg = <0 0x11210000 0 0x1000>;
		#clock-cells = <1>;
	};

	mfgsys_clk: syscon@13fbf000 {
		compatible = "mediatek,mt6890-mfgsys", "syscon";
		reg = <0 0x13fbf000 0 0x1000>;
		#clock-cells = <1>;
	};

	mmsys_config_clk: syson@14000000 {
		compatible = "mediatek,mt6890-mmsys_config", "syscon";
		reg = <0 0x14000000 0 0x1000>;
		#clock-cells = <1>;
	};
 old */

	trm: thermal_risk_monitor {
		compatible = "mediatek,mt6880-trm";
	};

	tboard_thermistor1: thermal-ntc1 {
		compatible = "mediatek,mt6980-board-ntc";
		#thermal-sensor-cells = <0>;
		reg = <0 0x128050D4 0 0x4>; /* TIA DATA T0 */
		temperature-lookup-table = <
			(-40000) 4397119
			(-39000) 4092874
			(-38000) 3811717
			(-37000) 3551749
			(-36000) 3311236
			(-35000) 3088599
			(-34000) 2882396
			(-33000) 2691310
			(-32000) 2514137
			(-31000) 2349778
			(-30000) 2197225
			(-29000) 2055558
			(-28000) 1923932
			(-27000) 1801573
			(-26000) 1687773
			(-25000) 1581881
			(-24000) 1483100
			(-23000) 1391113
			(-22000) 1305413
			(-21000) 1225531
			(-20000) 1151037
			(-19000) 1081535
			(-18000) 1016661
			(-17000) 956080
			(-16000) 899481
			(-15000) 846579
			(-14000) 797111
			(-13000) 750834
			(-12000) 707524
			(-11000) 666972
			(-10000) 628988
			(-9000) 593342
			(-8000) 559931
			(-7000) 528602
			(-6000) 499212
			(-5000) 471632
			(-4000) 445772
			(-3000) 421480
			(-2000) 398652
			(-1000) 377193
			0 357012
			1000 338006
			2000 320122
			3000 303287
			4000 287434
			5000 272500
			6000 258426
			7000 245160
			8000 232649
			9000 220847
			10000 209710
			11000 199196
			12000 189268
			13000 179890
			14000 171027
			15000 162651
			16000 154726
			17000 147232
			18000 140142
			19000 133432
			20000 127080
			21000 121066
			22000 115368
			23000 109970
			24000 104852
			25000 100000
			26000 95398
			27000 91032
			28000 86889
			29000 82956
			30000 79222
			31000 75675
			32000 72306
			33000 69104
			34000 66061
			35000 63167
			36000 60415
			37000 57797
			38000 55306
			39000 52934
			40000 50677
			41000 48528
			42000 46482
			43000 44533
			44000 42675
			45000 40904
			46000 39213
			47000 37601
			48000 36063
			49000 34595
			50000 33195
			51000 31859
			52000 30584
			53000 29366
			54000 28203
			55000 27091
			56000 26028
			57000 25013
			58000 24042
			59000 23113
			60000 22224
			61000 21374
			62000 20560
			63000 19782
			64000 19036
			65000 18322
			66000 17640
			67000 16986
			68000 16360
			69000 15759
			70000 15184
			71000 14631
			72000 14100
			73000 13591
			74000 13103
			75000 12635
			76000 12187
			77000 11756
			78000 11343
			79000 10946
			80000 10565
			81000 10199
			82000 9847
			83000 9509
			84000 9184
			85000 8872
			86000 8572
			87000 8283
			88000 8005
			89000 7738
			90000 7481
			91000 7234
			92000 6997
			93000 6769
			94000 6548
			95000 6337
			96000 6132
			97000 5934
			98000 5744
			99000 5561
			100000 5384
			101000 5214
			102000 5051
			103000 4893
			104000 4741
			105000 4594
			106000 4453
			107000 4316
			108000 4184
			109000 4057
			110000 3934
			111000 3816
			112000 3701
			113000 3591
			114000 3484
			115000 3380
			116000 3281
			117000 3185
			118000 3093
			119000 3003
			120000 2916
			121000 2832
			122000 2751
			123000 2672
			124000 2596
			125000 2522>;
	};

	tboard_thermistor2: thermal-ntc2 {
		compatible = "mediatek,mt6980-board-ntc";
		#thermal-sensor-cells = <0>;
		reg = <0 0x128050D8 0 0x4>; /* TIA DATA T1 */
		temperature-lookup-table = <
			(-40000) 4397119
			(-39000) 4092874
			(-38000) 3811717
			(-37000) 3551749
			(-36000) 3311236
			(-35000) 3088599
			(-34000) 2882396
			(-33000) 2691310
			(-32000) 2514137
			(-31000) 2349778
			(-30000) 2197225
			(-29000) 2055558
			(-28000) 1923932
			(-27000) 1801573
			(-26000) 1687773
			(-25000) 1581881
			(-24000) 1483100
			(-23000) 1391113
			(-22000) 1305413
			(-21000) 1225531
			(-20000) 1151037
			(-19000) 1081535
			(-18000) 1016661
			(-17000) 956080
			(-16000) 899481
			(-15000) 846579
			(-14000) 797111
			(-13000) 750834
			(-12000) 707524
			(-11000) 666972
			(-10000) 628988
			(-9000) 593342
			(-8000) 559931
			(-7000) 528602
			(-6000) 499212
			(-5000) 471632
			(-4000) 445772
			(-3000) 421480
			(-2000) 398652
			(-1000) 377193
			0 357012
			1000 338006
			2000 320122
			3000 303287
			4000 287434
			5000 272500
			6000 258426
			7000 245160
			8000 232649
			9000 220847
			10000 209710
			11000 199196
			12000 189268
			13000 179890
			14000 171027
			15000 162651
			16000 154726
			17000 147232
			18000 140142
			19000 133432
			20000 127080
			21000 121066
			22000 115368
			23000 109970
			24000 104852
			25000 100000
			26000 95398
			27000 91032
			28000 86889
			29000 82956
			30000 79222
			31000 75675
			32000 72306
			33000 69104
			34000 66061
			35000 63167
			36000 60415
			37000 57797
			38000 55306
			39000 52934
			40000 50677
			41000 48528
			42000 46482
			43000 44533
			44000 42675
			45000 40904
			46000 39213
			47000 37601
			48000 36063
			49000 34595
			50000 33195
			51000 31859
			52000 30584
			53000 29366
			54000 28203
			55000 27091
			56000 26028
			57000 25013
			58000 24042
			59000 23113
			60000 22224
			61000 21374
			62000 20560
			63000 19782
			64000 19036
			65000 18322
			66000 17640
			67000 16986
			68000 16360
			69000 15759
			70000 15184
			71000 14631
			72000 14100
			73000 13591
			74000 13103
			75000 12635
			76000 12187
			77000 11756
			78000 11343
			79000 10946
			80000 10565
			81000 10199
			82000 9847
			83000 9509
			84000 9184
			85000 8872
			86000 8572
			87000 8283
			88000 8005
			89000 7738
			90000 7481
			91000 7234
			92000 6997
			93000 6769
			94000 6548
			95000 6337
			96000 6132
			97000 5934
			98000 5744
			99000 5561
			100000 5384
			101000 5214
			102000 5051
			103000 4893
			104000 4741
			105000 4594
			106000 4453
			107000 4316
			108000 4184
			109000 4057
			110000 3934
			111000 3816
			112000 3701
			113000 3591
			114000 3484
			115000 3380
			116000 3281
			117000 3185
			118000 3093
			119000 3003
			120000 2916
			121000 2832
			122000 2751
			123000 2672
			124000 2596
			125000 2522>;
	};

	tboard_thermistor3: thermal-ntc3 {
		compatible = "mediatek,mt6980-board-ntc";
		#thermal-sensor-cells = <0>;
		reg = <0 0x128050DC 0 0x4>; /* TIA DATA T2 */
		temperature-lookup-table = <
			(-40000) 4397119
			(-39000) 4092874
			(-38000) 3811717
			(-37000) 3551749
			(-36000) 3311236
			(-35000) 3088599
			(-34000) 2882396
			(-33000) 2691310
			(-32000) 2514137
			(-31000) 2349778
			(-30000) 2197225
			(-29000) 2055558
			(-28000) 1923932
			(-27000) 1801573
			(-26000) 1687773
			(-25000) 1581881
			(-24000) 1483100
			(-23000) 1391113
			(-22000) 1305413
			(-21000) 1225531
			(-20000) 1151037
			(-19000) 1081535
			(-18000) 1016661
			(-17000) 956080
			(-16000) 899481
			(-15000) 846579
			(-14000) 797111
			(-13000) 750834
			(-12000) 707524
			(-11000) 666972
			(-10000) 628988
			(-9000) 593342
			(-8000) 559931
			(-7000) 528602
			(-6000) 499212
			(-5000) 471632
			(-4000) 445772
			(-3000) 421480
			(-2000) 398652
			(-1000) 377193
			0 357012
			1000 338006
			2000 320122
			3000 303287
			4000 287434
			5000 272500
			6000 258426
			7000 245160
			8000 232649
			9000 220847
			10000 209710
			11000 199196
			12000 189268
			13000 179890
			14000 171027
			15000 162651
			16000 154726
			17000 147232
			18000 140142
			19000 133432
			20000 127080
			21000 121066
			22000 115368
			23000 109970
			24000 104852
			25000 100000
			26000 95398
			27000 91032
			28000 86889
			29000 82956
			30000 79222
			31000 75675
			32000 72306
			33000 69104
			34000 66061
			35000 63167
			36000 60415
			37000 57797
			38000 55306
			39000 52934
			40000 50677
			41000 48528
			42000 46482
			43000 44533
			44000 42675
			45000 40904
			46000 39213
			47000 37601
			48000 36063
			49000 34595
			50000 33195
			51000 31859
			52000 30584
			53000 29366
			54000 28203
			55000 27091
			56000 26028
			57000 25013
			58000 24042
			59000 23113
			60000 22224
			61000 21374
			62000 20560
			63000 19782
			64000 19036
			65000 18322
			66000 17640
			67000 16986
			68000 16360
			69000 15759
			70000 15184
			71000 14631
			72000 14100
			73000 13591
			74000 13103
			75000 12635
			76000 12187
			77000 11756
			78000 11343
			79000 10946
			80000 10565
			81000 10199
			82000 9847
			83000 9509
			84000 9184
			85000 8872
			86000 8572
			87000 8283
			88000 8005
			89000 7738
			90000 7481
			91000 7234
			92000 6997
			93000 6769
			94000 6548
			95000 6337
			96000 6132
			97000 5934
			98000 5744
			99000 5561
			100000 5384
			101000 5214
			102000 5051
			103000 4893
			104000 4741
			105000 4594
			106000 4453
			107000 4316
			108000 4184
			109000 4057
			110000 3934
			111000 3816
			112000 3701
			113000 3591
			114000 3484
			115000 3380
			116000 3281
			117000 3185
			118000 3093
			119000 3003
			120000 2916
			121000 2832
			122000 2751
			123000 2672
			124000 2596
			125000 2522>;
	};

	tboard_thermistor4: thermal-ntc4 {
		compatible = "mediatek,mt6980-board-ntc";
		#thermal-sensor-cells = <0>;
		reg = <0 0x128050E0 0 0x4>; /* TIA DATA T3 */
		temperature-lookup-table = <
			(-40000) 4397119
			(-39000) 4092874
			(-38000) 3811717
			(-37000) 3551749
			(-36000) 3311236
			(-35000) 3088599
			(-34000) 2882396
			(-33000) 2691310
			(-32000) 2514137
			(-31000) 2349778
			(-30000) 2197225
			(-29000) 2055558
			(-28000) 1923932
			(-27000) 1801573
			(-26000) 1687773
			(-25000) 1581881
			(-24000) 1483100
			(-23000) 1391113
			(-22000) 1305413
			(-21000) 1225531
			(-20000) 1151037
			(-19000) 1081535
			(-18000) 1016661
			(-17000) 956080
			(-16000) 899481
			(-15000) 846579
			(-14000) 797111
			(-13000) 750834
			(-12000) 707524
			(-11000) 666972
			(-10000) 628988
			(-9000) 593342
			(-8000) 559931
			(-7000) 528602
			(-6000) 499212
			(-5000) 471632
			(-4000) 445772
			(-3000) 421480
			(-2000) 398652
			(-1000) 377193
			0 357012
			1000 338006
			2000 320122
			3000 303287
			4000 287434
			5000 272500
			6000 258426
			7000 245160
			8000 232649
			9000 220847
			10000 209710
			11000 199196
			12000 189268
			13000 179890
			14000 171027
			15000 162651
			16000 154726
			17000 147232
			18000 140142
			19000 133432
			20000 127080
			21000 121066
			22000 115368
			23000 109970
			24000 104852
			25000 100000
			26000 95398
			27000 91032
			28000 86889
			29000 82956
			30000 79222
			31000 75675
			32000 72306
			33000 69104
			34000 66061
			35000 63167
			36000 60415
			37000 57797
			38000 55306
			39000 52934
			40000 50677
			41000 48528
			42000 46482
			43000 44533
			44000 42675
			45000 40904
			46000 39213
			47000 37601
			48000 36063
			49000 34595
			50000 33195
			51000 31859
			52000 30584
			53000 29366
			54000 28203
			55000 27091
			56000 26028
			57000 25013
			58000 24042
			59000 23113
			60000 22224
			61000 21374
			62000 20560
			63000 19782
			64000 19036
			65000 18322
			66000 17640
			67000 16986
			68000 16360
			69000 15759
			70000 15184
			71000 14631
			72000 14100
			73000 13591
			74000 13103
			75000 12635
			76000 12187
			77000 11756
			78000 11343
			79000 10946
			80000 10565
			81000 10199
			82000 9847
			83000 9509
			84000 9184
			85000 8872
			86000 8572
			87000 8283
			88000 8005
			89000 7738
			90000 7481
			91000 7234
			92000 6997
			93000 6769
			94000 6548
			95000 6337
			96000 6132
			97000 5934
			98000 5744
			99000 5561
			100000 5384
			101000 5214
			102000 5051
			103000 4893
			104000 4741
			105000 4594
			106000 4453
			107000 4316
			108000 4184
			109000 4057
			110000 3934
			111000 3816
			112000 3701
			113000 3591
			114000 3484
			115000 3380
			116000 3281
			117000 3185
			118000 3093
			119000 3003
			120000 2916
			121000 2832
			122000 2751
			123000 2672
			124000 2596
			125000 2522>;
	};

	mt6361_temp: mt6361_temp {
		compatible = "mediatek,mt6361-pmic-temp";
		io-channels =
			<&pmic_auxadc AUXADC_CHIP_TEMP>,
			<&pmic_auxadc AUXADC_VS1_TEMP>,
			<&pmic_auxadc AUXADC_DIGRF_TEMP>,
			<&pmic_auxadc AUXADC_MODEM_TEMP>;
		io-channel-names =
			"pmic6361_ts1",
			"pmic6361_ts2",
			"pmic6361_ts3",
			"pmic6361_ts4";

		#thermal-sensor-cells = <1>;
		nvmem-cells = <&thermal_efuse_data1>;
		nvmem-cell-names = "mt6361_e_data";
	};

	md_rf_ic: md-rf-ic {
		compatible = "mediatek,md-rf";
		#thermal-sensor-cells = <0>;
	};

	md_cooler_mutt: mutt {
		compatible = "mediatek,mt6297-md-cooler-mutt";
		mutt_pa1: mutt-pa1 {
			id = <0>;
			#cooling-cells = <2>;
		};
		mutt_pa1_no_ims: mutt-pa1-no-ims {
			id = <0>;
			#cooling-cells = <2>;
		};
		mutt_pa2: mutt-pa2 {
			id = <1>;
			#cooling-cells = <2>;
		};
		mutt_pa2_no_ims: mutt-pa2-no-ims {
			id = <1>;
			#cooling-cells = <2>;
		};
	};

	md_cooler_mutt_cc: mutt-cc {
		compatible = "mediatek,md-cooler-mutt_cc";
		mutt_cc1: mutt-cc1 {
			id = <0>;
			#cooling-cells = <2>;
		};
		mutt_cc2: mutt-cc2 {
			id = <1>;
			#cooling-cells = <2>;
		};
	};

	md_cooler_ul_control: ul-control {
		compatible = "mediatek,md-cooler-ul-control";
		ul_control: ul-control {
			id = <0>;
			#cooling-cells = <2>;
		};
	};

	md_cooler_tx_pwr: tx-pwr {
		compatible = "mediatek,md-cooler-tx-pwr";
		tx_pwr_pa1: tx-pwr-pa1 {
			id = <0>;
			#cooling-cells = <2>;
		};
		tx_pwr_pa2: tx-pwr-pa2 {
			id = <1>;
			#cooling-cells = <2>;
		};
	};
	md_cooler_scg_off: scg-off {
		compatible = "mediatek,md-cooler-scg-off";
		scg_off_pa2: scg-off-pa2 {
			id = <1>;
			#cooling-cells = <2>;
		};
	};

	thermal-zones {
		soc_max {
			polling-delay = <100>; /* milliseconds */
			polling-delay-passive = <50>; /* milliseconds */
			thermal-sensors = <&lvts 0>;

			trips {
				cpu_threshold: cpu_trip-point@0 {
					temperature = <95000>;
					hysteresis = <2000>;
					type = "passive";
				};

				gpu_threshold: gpu_trip-point@0 {
					temperature = <95000>;
					hysteresis = <2000>;
					type = "passive";
				};

				soc_max_crit: soc_max_crit@0 {
					temperature = <115000>;
					hysteresis = <2000>;
					type = "critical";
				};
			};

			cooling-maps {
				map0 {
					trip = <&cpu_threshold>;
					cooling-device = <&cpu0 THERMAL_NO_LIMIT THERMAL_NO_LIMIT>,
							<&cpu1 THERMAL_NO_LIMIT THERMAL_NO_LIMIT>,
							<&cpu2 THERMAL_NO_LIMIT THERMAL_NO_LIMIT>,
							<&cpu3 THERMAL_NO_LIMIT THERMAL_NO_LIMIT>;
					contribution = <1024>;
				};

				map1 {
					trip = <&gpu_threshold>;
					cooling-device = <&mali THERMAL_NO_LIMIT THERMAL_NO_LIMIT>;
					contribution = <1024>;
				};
			};
		};

		cpu_little0 {
			polling-delay = <0>; /* milliseconds */
			polling-delay-passive = <0>; /* milliseconds */
			thermal-sensors = <&lvts 1>;
		};
		cpu_little1 {
			polling-delay = <0>; /* milliseconds */
			polling-delay-passive = <0>; /* milliseconds */
			thermal-sensors = <&lvts 2>;
		};
		cpu_little2 {
			polling-delay = <0>; /* milliseconds */
			polling-delay-passive = <0>; /* milliseconds */
			thermal-sensors = <&lvts 3>;
		};
		cpu_little3 {
			polling-delay = <0>; /* milliseconds */
			polling-delay-passive = <0>; /* milliseconds */
			thermal-sensors = <&lvts 4>;
		};
		gpu0 {
			polling-delay = <0>; /* milliseconds */
			polling-delay-passive = <0>; /* milliseconds */
			thermal-sensors = <&lvts 5>;
		};
		gpu1 {
			polling-delay = <0>; /* milliseconds */
			polling-delay-passive = <0>; /* milliseconds */
			thermal-sensors = <&lvts 6>;
		};
		infra {
			polling-delay = <0>; /* milliseconds */
			polling-delay-passive = <0>; /* milliseconds */
			thermal-sensors = <&lvts 7>;
		};
		connsys {
			polling-delay = <0>; /* milliseconds */
			polling-delay-passive = <0>; /* milliseconds */
			thermal-sensors = <&lvts 8>;
		};
		md0 {
			polling-delay = <0>; /* milliseconds */
			polling-delay-passive = <0>; /* milliseconds */
			thermal-sensors = <&lvts 9>;
		};
		md1{
			polling-delay = <0>; /* milliseconds */
			polling-delay-passive = <0>; /* milliseconds */
			thermal-sensors = <&lvts 10>;
		};
		md2 {
			polling-delay = <0>; /* milliseconds */
			polling-delay-passive = <0>; /* milliseconds */
			thermal-sensors = <&lvts 11>;
		};
		md3 {
			polling-delay = <0>; /* milliseconds */
			polling-delay-passive = <0>; /* milliseconds */
			thermal-sensors = <&lvts 12>;
		};

		soc_dram_ntc {
			polling-delay = <1000>; /* milliseconds */
			polling-delay-passive = <1000>; /* milliseconds */
			thermal-sensors = <&tboard_thermistor1>;

			trips {
				soc_dram_ntc_crit: soc_dram_ntc_crit@0 {
					temperature = <100000>;
					hysteresis = <2000>;
					type = "critical";
				};
			};
		};

		nrpa_ntc {
			polling-delay = <1000>; /* milliseconds */
			polling-delay-passive = <1000>; /* milliseconds */
			thermal-sensors = <&tboard_thermistor2>;

			trips {
				nrpa_ntc_target: nrpa_ntc_trip@0 {
					temperature = <82000>;
					hysteresis = <2000>;
					type = "passive";
				};
				nrpa_ntc_no_ims: nrpa_ntc_trip@1 {
					temperature = <90000>;
					hysteresis = <2000>;
					type = "passive";
				};
				nrpa_ntc_crit: nrpa_ntc_trip@2 {
					temperature = <100000>;
					hysteresis = <2000>;
					type = "critical";
				};
			};
			cooling-maps {
				map0 {
					trip = <&nrpa_ntc_target>;
					cooling-device = <&mutt_pa2 0 6>;
					#cooling-device = <&mutt_pa2 THERMAL_NO_LIMIT THERMAL_NO_LIMIT>;
				};
				map1 {
					trip = <&nrpa_ntc_no_ims>;
					cooling-device = <&mutt_pa2_no_ims THERMAL_NO_LIMIT THERMAL_NO_LIMIT>;
				};
			};
		};

		ltepa_ntc {
			polling-delay = <1000>; /* milliseconds */
			polling-delay-passive = <1000>; /* milliseconds */
			thermal-sensors = <&tboard_thermistor3>;

			trips {
				ltepa_ntc_target: ltepa_ntc_trip@0 {
					temperature = <82000>;
					hysteresis = <2000>;
					type = "passive";
				};
				ltepa_ntc_no_ims: ltepa_ntc_trip@1 {
					temperature = <90000>;
					hysteresis = <2000>;
					type = "passive";
				};
				ltepa_ntc_crit: ltepa_ntc_trip@2 {
					temperature = <100000>;
					hysteresis = <2000>;
					type = "critical";
				};
			};
			cooling-maps {
				map0 {
					trip = <&ltepa_ntc_target>;
					cooling-device = <&mutt_pa1 0 6>;
					#cooling-device = <&mutt_pa1 THERMAL_NO_LIMIT THERMAL_NO_LIMIT>;
				};
				map1 {
					trip = <&ltepa_ntc_no_ims>;
					cooling-device = <&mutt_pa1_no_ims THERMAL_NO_LIMIT THERMAL_NO_LIMIT>;
				};
			};
		};

		rf_ntc {
			polling-delay = <1000>; /* milliseconds */
			polling-delay-passive = <1000>; /* milliseconds */
			thermal-sensors = <&tboard_thermistor4>;

			trips {
				rf_ntc_crit: rf_ntc_crit@0 {
					temperature = <100000>;
					hysteresis = <2000>;
					type = "critical";
				};
			};
		};

		pmic6361_temp {
			polling-delay = <0>; /* milliseconds */
			polling-delay-passive = <0>; /* milliseconds */
			thermal-sensors = <&mt6361_temp 0>;

			trips {
				pmic_temp_crit: pmic_temp_crit@0 {
					temperature = <125000>;
					hysteresis = <2000>;
					type = "critical";
				};
			};
		};

		pmic6361_vs1 {
			polling-delay = <0>; /* milliseconds */
			polling-delay-passive = <0>; /* milliseconds */
			thermal-sensors = <&mt6361_temp 1>;
		};

		pmic6361_digrf {
			polling-delay = <0>; /* milliseconds */
			polling-delay-passive = <0>; /* milliseconds */
			thermal-sensors = <&mt6361_temp 2>;
		};

		pmic6361_md {
			polling-delay = <0>; /* milliseconds */
			polling-delay-passive = <0>; /* milliseconds */
			thermal-sensors = <&mt6361_temp 3>;
		};

		md_rf {
			polling-delay = <1000>; /* milliseconds */
			polling-delay-passive = <1000>; /* milliseconds */
			thermal-sensors = <&md_rf_ic>;

			trips {
				md_rf_crit: md_rf_crit@0 {
					temperature = <117000>;
					hysteresis = <2000>;
					type = "critical";
				};
			};
		};
	};

	chipid@08000000 {
		compatible = "mediatek,chipid";
		reg = <0 0x08000000 0 0x0004>,
		      <0 0x08000004 0 0x0004>,
		      <0 0x08000008 0 0x0004>,
		      <0 0x0800000c 0 0x0004>;
	};

	dbgtop@10005000 {
		compatible = "mediatek,dbgtop-drm";
		reg = <0 0x10005000 0 0x1000>;
	};

	dfd_mcu@0c530000 {
		compatible = "mediatek,dfd_mcu";
		enabled = <1>;
		hw_version = <35>;
		sw_version = <1>;
		dfd_timeout = <0x190>;
		buf_addr_align = <0x400000>;
		buf_addr_max = <0xffffffff>;
		buf_length = <0x280000>;
		nr_max_core = <4>;
		nr_big_core = <0>;
		nr_rs_entry_little = <8>;
		nr_rs_entry_big = <0>;
		nr_header_row = <0>;
		chip_id_offset = <0x18>;
		check_pattern_offset = <0x0>;
		/* dfd_disable_efuse = <25 12>; */
		dfd_disable_efuse = <(-1) (-1)>;
		dfd_cache {
			enabled = <0>;
			dfd_timeout = <0x1d4c0>;
			buf_length = <0xA00000>;
			tap_en = <0x43ff>;
		};
	};

	mcupm@0C540000 {
		compatible = "mediatek,mcupm";
		reg =<0 0x0C540000 0 0x22000>,
		      <0 0x0c56fb00 0 0xa0>,
                      <0 0x0c582004 0 0x4>,
                      <0 0x0c582018 0 0x4>,
                      <0 0x0c582000 0 0x4>,
                      <0 0x0c582010 0 0x4>,

                      <0 0x0c56fba0 0 0xa0>,
                      <0 0x0c582004 0 0x4>,
                      <0 0x0c582018 0 0x4>,
                      <0 0x0c582000 0 0x4>,
                      <0 0x0c582010 0 0x4>,

                      <0 0x0c56fc40 0 0xa0>,
                      <0 0x0c582004 0 0x4>,
                      <0 0x0c582018 0 0x4>,
                      <0 0x0c582000 0 0x4>,
                      <0 0x0c582010 0 0x4>,

                      <0 0x0c56fce0 0 0xa0>,
                      <0 0x0c582004 0 0x4>,
                      <0 0x0c582018 0 0x4>,
                      <0 0x0c582000 0 0x4>,
                      <0 0x0c582010 0 0x4>,

                      <0 0x0c56fd80 0 0xa0>,
                      <0 0x0c582004 0 0x4>,
                      <0 0x0c582018 0 0x4>,
                      <0 0x0c582000 0 0x4>,
                      <0 0x0c582010 0 0x4>,

                      <0 0x0c56fe20 0 0xa0>,
                      <0 0x0c582004 0 0x4>,
                      <0 0x0c582018 0 0x4>,
                      <0 0x0c582000 0 0x4>,
                      <0 0x0c582010 0 0x4>,

                      <0 0x0c56fec0 0 0xa0>,
                      <0 0x0c582004 0 0x4>,
                      <0 0x0c582018 0 0x4>,
                      <0 0x0c582000 0 0x4>,
                      <0 0x0c582010 0 0x4>,

                      <0 0x0c56ff60 0 0xa0>,
                      <0 0x0c582004 0 0x4>,
                      <0 0x0c582018 0 0x4>,
                      <0 0x0c582000 0 0x4>,
                      <0 0x0c582010 0 0x4>;
		reg-names = "mcupm_base",

			"mbox0_base",
			"mbox0_set",
			"mbox0_clr",
			"mbox0_send",
			"mbox0_recv",

			"mbox1_base",
			"mbox1_set",
			"mbox1_clr",
			"mbox1_send",
			"mbox1_recv",

			"mbox2_base",
			"mbox2_set",
			"mbox2_clr",
			"mbox2_send",
			"mbox2_recv",

			"mbox3_base",
			"mbox3_set",
			"mbox3_clr",
			"mbox3_send",
			"mbox3_recv",

			"mbox4_base",
			"mbox4_set",
			"mbox4_clr",
			"mbox4_send",
			"mbox4_recv",

			"mbox5_base",
			"mbox5_set",
			"mbox5_clr",
			"mbox5_send",
			"mbox5_recv",

			"mbox6_base",
			"mbox6_set",
			"mbox6_clr",
			"mbox6_send",
			"mbox6_recv",

			"mbox7_base",
			"mbox7_set",
			"mbox7_clr",
			"mbox7_send",
			"mbox7_recv";

		interrupts = <GIC_SPI 24 IRQ_TYPE_LEVEL_HIGH>,
                             <GIC_SPI 25 IRQ_TYPE_LEVEL_HIGH>,
                             <GIC_SPI 26 IRQ_TYPE_LEVEL_HIGH>,
                             <GIC_SPI 27 IRQ_TYPE_LEVEL_HIGH>,
                             <GIC_SPI 28 IRQ_TYPE_LEVEL_HIGH>,
                             <GIC_SPI 29 IRQ_TYPE_LEVEL_HIGH>,
                             <GIC_SPI 30 IRQ_TYPE_LEVEL_HIGH>,
                             <GIC_SPI 31 IRQ_TYPE_LEVEL_HIGH>;

		interrupt-names = "mbox0",
			"mbox1",
			"mbox2",
			"mbox3",
			"mbox4",
			"mbox5",
			"mbox6",
			"mbox7";
	};

	topckgen: topckgen@10000000 {
		compatible = "mediatek,topckgen", "syscon";
		reg = <0 0x10000000 0 0x1000>;
	};

	infracfg_ao: infracfg_ao@10001000 {
		compatible = "mediatek,infracfg_ao", "syscon", "simple-mfd";
		reg = <0 0x10001000 0 0x1000>;
	};

	infracfg_ao_mem@10002000 {
		compatible = "mediatek,infracfg_ao_mem";
		reg = <0 0x10002000 0 0x1000>;
	};

	pericfg@11035000 {
		compatible = "mediatek,pericfg";
		reg = <0 0x11035000 0 0x1000>;
	};

	gpio_usage_mapping: gpio_usage_mapping {
		compatible = "mediatek,gpio_usage_mapping";
	};

	gpio: gpio@10004000 {
		compatible = "mediatek,gpio";
		reg = <0 0x10004000 0 0x1000>;
	};

	pio: pinctrl@10004000 {
		compatible = "mediatek,mt69xx-pinctrl";
		reg = <0 0x10004000 0 0x1000>,
			<0 0x11c00000 0 0x1000>,
			<0 0x11c10000 0 0x1000>,
			<0 0x11d00000 0 0x1000>,
			<0 0x11d10000 0 0x1000>,
			<0 0x11d20000 0 0x1000>,
			<0 0x11d30000 0 0x1000>,
			<0 0x11e80000 0 0x1000>,
			<0 0x11e90000 0 0x1000>,
			<0 0x11eb0000 0 0x1000>;
		reg-names = "gpio",
			"iocfg_rt_8", "iocfg_rt_9",
			"iocfg_bm_4", "iocfg_bm_5",
			"iocfg_bm_6", "iocfg_bm_7",
			"iocfg_lt_0","iocfg_lt_1",
			"iocfg_lt_3";
		gpio-controller;
		#gpio-cells = <2>;
		gpio-ranges = <&pio 0 0 226>;
		interrupt-controller;
		#interrupt-cells = <2>;
		mediatek,eint = <&eint>;
	};

	eint: apirq@11e70000 {
		compatible = "mediatek,mt6983-eint";
		reg = <0 0x11e70000 0 0x1000>,
			<0 0x11c30000 0 0x1000>,
			<0 0x11d70000 0 0x1000>,
			<0 0x1201e000 0 0x1000>;
		reg-name = "eint-w", "eint-e", "eint-s", "eint-c";
		interrupts = <GIC_SPI 160 IRQ_TYPE_LEVEL_HIGH>;
		mediatek,total-pin-number = <237>;
		mediatek,instance-num = <4>;
		mediatek,pins = <0 2 0 1>,
			<1 2 1 1>,
			<2 2 2 1>,
			<3 2 3 1>,
			<4 2 4 1>,
			<5 2 5 1>,
			<6 2 6 1>,
			<7 2 7 1>,
			<8 2 8 1>,
			<9 2 9 1>,
			<10 2 10 1>,
			<11 2 11 1>,
			<12 2 12 1>,
			<13 2 13 1>,
			<14 2 14 1>,
			<15 2 15 1>,
			<16 2 16 1>,
			<17 2 17 1>,
			<18 2 18 1>,
			<19 2 19 1>,
			<20 2 20 1>,
			<21 2 21 1>,
			<22 2 22 1>,
			<23 2 23 1>,
			<24 2 24 1>,
			<25 2 25 1>,
			<26 2 26 1>,
			<27 2 27 1>,
			<28 0 0 1>,
			<29 0 1 1>,
			<30 0 2 1>,
			<31 0 3 1>,
			<32 0 4 1>,
			<35 0 5 1>,
			<36 0 6 1>,
			<37 0 7 1>,
			<38 0 8 1>,
			<44 0 9 1>,
			<45 0 10 1>,
			<46 0 11 1>,
			<47 0 12 1>,
			<48 2 28 1>,
			<49 2 29 1>,
			<50 2 30 1>,
			<51 2 31 1>,
			<52 2 32 1>,
			<53 2 33 1>,
			<54 2 34 1>,
			<55 2 35 1>,
			<56 2 36 1>,
			<57 2 37 1>,
			<58 2 38 1>,
			<59 2 39 1>,
			<60 2 40 1>,
			<61 2 41 1>,
			<62 2 42 1>,
			<63 2 43 1>,
			<64 2 44 1>,
			<65 2 45 1>,
			<66 2 46 1>,
			<67 2 47 1>,
			<68 2 48 1>,
			<69 2 49 1>,
			<70 2 50 1>,
			<73 2 51 1>,
			<74 2 52 1>,
			<75 2 53 1>,
			<76 2 54 1>,
			<77 2 55 1>,
			<78 2 56 1>,
			<79 2 57 1>,
			<80 2 58 1>,
			<81 2 59 1>,
			<82 2 60 1>,
			<83 2 61 1>,
			<84 2 62 1>,
			<85 2 63 1>,
			<86 2 64 1>,
			<87 2 65 1>,
			<88 2 66 1>,
			<89 2 67 1>,
			<90 2 68 1>,
			<91 2 69 1>,
			<92 2 70 1>,
			<93 2 71 1>,
			<94 2 72 1>,
			<95 2 73 1>,
			<96 2 74 1>,
			<97 2 75 1>,
			<98 2 76 1>,
			<99 2 77 1>,
			<100 2 78 1>,
			<101 2 79 1>,
			<102 2 80 1>,
			<103 2 81 1>,
			<104 2 82 1>,
			<105 2 83 1>,
			<106 2 84 1>,
			<107 2 85 1>,
			<108 2 86 1>,
			<109 2 87 1>,
			<110 2 88 1>,
			<111 2 89 1>,
			<112 2 90 1>,
			<113 2 91 1>,
			<114 2 92 1>,
			<115 2 93 1>,
			<116 2 94 1>,
			<117 2 95 1>,
			<118 2 96 1>,
			<119 2 97 1>,
			<120 2 98 1>,
			<121 2 99 1>,
			<122 2 100 1>,
			<123 2 101 1>,
			<124 2 102 1>,
			<125 2 103 1>,
			<126 2 104 1>,
			<127 2 105 1>,
			<128 2 106 1>,
			<136 2 107 1>,
			<137 2 108 1>,
			<138 2 109 1>,
			<139 2 110 1>,
			<145 2 111 1>,
			<152 2 112 1>,
			<153 2 113 1>,
			<154 2 114 1>,
			<155 2 115 1>,
			<173 2 116 1>,
			<174 2 117 1>,
			<175 2 118 1>,
			<189 1 0 1>,
			<190 1 1 1>,
			<191 1 2 1>,
			<192 1 3 1>,
			<193 1 4 1>,
			<194 1 5 1>,
			<195 1 6 1>,
			<196 1 7 1>,
			<197 1 8 1>,
			<198 1 9 1>,
			<199 1 10 1>,
			<200 1 11 1>,
			<201 1 12 1>,
			<202 1 13 1>,
			<203 1 14 1>,
			<204 1 15 1>,
			<205 1 16 1>,
			<206 1 17 1>,
			<207 1 18 1>,
			<208 1 19 1>,
			<209 1 20 1>,
			<210 1 21 1>,
			<211 1 22 1>,
			<212 3 0 0>,
			<213 3 1 0>,
			<214 3 2 0>,
			<215 3 3 0>,
			<216 3 7 0>,
			<217 3 8 0>,
			<218 3 12 0>,
			<219 3 13 0>,
			<220 3 16 0>;
	};

	sleep: sleep@12001000 {
		compatible = "mediatek,sleep", "syscon";
		reg = <0 0x12001000 0 0x1000>;
	};

	spmtwam: spmtwam@12001000 {
		compatible = "mediatek,spmtwam";
		reg = <0 0x12001000 0 0x1000>;
		interrupts = <GIC_SPI 151 IRQ_TYPE_LEVEL_HIGH>;
		spm_twam_con = <0xa0>;
		spm_twam_window_len = <0xa4>;
		spm_twam_idle_sel = <0xa8>;
		spm_irq_mask = <0xb4>;
		spm_irq_sta = <0x128>;
		spm_twam_last_sta0 = <0x1d0>;
		spm_twam_last_sta1 = <0x1d4>;
		spm_twam_last_sta2 = <0x1d8>;
		spm_twam_last_sta3 = <0x1dc>;
	};

	srclken: srclken@10006500 {
		compatible = "mediatek,srclken";
		reg = <0 0x10006500 0 0x1000>,
			<0 0x105c4000 0 0x1000>,
			<0 0x10004000 0 0x1000>;
		reg-names = "srclken", "scpdvfs", "gpio";
		srclken-mode = "bringup";

		srclken-rst-cfg = <0x0>;
		srclken-central-cfg = <0x4 0x8 0x1C>;
		srclken-cmd-cfg = <0xC>;
		srclken-pmic-cfg = <0x10 0x14>;
		srclken-dcxo-fpm-cfg = <0x18>;
		srclken-subsys-cfg = <0x20>;
		srclken-misc-cfg = <0xB4>;
		srclken-spm-cfg = <0xB8>;
		srclken-subsys-if-cfg = <0xBC>;
		srclken-fsm-sta = <0x60>;
		srclken-cmd-sta = <0x64 0x68>;
		srclken-spi-sta = <0x6C>;
		srclken-pipo-sta = <0x70>;
		srclken-subsys-sta = <0x80>;
		srclken-dbg-trace-sta = <0xC0 0xC4>;

		srclken-scp-enable = "n";
		scp-vreq-cfg = <0x54>;
		scp-rc-vreq-bit = <27 28>;

		srclken-gpio-enable = "n";
		gpio-dir-cfg = <0x0>;
		gpio-dout-cfg = <0x100>;
		gpio-pull-bit = <6>;
	};

	watchdog: watchdog@12007000 {
		compatible = "mediatek,mt6880-wdt",
			     "mediatek,mt6589-wdt",
			     "syscon", "simple-mfd";
		reg = <0 0x12007000 0 0x1000>;
		reboot-mode {
			compatible = "syscon-reboot-mode";
			offset = <0x24>;
			mask = <0xF>;
			mode-charger = <BOOT_CHARGER>;
			mode-recovery = <BOOT_RECOVERY>;
			mode-bootloader = <BOOT_BOOTLOADER>;
			mode-dm-verity-dev-corrupt = <BOOT_DM_VERITY>;
			mode-kpoc = <BOOT_KPOC>;
			mode-ddr-reserve = <BOOT_DDR_RSVD>;
			mode-meta = <BOOT_META>;
			mode-download = <BOOT_DOWNLOAD>;
			mode-pcie = <BOOT_PCIE>;
		};
	};

	apxgpt@12008000 {
		compatible = "mediatek,apxgpt";
		reg = <0 0x12008000 0 0x1000>;
		interrupts = <GIC_SPI 136 IRQ_TYPE_LEVEL_HIGH>;
	};

	sej@1000a000 {
		compatible = "mediatek,sej";
		reg = <0 0x1000a000 0 0x1000>;
		interrupts = <GIC_SPI 170 IRQ_TYPE_LEVEL_HIGH>;
	};

	apmixed: apmixed@10010000 {
		compatible = "mediatek,apmixed";
		reg = <0 0x10010000 0 0xe00>;
	};

	fhctl@10010e00 {
		compatible = "mediatek,mt6990-fhctl";
		reg = <0 0x10010e00 0 0x200>;
		mediatek,apmixed = <&apmixed>;

		armpll_ll {
			mediatek,fh-id = <0>;
			mediatek,fh-pll-id = <CLK_APMIXED_ARMPLL_LL>;
			mediatek,fh-cpu-pll;
		};

		ccipll {
			mediatek,fh-id = <1>;
			mediatek,fh-pll-id = <CLK_APMIXED_CCIPLL>;
		};

		mainpll {
			mediatek,fh-id = <2>;
			mediatek,fh-pll-id = <CLK_APMIXED_MAINPLL>;
		};

		msdcpll {
			mediatek,fh-id = <3>;
			mediatek,fh-pll-id = < CLK_APMIXED_MSDCPLL>;
		};

		mfgpll {
			mediatek,fh-id = <4>;
			mediatek,fh-pll-id = <CLK_APMIXED_MFGPLL>;
		};

		mmpll {
			mediatek,fh-id = <5>;
			mediatek,fh-pll-id = <CLK_APMIXED_MMPLL>;
		};

		mpll {
			mediatek,fh-id = <6>;
			mediatek,fh-pll-id = <CLK_APMIXED_MPLL>;
		};

		net1pll {
			mediatek,fh-id = <8>;
			mediatek,fh-pll-id = <CLK_APMIXED_NET1PLL>;
		};

		net2pll {
			mediatek,fh-id = <9>;
			mediatek,fh-pll-id = <CLK_APMIXED_NET2PLL>;
		};

		wedmcupll {
			mediatek,fh-id = <10>;
			mediatek,fh-pll-id = <CLK_APMIXED_WEDMCUPLL>;
		};

		medmcupll {
			mediatek,fh-id = <11>;
			mediatek,fh-pll-id = <CLK_APMIXED_MEDMCUPLL>;
		};
	};

	pwrap@10005000 {
		compatible = "mediatek,pwrap";
		reg = <0 0x10005000 0 0x1000>;
	};

	keypad:kp@1200e000 {
		compatible = "mediatek,kp";
		reg = <0 0x1200e000 0 0x1000>;
		interrupts = <GIC_SPI 97 IRQ_TYPE_EDGE_RISING>;
		clocks = <&clk26m>;
		clock-names = "kpd";
	};

	gpio-keys {
		compatible = "gpio-keys";

#if 0 /*mtk default key config*/
		button0 {
			label = "Modem RF";
			gpios = <&pio 6 GPIO_ACTIVE_LOW>;
			linux,code = <KEY_PHONE>;
		};

		button1 {
			label = "GPS";
			gpios = <&pio 7 GPIO_ACTIVE_LOW>;
			linux,code = <246>;
		};
#else /*quectel key config*/
/*
		button2 {
			label = "Factory Mode";
			gpios = <&pio 112 GPIO_ACTIVE_LOW>;
			linux,code = <112>;
		};

		button3 {
			label = "WIFI";
			gpios = <&pio 114 GPIO_ACTIVE_LOW>;
			linux,code = <114>;
		};

		button4 {
			label = "WPS";
			gpios = <&pio 115 GPIO_ACTIVE_LOW>;
			linux,code = <115>;
		};
*/
		button0 {
			label = "RESTORE_KEY";
			gpios = <&pio 6 GPIO_ACTIVE_LOW>;
			// wakeup-source;
			linux,code = <6>;	//the same is gpio number
			linux,input-type = <EV_KEY>;	//set to EV_KEY type
		};

		button1 {
			label = "WPS_KEY";
			gpios = <&pio 1 GPIO_ACTIVE_LOW>;
			linux,code = <7>;
			linux,input-type = <EV_KEY>;	//set to EV_KEY type
			debounce-interval = <10>;
		};
#endif
	};

	topmisc@10011000 {
		compatible = "mediatek,topmisc";
		reg = <0 0x10011000 0 0x1000>;
	};

	dvfsrc: dvfsrc@1200F000 {

		compatible = "mediatek,mt6990-dvfsrc";
		reg = <0 0x1200F000 0 0x1000>,
			<0 0x12001000 0 0x1000>;
		reg-names = "dvfsrc", "spm";
		#interconnect-cells = <1>;

		dvfsrc_vcore: dvfsrc-vcore {
			regulator-name = "dvfsrc-vcore";
			regulator-min-microvolt = <575000>;
			regulator-max-microvolt = <750000>;
			regulator-always-on;
		};


		dvfsrc_freq_opp7: opp7 {
			opp-peak-KBps = <0 0>;
		};
		dvfsrc_freq_opp6: opp6 {
			opp-peak-KBps = <2500000 2500000>;
		};
		dvfsrc_freq_opp5: opp5 {
			opp-peak-KBps = <5100000 5100000>;
		};
		dvfsrc_freq_opp4: opp4 {
			opp-peak-KBps = <5900000 5900000>;
		};
		dvfsrc_freq_opp3: opp3 {
			opp-peak-KBps = <6800000 6800000>;
		};
		dvfsrc_freq_opp2: opp2 {
			opp-peak-KBps = <8500000 8500000>;
		};
		dvfsrc_freq_opp1: opp1 {
			opp-peak-KBps = <9900000 11900000>;
		};
		dvfsrc_freq_opp0: opp0 {
			opp-peak-KBps = <13600000 13600000>;
		};


		dvfsrc-helper {
			compatible = "mediatek,dvfsrc-helper";
			vcore-supply = <&mt6361_buck4_vcore_reg>;
			rc-vcore-supply = <&dvfsrc_vcore>;
			interconnects = <&dvfsrc MT6873_MASTER_DBGIF &dvfsrc MT6873_SLAVE_DDR_EMI>,
				<&dvfsrc MT6873_MASTER_DBGIF &dvfsrc MT6873_SLAVE_DDR_EMI>,
				<&dvfsrc MT6873_MASTER_HRT_DBGIF &dvfsrc MT6873_SLAVE_HRT_DDR_EMI>;
			interconnect-names = "icc-bw", "icc-perf-bw", "icc-hrt-bw";
			required-opps = <&dvfsrc_freq_opp0>,
					<&dvfsrc_freq_opp1>,
					<&dvfsrc_freq_opp2>,
					<&dvfsrc_freq_opp3>,
					<&dvfsrc_freq_opp4>,
					<&dvfsrc_freq_opp5>,
					<&dvfsrc_freq_opp6>,
					<&dvfsrc_freq_opp7>;
		};

		dvfsrc-met {
			rc-vcore-supply = <&dvfsrc_vcore>;
			interconnects = <&dvfsrc MT6873_MASTER_DBGIF &dvfsrc MT6873_SLAVE_DDR_EMI>,
				<&dvfsrc MT6873_MASTER_HRT_DBGIF &dvfsrc MT6873_SLAVE_HRT_DDR_EMI>;
			interconnect-names = "icc-bw", "icc-hrt-bw";
			compatible = "mediatek,dvfsrc-met";
		};

	};

	mbist_ao@10007000 {
		compatible = "mediatek,mbist_ao";
		reg = <0 0x10007000 0 0x1000>;
	};

	dpmaif_ao@10011000 {
		compatible = "mediatek,dpmaif_ao";
		reg = <0 0x10011000 0 0x1000>;
	};

	aes_top0@1200a000 {
		compatible = "mediatek,aes_top0";
		reg = <0 0x1200a000 0 0x1000>;
	};

	timer: timer {
		compatible = "arm,armv8-timer";
		interrupt-parent = <&gic>;
		interrupts = <GIC_PPI 13 IRQ_TYPE_LEVEL_HIGH>,
				<GIC_PPI 14 IRQ_TYPE_LEVEL_HIGH>,
				<GIC_PPI 11 IRQ_TYPE_LEVEL_HIGH>,
				<GIC_PPI 10 IRQ_TYPE_LEVEL_HIGH>;
		clock-frequency = <13000000>;
	};

	sys_timer@12011000 {
		compatible = "mediatek,sys_timer",
				"mediatek,mt6765-timer";
		reg = <0 0x12011000 0 0x1000>;
		interrupts = <GIC_SPI 128 IRQ_TYPE_LEVEL_HIGH>;
		clocks = <&clk13m>;
	};

	modem_temp_share@12012000 {
		compatible = "mediatek,modem_temp_share";
		reg = <0 0x12012000 0 0x1000>;
	};

	security_ao@1200b000 {
		compatible = "mediatek,security_ao";
		reg = <0 0x1200b000 0 0x1000>;
	};

	topckgen_ao@10008000 {
		compatible = "mediatek,topckgen_ao";
		reg = <0 0x10008000 0 0x1000>;
	};

	devapc_ao_mm@12014000 {
		compatible = "mediatek,devapc_ao_mm";
		reg = <0 0x12014000 0 0x1000>;
	};

	sleep_sram@1001e000 {
		compatible = "mediatek,sleep_sram";
		reg = <0 0x1001e000 0 0x4000>;
	};

	bcrm_ao_peri@10020000 {
		compatible = "mediatek,bcrm_ao_peri";
		reg = <0 0x10020000 0 0x1000>;
	};

	debug_ao_peri@10030000 {
		compatible = "mediatek,debug_ao_peri";
		reg = <0 0x10030000 0 0x1000>;
	};

	mhccif: mhccif@12020000 {
		compatible = "mediatek,mt6880-mhccif";
		#interrupt-cells = <3>;
		interrupt-controller;
		reg = <0 0x12020000 0 0x1000>,
		      <0 0x12021000 0 0x1000>;
		reg-names = "mhccif_rc", "mhccif_ep";
		interrupts = <GIC_SPI 174 IRQ_TYPE_LEVEL_HIGH>;
		status = "disabled";
	};

	spmi_bus: spmi@12804000 {
		compatible = "mediatek,mt6990-spmi";
		reg = <0 0x12804000 0 0x0008ff>,
		      <0 0x12806000 0 0x000120>;
		reg-names = "pmif", "spmimst";
		interrupts-extended = <&gic GIC_SPI 168 IRQ_TYPE_LEVEL_HIGH>,
				      <&pio 220 IRQ_TYPE_LEVEL_HIGH>;
		interrupt-names = "pmif_irq", "rcs_irq";
		interrupt-controller;
		#interrupt-cells = <1>;
		irq_event_en = <0x80000000 0x0 0x0 0x0 0x0>;
		clocks = <&vlp_cksys_clk CLK_VLP_CK_PWRAP_ULPOSC_SEL>,
			 <&vlp_cksys_clk CLK_VLP_CK_SPMI_M_MST_SEL>;
		clock-names = "vlp_pmif_clk_mux",
			      "vlp_spmimst_m_clk_mux";
		swinf_ch_start = <10>;
		ap_swinf_no = <2>;
		grpid = <0xB>;
		#address-cells = <2>;
		#size-cells = <0>;
	};

	/* ATF logger */
        atf_logger {
                compatible = "mediatek,atf_logger";
        };

	bcrm_peri_ao@1002a000 {
		compatible = "mediatek,bcrm_peri_ao";
		reg = <0 0x1002a000 0 0x1000>;
	};

	debug_ao_peri@1002b000 {
		compatible = "mediatek,debug_ao_peri";
		reg = <0 0x1002b000 0 0x1000>;
	};

	bcrm_peri_ao2@1002d000 {
		compatible = "mediatek,bcrm_peri_ao2";
		reg = <0 0x1002d000 0 0x1000>;
	};

	debug_ao_peri2@1002e000 {
		compatible = "mediatek,debug_ao_peri2";
		reg = <0 0x1002e000 0 0x1000>;
	};

	devapc_ao_infra@10030000 {
		compatible = "mediatek,devapc_ao_infra";
		reg = <0 0x10030000 0 0x4000>;
	};

	devapc_ao_peri@10034000 {
		compatible = "mediatek,devapc_ao_peri";
		reg = <0 0x10034000 0 0x4000>;
	};

	devapc_ao_peri2@10038000 {
		compatible = "mediatek,devapc_ao_peri2";
		reg = <0 0x10038000 0 0x4000>;
	};

	devapc_ao_peri_par@1003c000 {
		compatible = "mediatek,devapc_ao_peri_par";
		reg = <0 0x1003c000 0 0x4000>;
	};

	debug_ao_peri_par@10040000 {
		compatible = "mediatek,debug_ao_peri_par";
		reg = <0 0x10040000 0 0x1000>;
	};

	bcrm_peri_par_ao@10041000 {
		compatible = "mediatek,bcrm_peri_par_ao";
		reg = <0 0x10041000 0 0x1000>;
	};

	debug_ao_fmem@10042000 {
		compatible = "mediatek,debug_ao_fmem";
		reg = <0 0x10042000 0 0x1000>;
	};

	bcrm_fmem_ao@10043000 {
		compatible = "mediatek,bcrm_fmem_ao";
		reg = <0 0x10043000 0 0x1000>;
	};

	devapc_ao_fmem@10044000 {
		compatible = "mediatek,devapc_ao_fmem";
		reg = <0 0x10044000 0 0x4000>;
	};

	///PWM controller nodes
	pwm:pwm@12016000 {
		compatible = "mediatek,mt69xx-pwm";
		reg = <0 0x12016000 0 0x1000>;
		#pwm-cells = <2>;
		interrupts = <GIC_SPI 142 IRQ_TYPE_LEVEL_HIGH>;
		clocks = <&vlp_cksys_clk CLK_VLP_CK_PWM_VLP_SEL>,
			<&vlpcfg_clk CLK_VLPCFG_PWM_CK_CGEN_8>,
			<&vlpcfg_clk CLK_VLPCFG_PWM_CK_CGEN_1>,
			<&vlpcfg_clk CLK_VLPCFG_PWM_CK_CGEN_2>,
			<&vlpcfg_clk CLK_VLPCFG_PWM_CK_CGEN_3>,
			<&vlpcfg_clk CLK_VLPCFG_PWM_CK_CGEN_4>,
			<&vlpcfg_clk CLK_VLPCFG_PWM_CK_CGEN_5>,
			<&vlpcfg_clk CLK_VLPCFG_PWM_CK_CGEN_6>,
			<&vlpcfg_clk CLK_VLPCFG_PWM_CK_CGEN_7>;

		clock-names = "top",
			"main",
			"pwm1",
			"pwm2",
			"pwm3",
			"pwm4",
			"pwm5",
			"pwm6",
			"pwm7";
	};

	sys_cirq@10204000 {
		compatible = "mediatek,sys_cirq";
		reg = <0 0x10204000 0 0x1000>;
		interrupts = <GIC_SPI 501 IRQ_TYPE_LEVEL_HIGH>;
	};

	devapc@10207000 {
		compatible = "mediatek,mt69xx-devapc";
		interrupts = <GIC_SPI 222 IRQ_TYPE_LEVEL_HIGH>;
	};

	hwrng: hwrng {
		compatible = "mediatek,mt67xx-rng";
	};

	sys_tracker@10208000 {
		compatible = "mediatek,sys-tracker";
		reg = <0 10208000 0 0x1000>;

		interrupts = <GIC_SPI 175 IRQ_TYPE_LEVEL_HIGH>,
			<GIC_SPI 224 IRQ_TYPE_LEVEL_HIGH>,
			<GIC_SPI 287 IRQ_TYPE_LEVEL_HIGH>;

		interrupt-names = "tracker-irq",
			"infra-tracker-irq",
			"peri-tracker-irq";
	};

	ap_ccif0@10209000 {
		compatible = "mediatek,ap_ccif0";
		reg = <0 0x10209000 0 0x1000>;
		interrupts = <GIC_SPI 258 IRQ_TYPE_LEVEL_HIGH>;
	};

	md_ccif0@1020a000 {
		compatible = "mediatek,md_ccif0";
		reg = <0 0x1020a000 0 0x1000>;
	};

	ap_ccif1@1020b000 {
		compatible = "mediatek,ap_ccif1";
		reg = <0 0x1020b000 0 0x1000>;
		interrupts = <GIC_SPI 260 IRQ_TYPE_LEVEL_HIGH>;
	};

	md_ccif1@1020c000 {
		compatible = "mediatek,md_ccif1";
		reg = <0 0x1020c000 0 0x1000>;
	};

	infra_mbist@1020d000 {
		compatible = "mediatek,infra_mbist";
		reg = <0 0x1020d000 0 0x1000>;
	};

	infracfg@1020e000 {
		compatible = "mediatek,infracfg";
		reg = <0 0x1020e000 0 0x1000>;
	};

	trng@1020f000 {
		compatible = "mediatek,trng";
		reg = <0 0x1020f000 0 0x1000>;
		interrupts = <GIC_SPI 271 IRQ_TYPE_LEVEL_HIGH>;
	};

	dxcc_sec@10210000 {
		compatible = "mediatek,dxcc_sec";
		reg = <0 0x10210000 0 0x1000>;
	};

	cqdma-controller@10212000 {
		compatible = "mediatek,mt6990-cqdma";
		reg = <0 0x10212000 0 0x80>,
			<0 0x10212100 0 0x80>,
			<0 0x10212200 0 0x80>,
			<0 0x10212300 0 0x80>;
		interrupts = <GIC_SPI 211 IRQ_TYPE_LEVEL_HIGH>,
			<GIC_SPI 212 IRQ_TYPE_LEVEL_HIGH>,
			<GIC_SPI 213 IRQ_TYPE_LEVEL_HIGH>,
			<GIC_SPI 214 IRQ_TYPE_LEVEL_HIGH>;
		clocks = <&infracfg_ao_clk CLK_IFRAO_CQ_DMA>;
		clock-names = "cqdma";
		dma-channel-mask = <63>;
		dma-channels = <4>;
		dma-requests = <10>;
		#dma-cells = <1>;
	};

	md2md_md2_ccif0@10213000 {
		compatible = "mediatek,md2md_md2_ccif0";
		reg = <0 0x10213000 0 0x1000>;
	};

	sramrom@10214000 {
		compatible = "mediatek,sramrom";
		reg = <0 0x10214000 0 0x1000>;
	};

	bcrm_infra@10215000 {
		compatible = "mediatek,bcrm_infra";
		reg = <0 0x10215000 0 0x1000>;
	};

	dbg_tracker2@10218000 {
		compatible = "mediatek,dbg_tracker2";
		reg = <0 0x10218000 0 0x1000>;
	};

	emicen: emicen@10217000 {
		compatible = "mediatek,mt6980-emicen",
			     "mediatek,common-emicen";
		reg = <0 0x10217000 0 0x1000>;
		mediatek,emi-reg = <&emichn>;
		a2d_hash = <1>;
		a2d_disph = <2>;
	};

	infra_device_mpu@1021a000 {
		compatible = "mediatek,infra_device_mpu";
		reg = <0 0x1021a000 0 0x1000>;
	};

	infra_device_mpu@1021b000 {
		compatible = "mediatek,infra_device_mpu";
		reg = <0 0x1021b000 0 0x1000>;
	};

	infracfg_mem@1021c000 {
		compatible = "mediatek,infracfg_mem";
		reg = <0 0x1021c000 0 0x1000>;
	};

	emimpu:emimpu@1021a000 {
		compatible = "mediatek,mt6980-emimpu",
			     "mediatek,common-emimpu";
		reg = <0 0x1021a000 0 0x1000>;
		mediatek,emi-reg = <&emicen>;
		interrupts = <GIC_SPI 338 IRQ_TYPE_LEVEL_HIGH>;
		region_cnt = <32>;
		domain_cnt = <16>;
		addr_align = <16>;
		ap_region = <31>;
		ap_apc = <5 5 0 5 0 0 6 5>,
			 <0 0 5 5 5 5 5 5>;
		dump = <0x1f0 0x1f8 0x1fc>;
		clear = <0x160 0xffffffff 16>,
			<0x200 0x00000003 16>,
			<0x1f0 0x80000000 1>;
		clear_md = <0x1fc 0x80000000 1>;
		ctrl_intf = <1>;
		slverr = <0>;
	};

	cldma_sys_ap {
		compatible = "mediatek,cldma_sys_ap";
		reg = <0 0x1004A000 0 0x1000>, /*CLDMA0_AO_INDMA_AO_MD*/
			<0 0x1021E000 0 0x1000>; /*CLDMA0_AO_INDMA_PD_MD*/
		interrupts = <GIC_SPI 285 IRQ_TYPE_LEVEL_HIGH>; /*cldma0_md_int_ap*/
//  Need to update to MT6990 clock, modified by Pei-hsuan Cheng
/*		clocks = <&infracfg_ao_clk CLK_IFRAO_RG_133M_CLDMA_TOP>;*/
		clock-names = "infra-cldma0-rh";
		mediatek,hif_ids = <1>; /* (1 << HIF_ID_CLDMA) */
	};

	mrdump_ext_rst: mrdump_ext_rst {
		compatible = "mediatek, mrdump_ext_rst-eint";
		force_mode = "EINT";
		mode = "IRQ";
		status = "okay";
	};

	cpu_mcucfg: mcusys_ao_cfg@0c530000 {
		reg = <0 0x0c530000 0 0x10000>; /* 64KB */
	};

	bus_tracer@0d040000 {
		compatible = "mediatek,bus_tracer-v1";
		reg = <0 0x0d040000 0 0x100>, /* btm_top base */
			  <0 0x0d01a000 0 0x1000>, /* dbgao base */
			  <0 0x0d041000 0 0x3000>, /* funnel/rep/etr base */
			  <0 0x0d044000 0 0x1000>, /* bus tracer etf base */
			  <0 0x0d040800 0 0x100>, /* MCU_AP bus tracer base */
			  <0 0x0d040900 0 0x100>, /* infra bus tracer base */
			  <0 0x0d040a00 0 0x100>; /* peri bus tracer base */

		mediatek,err_flag = <0xfbf8ffff>;

		/*
		 * index 0 for ap bus tracer
		 * index 1 for infra bus tracer
		 * index 2 for peri bus tracer
		 */
		mediatek,num_tracer = <3>;
		mediatek,enabled_tracer = <1 1 1>;
		mediatek,at_id = <0x10 0x30 0x70>;

		/* filters: disabled by default */
		/*
		 * mediatek,watchpoint_filter = <0x0 0x10010000 0xfffff000>;
		 * mediatek,bypass_filter = <0x14000000 0xffff0000>;
		 * mediatek,id_filter = <0x10 0x40>;
		 * mediatek,rw_filter = <0x0 0x1>;
		 */
	};

	cpu_pll: mcusys_pll1u_top@01000c000 {
		reg = <0 0x10010000 0 0x1000>; /* 4KB */
	};

	cpuhvfs: cpuhvfs {
		compatible = "mediatek,cpufreq-hybrid";
		reg = <0 0x0011bc90 0 0xc00>,
			<0 0x0011bc00 0 0x1400>,
			<0 0x00121400 0 0x1800>;
		reg-names = "USRAM", "CSRAM", "ESRAM";
		cslog-range = <0x0578>, <0x0ed8>;
		tbl-off = <4>, <76>;
		/* pll mcucfg */
		mcucfg-ver = <0>;
		apmixedsys = <&cpu_pll>;
		clk-div-base = <&cpu_mcucfg>;
		pll-con = <0x2f4>, <0x330>;
		clk-div = <0xa2a0>, <0xa2e0>;
		/* regulator */
		proc1-supply = <&mt6319_6_vbuck3>; /* L */
		proc2-supply = <&mt6319_6_vbuck3>; /* DSU */
	};

	ccifdriver:ccifdriver@10209000 {
		compatible = "mediatek,ccci_ccif";
		reg = <0 0x10209000 0 0x1000>, /*AP_CCIF_BASE*/
			<0 0x1020a000 0 0x1000>; /*MD_CCIF_BASE*/
		mediatek,sram_size = <512>;
		/* CCIF0 184/216; CCIF1 185/217 */
		interrupts = <GIC_SPI 184 IRQ_TYPE_LEVEL_HIGH>,
				 <GIC_SPI 185 IRQ_TYPE_LEVEL_HIGH>;
		clocks = <&infracfg_ao_clk CLK_IFRAO_CCIF0>,
			<&infracfg_ao_clk CLK_IFRAO_CCIF1>;
		clock-names = "infra-ccif0",
			"infra-ccif1";
	};

	mddriver:mddriver {
		compatible = "mediatek,mddriver";
		/* bit0~3: CLDMA|CCIF|DPMAIF */
		mediatek,mdhif_type = <2>;
		mediatek,md_id = <0>;
		mediatek,ap_plat_info = <6990>;
		mediatek,md_generation = <6298>;
		/* DTSI apon_md is for colgin */
		/* mediatek,offset_apon_md1 = <0x2844>; */
		/* 0x44: epon offset; */
		/* 0x06: once a value[1] exist, means in l2sram */
		/* value[1] not exist means in mddbgsys. the value(6) has no meaningful */
		mediatek,offset_epon_md1 = <0x44 0x06>;
		mediatek,cldma_capability = <2>;
		/* bit0:srcclkena|bit1:srclken_o1_on|bit2:revert_sequencer| */
		/* bit3:pll_setting|bit4:skip_topclk */
		mediatek,power_flow_config = <0x04>;
		/* srclken_o1 set value |= 1<<21 */
		mediatek,srclken_o1 = <0>;
		/* WDT pattern in l2sram */
		reg = <0 0x0d124000 0 0x2000>; /* l2sram base address */
		/* MDWDT 333/365 */
		interrupts = <GIC_SPI 333 IRQ_TYPE_LEVEL_HIGH>;
		/* md_vmodem-supply = <&mt6315_3_vbuck1>; move mt6873.dts */
		/* md_vsram-supply = <&mt6315_3_vbuck4>; move mt6873.dts */
		/* md_vnr-supply = <&mt6315_3_vbuck3>; move mt6873.dts */
		/* md_vdigrf-supply = <&mt6359p_vpu_reg>; move mt6873.dts */
		power-domains = <&scpsys MT6990_POWER_DOMAIN_MD>;
		ccci-infracfg = <&infracfg_ao_clk>;
	};

/*	md_auxadc:md_auxadc {
		compatible = "mediatek,md_auxadc";
		io-channels = <&auxadc 2>;
		io-channel-names = "md-channel",
			"md-battery";
	};

	md_ccci_rtc:md_ccci_rtc {
		compatible = "mediatek,md_ccci_rtc";
		nvmem-cells = <&ext_32k>;
		nvmem-cell-names = "external-32k";
	}; */

	gce_mbox: gce_mbox@10228000 {
		compatible = "mediatek,mailbox-gce";
		reg = <0 0x10228000 0 0x4000>;
		interrupts = <GIC_SPI 202 IRQ_TYPE_LEVEL_HIGH>;

		#mbox-cells = <3>;
		#gce-event-cells = <1>;
		#gce-subsys-cells = <2>;
		default_tokens = /bits/ 16 <CMDQ_SYNC_TOKEN_GPR_SET_0>,
			/bits/ 16 <CMDQ_SYNC_TOKEN_GPR_SET_1>,
			/bits/ 16 <CMDQ_SYNC_TOKEN_GPR_SET_2>,
			/bits/ 16 <CMDQ_SYNC_TOKEN_GPR_SET_3>,
			/bits/ 16 <CMDQ_SYNC_TOKEN_GPR_SET_4>,
			/bits/ 16 <CMDQ_SYNC_RESOURCE_WROT0>,
			/bits/ 16 <CMDQ_SYNC_RESOURCE_WROT1>;
		clocks = <&infracfg_ao_clk CLK_IFRAO_GCE_AXI>,
			 <&infracfg_ao_clk CLK_IFRAO_GCE>;
		clock-names = "gce", "gce-timer";
	};

	infra_dpmaif@1022c000 {
		compatible = "mediatek,infra_dpmaif";
		reg = <0 0x1022c000 0 0x10>;
	};

	dramc: dramc@10230000 {
		compatible = "mediatek,mt6990-dramc",
			"mediatek,common-dramc";
		reg = <0 0x10230000 0 0x2000>, /* DRAMC AO CHA */
			<0 0x10240000 0 0x2000>, /* DRAMC AO CHB */
			<0 0x10234000 0 0x1000>, /* DRAMC NAO CHA */
			<0 0x10244000 0 0x1000>, /* DRAMC NAO CHB */
			<0 0x10238000 0 0x2000>, /* DDRPHY AO CHA */
			<0 0x10248000 0 0x2000>, /* DDRPHY AO CHB */
			<0 0x10236000 0 0x2000>, /* DDRPHY NAO CHA */
			<0 0x10246000 0 0x2000>, /* DDRPHY NAO CHB */
			<0 0x10006000 0 0x1000>; /* SLEEP BASE */
		mr4_version = <1>;
		mr4_rg = <0x0090 0x0000ffff 0>;
		fmeter_version = <2>;
		crystal_freq = <26>;
		pll_id = <0x0CB4 0x00000100 8>;
		shu_lv = <0x0CB4 0x00030000 16>;
		shu_of = <0x700>;
		sdmpcw = <0x0908 0x0007FFF8 3>,
			<0x0928 0x0007FFF8 3>;
		prediv = <0x090C 0x0000c000 14>,
			<0x092C 0x0000c000 14>;
		posdiv = <0x090C 0x0003800 11>,
			<0x092C 0x0003800 11>;
		ckdiv4 = <0x0874 0x00000004 2>,
			<0x0874 0x00000004 2>;
		pll_md = <0x0744 0x00000100 8>,
			<0x0744 0x00000100 8>;
		cldiv2 = <0x08b4 0x00000002 1>,
			<0x08b4 0x00000002 1>;
		fbksel = <0x0910 0x00000020 5>,
			<0x0910 0x00000020 5>;
		dqopen = <0x0D94 0x2000000 25>,
			<0x0D94 0x2000000 25>;
		ckdiv4_b0 = <0x13EC 0x00000004 2>,
			<0x13EC 0x00000004 2>;
		ckdiv4_ca = <0x136C 0x00000004 2>,
			<0x136C 0x00000004 2>;
	};

	emichn: emichn@10235000 {
		compatible = "mediatek,mt6980-emichn",
			     "mediatek,common-emichn";
		reg = <0 0x10235000 0 0x1000>,
		      <0 0x10245000 0 0x1000>;
	};

	emi-fake-eng@10219000 {
		compatible = "mediatek,emi-fake-engine";
		reg = <0 0x10219000 0 0x100>,
		      <0 0x10219800 0 0x100>;
	};

	emiisu {
		compatible = "mediatek,mt6980-emiisu",
			     "mediatek,common-emiisu";
		ctrl_intf = <1>;
	};

dpmaif:dpmaif@0x10011000 {
		compatible = "mediatek,dpmaif";
		reg = <0 0x10011000 0 0x1000>, /*AO_UL*/
			<0 0x1022D000 0 0x1000>, /*PD_UL*/
			<0 0x1022C000 0 0x1000>, /*PD_MD_MISC*/
			<0 0x1022E000 0 0x1000>, /*SRAM*/
			<0 0x15B14000 0 0x1000>, /*MED_BMP_CFG*/
			<0 0x15B38000 0 0x1000>, /*MED_SSR1_CFG*/
			<0 0x15B13000 0 0x1000>; /*MED_INT_MNG*/
		interrupts = <GIC_SPI 209 IRQ_TYPE_LEVEL_HIGH>, /*209+32=241*/
                <GIC_SPI 456 IRQ_TYPE_LEVEL_HIGH>;
		mediatek,dpmaif_capability = <6>;
		clocks = <&infracfg_ao_clk CLK_IFRAO_DPMAIF>,
			<&infracfg_ao_clk CLK_IFRAO_RG_MMW_DPMAIF26M_CK>;
		clock-names = "infra-dpmaif-clk",
			"infra-dpmaif-rg-mmw-clk";
	};


	medmcu: medmcu@15f00000 {
		compatible = "mediatek,medmcu";
		status = "okay";
		reg = <0 0x15d00000 0 0x20000>,  /* tcm */
			<0 0x15f24000 0 0x1000>,     /* cfg */
			<0 0x15f21000 0 0x1000>,     /* clk*/
			<0 0x15f30000 0 0x1000>,     /* cfg core0 */
			<0 0x15f40000 0 0x1000>,     /* cfg core1 */
			<0 0x15f52000 0 0x1000>,     /* bus tracker */
			<0 0x15f60000 0 0x40000>,    /* llc */
			<0 0x15fa5000 0 0x4>,        /* cfg_sec */
			<0 0x15ffb000 0 0x100>,      /* mbox0 base */
			<0 0x15ffb100 0 0x4>,        /* mbox0 set */
			<0 0x15ffb10c 0 0x4>,        /* mbox0 clr */
			<0 0x15fa5020 0 0x4>,        /* mbox0 init */
			<0 0x15ffc000 0 0x100>,      /* mbox1 base */
			<0 0x15ffc100 0 0x4>,        /* mbox1 set */
			<0 0x15ffc10c 0 0x4>,        /* mbox1 clr */
			<0 0x15fa5024 0 0x4>,        /* mbox1 init */
			<0 0x15ffd000 0 0x100>,      /* mbox2 base */
			<0 0x15ffd100 0 0x4>,        /* mbox2 set */
			<0 0x15ffd10c 0 0x4>,        /* mbox2 clr */
			<0 0x15fa5028 0 0x4>,        /* mbox2 init */
			<0 0x15ffe000 0 0x100>,      /* mbox3 base */
			<0 0x15ffe100 0 0x4>,        /* mbox3 set */
			<0 0x15ffe10c 0 0x4>,        /* mbox3 clr */
			<0 0x15fa502c 0 0x4>,        /* mbox3 init */
			<0 0x15fff000 0 0x100>,      /* mbox4 base */
			<0 0x15fff100 0 0x4>,        /* mbox4 set */
			<0 0x15fff10c 0 0x4>,        /* mbox4 clr */
			<0 0x15fa5030 0 0x4>,        /* mbox4 init */
			<0 0x15b80000 0 0x100>;      /* medsys infra top cfg */

		reg-names = "scp_sram_base",
			"scp_cfgreg",
			"scp_clkreg",
			"scp_cfgreg_core0",
			"scp_cfgreg_core1",
			"scp_bus_tracker",
			"scp_l1creg",
			"scp_cfgreg_sec",
			"mbox0_base",
			"mbox0_set",
			"mbox0_clr",
			"mbox0_init",
			"mbox1_base",
			"mbox1_set",
			"mbox1_clr",
			"mbox1_init",
			"mbox2_base",
			"mbox2_set",
			"mbox2_clr",
			"mbox2_init",
			"mbox3_base",
			"mbox3_set",
			"mbox3_clr",
			"mbox3_init",
			"mbox4_base",
			"mbox4_set",
			"mbox4_clr",
			"mbox4_init";

		interrupts = <GIC_SPI 463 IRQ_TYPE_LEVEL_HIGH>,
			<GIC_SPI 464 IRQ_TYPE_LEVEL_HIGH>,
			<GIC_SPI 465 IRQ_TYPE_LEVEL_HIGH>,
			<GIC_SPI 466 IRQ_TYPE_LEVEL_HIGH>,
			<GIC_SPI 467 IRQ_TYPE_LEVEL_HIGH>;


		interrupt-names = "mbox0",
			"mbox1",
			"mbox2",
			"mbox3",
			"mbox4";

		core_0 = "enable";
		scp_sramSize = <0x00020000>;
		mbox_count = <5>;
		/* id, mbox, send_size */
		send_table =
		<0 0 7>,     /* IPI_OUT_AUDIO_VOW_1 */
		<3 1 2>,     /* IPI_OUT_APCCCI_0 */
		<4 1 1>,     /* IPI_OUT_DVFS_SET_FREQ_0 */
		<5 1 1>,     /* IPI_OUT_C_SLEEP_0 */
		<6 1 1>,     /* IPI_OUT_TEST_0 */
		<11 2 18>,   /* IPI_OUT_MED_TABLE_ADDR */
		<13 2 1>,    /* IPI_OUT_MED_STOP */
		<15 3 1>,    /* IPI_OUT_QUERY_MED_SUSPEND */
		<16 3 1>,    /* IPI_OUT_DVFS_SET_FREQ_1 */
		<17 3 1>,    /* IPI_OUT_C_SLEEP_1 */
		<18 3 1>,    /* IPI_OUT_TEST_1 */
		<19 3 1>,    /* IPI_OUT_MED_UNMASK_IRQ */
		<20 3 1>,    /* IPI_OUT_LOGGER_ENABLE_1 */
		<21 3 1>,    /* IPI_OUT_LOGGER_WAKEUP_1 */
		<22 3 2>,    /* IPI_OUT_LOGGER_INIT_1 */
		<23 3 2>,    /* IPI_OUT_SCPCTL_1 */
		<24 3 2>,    /* IPI_OUT_SCP_LOG_FILTER_1 */
		<31 4 34>;   /* IPI_OUT_SCP_MPOOL_1 */
		/* id, mbox, recv_size, recv_opt */
		recv_table =
		<1 0 2 0>,   /* IPI_IN_AUDIO_VOW_ACK_1 */
		<2 0 20 0>,  /* IPI_IN_AUDIO_VOW_1 */
		<7 1 2 0>,   /* IPI_IN_APCCCI_0 */
		<8 1 10 0>,  /* IPI_IN_SCP_ERROR_INFO_0 */
		<9 1 1 0>,   /* IPI_IN_SCP_READY_0 */
		<10 1 2 0>,  /* IPI_IN_SCP_RAM_DUMP_0 */
		<5 1 1 1>,   /* IPI_OUT_C_SLEEP_0 */
		<12 2 2 0>,  /* IPI_IN_MED_CCCI */
		<14 2 2 0>,  /* IPI_IN_MED_STOP_ACK */
		<25 3 2 0>,  /* IPI_IN_MED_SUSPEND_RESPONSE */
		<26 3 10 0>, /* IPI_IN_SCP_ERROR_INFO_1 */
		<27 3 1 0>,  /* IPI_IN_LOGGER_WAKEUP_1 */
		<28 3 5 0>,  /* IPI_IN_LOGGER_INIT_1 */
		<29 3 1 0>,  /* IPI_IN_SCP_READY_1 */
		<30 3 2 0>,  /* IPI_IN_SCP_RAM_DUMP_1 */
		<17 3 1 1>,  /* IPI_OUT_C_SLEEP_1 */
		<32 4 30 0>; /* IPI_IN_SCP_MPOOL_1 */

		power-domains = <&scpsys MT6990_POWER_DOMAIN_MED>;
		clocks = <&topckgen_clk CLK_TOP_NETSYS_MED_MCU_SEL>;
		clock-names = "medmcu_sel";
	};

	dramc_ch0_top0@10230000 {
		compatible = "mediatek,dramc_ch0_top0";
		reg = <0 0x10230000 0 0x2000>;
	};

	dramc_ch0_top1@10232000 {
		compatible = "mediatek,dramc_ch0_top1";
		reg = <0 0x10232000 0 0x2000>;
	};

	dramc_ch0_top2@10234000 {
		compatible = "mediatek,dramc_ch0_top2";
		reg = <0 0x10234000 0 0x1000>;
	};

	dramc_ch0_top3@10235000 {
		compatible = "mediatek,dramc_ch0_top3";
		reg = <0 0x10235000 0 0x1000>;
	};

	dramc_ch0_top4@10236000 {
		compatible = "mediatek,dramc_ch0_top4";
		reg = <0 0x10236000 0 0x2000>;
	};

	dramc_ch0_top5@10238000 {
		compatible = "mediatek,dramc_ch0_top5";
		reg = <0 0x10238000 0 0x2000>;
	};

	dramc_ch0_top6@1023a000 {
		compatible = "mediatek,dramc_ch0_top6";
		reg = <0 0x1023a000 0 0x2000>;
	};

	ap_ccif2@1023c000 {
		compatible = "mediatek,ap_ccif2";
		reg = <0 0x1023c000 0 0x1000>;
		interrupts = <GIC_SPI 262 IRQ_TYPE_LEVEL_HIGH>;
	};

	md_ccif2@1023d000 {
		compatible = "mediatek,md_ccif2";
		reg = <0 0x1023d000 0 0x1000>;
	};

	ap_ccif3@1023e000 {
		compatible = "mediatek,ap_ccif3";
		reg = <0 0x1023e000 0 0x1000>;
		interrupts = <GIC_SPI 263 IRQ_TYPE_LEVEL_HIGH>;
	};

	md_ccif3@1023f000 {
		compatible = "mediatek,md_ccif3";
		reg = <0 0x1023f000 0 0x1000>;
	};

	stmmac_axi_setup: stmmac-axi-config {
		snps,wr_osr_lmt = <0x7>;
		snps,rd_osr_lmt = <0x7>;
		snps,blen = <0 0 0 0 16 8 4>;
	};

	mtl_rx_setup: rx-queues-config {
		snps,rx-queues-to-use = <1>;
		snps,rx-sched-sp;
		queue0 {
			snps,dcb-algorithm;
			snps,map-to-dma-channel = <0x0>;
			snps,priority = <0x0>;
		};
		queue1 {
			snps,dcb-algorithm;
			snps,map-to-dma-channel = <0x1>;
			snps,priority = <0x0>;
			snps,route-ptp;
		};
		queue2 {
			snps,dcb-algorithm;
			snps,map-to-dma-channel = <0x2>;
			snps,priority = <0x0>;
			snps,route-multi-broad;
		};
	};

	mtl_tx_setup: tx-queues-config {
		snps,tx-queues-to-use = <3>;
		snps,tx-sched-wrr;
		queue0 {
			snps,weight = <0x10>;
			snps,dcb-algorithm;
			snps,priority = <0x0>;
		};

		queue1 {
			snps,weight = <0x11>;
			snps,dcb-algorithm;
			snps,priority = <0x1>;
		};

		queue2 {
			snps,weight = <0x12>;
			snps,dcb-algorithm;
			snps,priority = <0x2>;
		};
	};

	i2c0: i2c@11d40000 {
		compatible = "mediatek,mt6990-i2c";
		reg = <0 0x11d40000 0 0x1000>,
			<0 0x11300080 0 0x80>;
		interrupts = <GIC_SPI 368 IRQ_TYPE_LEVEL_HIGH 0>;
		clocks = <&imp_iic_top_wrap_clk CLK_IMP_IIC_TOP_WRAP_I2C0>,
			<&pericfg_ao_clk CLK_PERAO_AP_DMA_HCLK>;
		clock-names = "main", "dma";
		clock-div = <1>;
	};

	i2c1: i2c@11d41000 {
		compatible = "mediatek,mt6990-i2c";
		reg = <0 0x11d41000 0 0x1000>,
			<0 0x11300100 0 0x80>;
		interrupts = <GIC_SPI 369 IRQ_TYPE_LEVEL_HIGH 0>;
		clocks = <&imp_iic_top_wrap_clk CLK_IMP_IIC_TOP_WRAP_I2C1>,
			<&pericfg_ao_clk CLK_PERAO_AP_DMA_HCLK>;
		clock-names = "main", "dma";
		clock-div = <1>;
	};

	i2c2: i2c@11ed0000 {
		compatible = "mediatek,mt6990-i2c";
		reg = <0 0x11ed0000 0 0x1000>,
			<0 0x11300180 0 0x80>;
		interrupts = <GIC_SPI 370 IRQ_TYPE_LEVEL_HIGH 0>;
		clocks = <&imp_iic_top_wrap_clk CLK_IMP_IIC_TOP_WRAP_I2C2>,
			<&pericfg_ao_clk CLK_PERAO_AP_DMA_HCLK>;
		clock-names = "main", "dma";
		clock-div = <1>;
	};

	i2c3: i2c@11ed1000 {
		compatible = "mediatek,mt6990-i2c";
		reg = <0 0x11ed1000 0 0x1000>,
			<0 0x11300200 0 0x80>;
		interrupts = <GIC_SPI 371 IRQ_TYPE_LEVEL_HIGH 0>;
		clocks = <&imp_iic_top_wrap_clk CLK_IMP_IIC_TOP_WRAP_I2C3>,
			<&pericfg_ao_clk CLK_PERAO_AP_DMA_HCLK>;
		clock-names = "main", "dma";
		clock-div = <1>;
	};

	i2c4: i2c@11d42000 {
		compatible = "mediatek,mt6990-i2c";
		reg = <0 0x11d42000 0 0x1000>,
			<0 0x11300280 0 0x80>;
		interrupts = <GIC_SPI 372 IRQ_TYPE_LEVEL_HIGH 0>;
		clocks = <&imp_iic_top_wrap_clk CLK_IMP_IIC_TOP_WRAP_I2C4>,
			<&pericfg_ao_clk CLK_PERAO_AP_DMA_HCLK>;
		clock-names = "main", "dma";
		clock-div = <1>;
	};

	i2c5: i2c@11d43000 {
		compatible = "mediatek,mt6990-i2c",
					"mediatek,mt6873-i2c";
		reg = <0 0x11d43000 0 0x1000>,
			<0 0x11300300 0 0x80>;
		interrupts = <GIC_SPI 373 IRQ_TYPE_LEVEL_HIGH 0>;
		clocks = <&imp_iic_top_wrap_clk CLK_IMP_IIC_TOP_WRAP_I2C5>,
			<&pericfg_ao_clk CLK_PERAO_AP_DMA_HCLK>;
		clock-names = "main", "dma";
		clock-div = <1>;
	};

	ssusb: usb@11201000 {
		compatible = "mediatek,mtu3";
		reg = <0 0x11201000 0 0x2e00>,
			<0 0x11203e00 0 0x0100>,
			<0 0x12001000 0 0x1000>,
			<0 0x11036000 0 0x1000>;
		reg-names = "mac", "ippc", "spm", "pericfg";
		vusb33-supply = <&mt6361_ldo27_vusb_reg>;
		interrupts = <GIC_SPI 274 IRQ_TYPE_LEVEL_HIGH>;
		phy-cells = <1>;
		phys = <&u2port0 PHY_TYPE_USB2>,
			 <&u3port0 PHY_TYPE_USB3>;
		clocks = <&pericfg_ao_clk CLK_PERAO_USB_SYS>,
			 <&pericfg_ao_clk CLK_PERAO_USB_XCHI>;
		clock-names = "sys_ck","ref_ck";
		#address-cells = <2>;
		#size-cells = <2>;
		ranges;
		dr_mode = "otg";
		maximum-speed = "super-speed-plus";
		mediatek,force-vbus;
		mediatek,clk-mgr;
		mediatek,usb3-drd;
		mediatek,gen1-txdeemph;
		usb-role-switch;
		/*plat_type = <1>; *//* 0: FPGA 1: ASIC */
		power-domains = <&scpsys MT6990_POWER_DOMAIN_SSUSB_TOP>;

		usb_host: xhci0@11200000 {
			compatible = "mediatek,mtk-xhci";
			reg = <0 0x11200000 0 0x1000>;
			reg-names = "mac";
			interrupts = <GIC_SPI 275 IRQ_TYPE_LEVEL_HIGH>;
			clocks = <&clk26m>;
			clock-names = "sys_ck";
		};
	};

	u3fpgaphy: usb-phy {
		compatible = "mediatek,fpga-u3phy";
		mediatek,ippc = <0x11203e00>;
		#address-cells = <2>;
		#size-cells = <2>;
		fpga_i2c_physical_base = <0x11ed0000>;
		status = "disabled";

		u3fpgaport0: usb-phy@0 {
			chip-id= <0xa60931a>;
			port = <0>;
			pclk_phase = <23>;
			#phy-cells = <1>;
		};
	};

	u3phy: usb-phy0@11ec0000 {
		compatible = "mediatek,xsphy";
		reg = <0 0x11ec3000 0 0x200>;
		#address-cells = <2>;
		#size-cells = <2>;
		ranges;

		u2port0: usb2-phy0@11ec0000 {
			reg = <0 0x11ec0000 0 0x400>;
			clocks = <&clk26m>;
			clock-names = "ref";
			#phy-cells = <1>;
			/*usb2jtag = <&vlpcfg_bus_clk 2>;
			nvmem-cells = <&u2_phy_data>, <&u2_phy_data>;
			nvmem-cell-names = "intr_cal", "term_cal";
			nvmem-cell-masks = <0x3f 0xf00>;*/
			mediatek,efuse-u2-intr-cal = <0x23>;
			mediatek,efuse-u2-term-cal = <0x8>;
			mediatek,eye-vrt = <2>;
			mediatek,eye-vrt-host = <2>;
			mediatek,discth= <0x9>;
			mediatek,rev6= <0x1>;
			mediatek,sqth= <0x5>;
			nvmem-cells = <&u2_efuse_segment>;
			nvmem-cell-names = "u2_efuse_data";
		};

		u3port0: usb3-phy0@11ec3000 {
			reg = <0 0x11ec3400 0 0x500>;
			clocks = <&clk26m>;
			clock-names = "ref";
			#phy-cells = <1>;
			nvmem-cells = <&u3_efuse_segment>;
			nvmem-cell-names = "u3_efuse_data";
		};
	};

	apdma: dma-controller@11300000 {
		compatible = "mediatek, mt6873-uart-dma",
					 "mediatek,mt6577-uart-dma";
		reg = <0 0x11300400 0 0x80>,
			  <0 0x11300480 0 0x80>,
			  <0 0x11300500 0 0x80>,
			  <0 0x11300580 0 0x80>,
			  <0 0x11300600 0 0x80>,
			  <0 0x11300680 0 0x80>;
		interrupts = <GIC_SPI 244 IRQ_TYPE_LEVEL_HIGH>,
			  <GIC_SPI 245 IRQ_TYPE_LEVEL_HIGH>,
			  <GIC_SPI 246 IRQ_TYPE_LEVEL_HIGH>,
			  <GIC_SPI 247 IRQ_TYPE_LEVEL_HIGH>,
			  <GIC_SPI 248 IRQ_TYPE_LEVEL_HIGH>,
			  <GIC_SPI 249 IRQ_TYPE_LEVEL_HIGH>;
		dma-requests = <6>;
		dma-bits = <34>;
		clocks = <&clk26m>;
		#dma-cells = <1>;
	};

	auxadc: auxadc@11001000 {
		compatible = "mediatek,mt6765-auxadc";
		reg = <0 0x11001000 0 0x1000>;
		interrupts = <GIC_SPI 64 IRQ_TYPE_EDGE_RISING>;
//  Need to update to MT6990 clock, modified by Pei-hsuan Cheng
/*		clocks = <&infracfg_ao_clk CLK_IFRAO_AUXADC>;*/
		clock-names = "main";
		#io-channel-cells = <1>;
		/* Auxadc efuse calibration */
		/* 1. Auxadc cali on/off bit shift */
		mediatek,cali-en-bit = <20>;
		/* 2. Auxadc cali ge bits shift */
		mediatek,cali-ge-bit = <10>;
		/* 3. Auxadc cali oe bits shift */
		mediatek,cali-oe-bit = <0>;
		/* 4. Auxadc cali efuse reg offset */
		mediatek,cali-efuse-reg-offset = <0xf8>;
		nvmem = <&efuse>;
		nvmem-names = "mtk_efuse";
		#interconnect-cells = <1>;
	};

	uart0: serial@11002000 {
		compatible = "mediatek,mt6873-uart",
					 "mediatek,mt6577-uart";
		reg = <0 0x11002000 0 0x1000>;
		interrupts = <GIC_SPI 232 IRQ_TYPE_LEVEL_HIGH>;
		clocks = <&clk26m>, <&pericfg_ao_clk CLK_PERAO_UART0>;
		clock-names = "baud", "bus";
		dmas = <&apdma 0
				&apdma 1>;
		dma-names = "tx", "rx";
	};

	uart1: serial@11003000 {
		compatible = "mediatek,mt6873-uart",
					 "mediatek,mt6577-uart";
		reg = <0 0x11003000 0 0x1000>,
		      <0 0x11036b90 0 0x20>;
		interrupts = <GIC_SPI 233 IRQ_TYPE_LEVEL_HIGH>;
		clocks = <&clk26m>, <&pericfg_ao_clk CLK_PERAO_UART1>;
		clock-names = "baud", "bus";
		dmas = <&apdma 2
				&apdma 3>;
		dma-names = "tx", "rx";
	};

	uart2: serial@11004000 {
		compatible = "mediatek,mt6873-uart",
					 "mediatek,mt6577-uart";
		reg = <0 0x11004000 0 0x1000>;
		interrupts = <GIC_SPI 234 IRQ_TYPE_LEVEL_HIGH>;
		clocks = <&clk26m>, <&pericfg_ao_clk CLK_PERAO_UART2>;
		clock-names = "baud", "bus";
		dmas = <&apdma 4
				&apdma 5>;
		dma-names = "tx", "rx";
	};

	nandc: nfi@11006000 {
		compatible = "mediatek,mt6880-nfc";
		reg = <0 0x11006000 0 0x1000>,
		      <0 0x11007000 0 0x1000>;
		interrupts = <GIC_SPI 258 IRQ_TYPE_LEVEL_HIGH>,
			     <GIC_SPI 259 IRQ_TYPE_LEVEL_HIGH>;
		status = "disabled";
		clocks =<&topckgen_clk CLK_TOP_TCK_26M_MX9>,
				<&topckgen_clk CLK_TOP_UNIVPLL_D5_D4>,
				<&topckgen_clk CLK_TOP_MAINPLL_D7_D4>,
				<&topckgen_clk CLK_TOP_MAINPLL_D6_D4>,
				<&topckgen_clk CLK_TOP_UNIVPLL_D6_D4>,
				<&topckgen_clk CLK_TOP_MAINPLL_D4_D4>,
				<&topckgen_clk CLK_TOP_UNIVPLL_D4_D4>,
				<&topckgen_clk CLK_TOP_MAINPLL_D6_D2>,
				<&topckgen_clk CLK_TOP_NFI1X_SEL>,
				<&pericfg_ao_clk CLK_PERAO_NFI_HCLK>,
				<&pericfg_ao_clk CLK_PERAO_NFI_BCLK>,
				/* The following clocks are snfi clocks */
				<&topckgen_clk CLK_TOP_TCK_26M_MX9>,
				<&topckgen_clk CLK_TOP_UNIVPLL_D6_D8>,
				<&topckgen_clk CLK_TOP_UNIVPLL_D5_D8>,
				<&topckgen_clk CLK_TOP_MAINPLL_D4_D8>,
				<&topckgen_clk CLK_TOP_UNIVPLL_D4_D8>,
				<&topckgen_clk CLK_TOP_MAINPLL_D6_D4>,
				<&topckgen_clk CLK_TOP_UNIVPLL_D6_D4>,
				<&topckgen_clk CLK_TOP_UNIVPLL_D5_D4>,
				<&topckgen_clk CLK_TOP_SPINFI_BCLK_SEL>,
				<&pericfg_ao_clk CLK_PERAO_NFI_CFCLK>;
		clock-names = "nfi_parent_26m",
				"nfi_parent124.8m",
				"nfi_parent78m",
				"nfi_parent91m",
				"nfi_parent104m",
				"nfi_parent136.5m",
				"nfi_parent156m",
				"nfi_parent182m",
				"nfi_clk_sel",
				"dma_cg",
				"nfi_cg",
				/* The following clock names are snfi clock names */
				"snfi_parent_26m",
				"snfi_parent52m",
				"snfi_parent62.4m",
				"snfi_parent68.25",
				"snfi_parent78m",
				"snfi_parent91m",
				"snfi_parent104m",
				"snfi_parent124.8m",
				"snfi_clk_sel",
				"snfi_cg";
		nand-trap {
			trap-base = <0x100046F0>;
			trap-mask = <0x001C0000>;
			trap-list = <0x00000000 0x000C0000>;
			trap-name-list = "pnand", "snand";
		};
	};

    mmc0: mmc@11230000 {
        compatible = "mediatek,mt6990-mmc";
        reg = <0 0x11230000 0 0x1000>,
            <0 0x11f00000 0 0x1000>;
        interrupts = <GIC_SPI 260 IRQ_TYPE_LEVEL_HIGH>;
        clocks = <&pericfg_ao_clk CLK_PERAO_MSDC50_SCAN>,
                <&pericfg_ao_clk CLK_PERAO_MSDC50_HCLK>,
                <&pericfg_ao_clk CLK_PERAO_MSDC0_AXI_MASTER>,
                <&pericfg_ao_clk CLK_PERAO_MSDC0_AHB_SLAVE>;
        clock-names = "source", "hclk", "axi_clk", "ahb_clk";
        power-domains = <&scpsys MT6990_POWER_DOMAIN_MSDC>;

        status = "disabled";
    };

    mmc1: mmc@11240000 {
        compatible = "mediatek,mt6990-mmc";
        reg = <0 0x11240000 0 0x1000>,
            <0 0x11d60000 0 0x1000>;
        interrupts = <GIC_SPI 261 IRQ_TYPE_LEVEL_HIGH>;

        clocks = <&pericfg_ao_clk CLK_PERAO_MSDC1_SRC>,
                <&pericfg_ao_clk CLK_PERAO_MSDC1_HCLK>;
        clock-names = "source", "hclk";
        power-domains = <&scpsys MT6990_POWER_DOMAIN_MSDC>;

        status = "disabled";
    };

	pd-sgmii_0_phy {
		compatible = "mediatek,sgmii-bring-up";
		mediatek,pwr_type = <0>;
		mediatek,pwr_id = <0>;
		/*power-domains = <&scpsys MT6990_POWER_DOMAIN_XFI_PHY_0>;*/

	};

	pd-sgmii_0_top {
		compatible = "mediatek,sgmii-bring-up";
		mediatek,pwr_type = <1>;
		mediatek,pwr_id = <0>;
		power-domains = <&scpsys MT6990_POWER_DOMAIN_SGMII_TOP_0>;

	};

	pd-sgmii_1_phy {
		compatible = "mediatek,sgmii-bring-up";
		mediatek,pwr_type = <0>;
		mediatek,pwr_id = <1>;
		/*power-domains = <&scpsys MT6990_POWER_DOMAIN_XFI_PHY_1>;*/

	};

	pd-sgmii_1_top {
		compatible = "mediatek,sgmii-bring-up";
		mediatek,pwr_type = <1>;
		mediatek,pwr_id = <1>;
		power-domains = <&scpsys MT6990_POWER_DOMAIN_SGMII_TOP_1>;

	};

	pd-xfi_top_0 {
		compatible = "mediatek,sgmii-bring-up";
		mediatek,pwr_type = <2>;
		mediatek,pwr_id = <0>;
		power-domains = <&scpsys MT6990_POWER_DOMAIN_XFI_TOP_0>;
	};

	pd-xfi_top_1 {
		compatible = "mediatek,sgmii-bring-up";
		mediatek,pwr_type = <2>;
		mediatek,pwr_id = <1>;
		power-domains = <&scpsys MT6990_POWER_DOMAIN_XFI_TOP_1>;
	};

	sgmiisys_0: sgmiisys@11304000 {
		compatible = "mediatek,colgin-sgmiisys_0", "syscon";
		reg = <0 0x11304000 0 0x1000>;
		#clock-cells = <1>;
		mediatek,physpeed = "2500";
	};

	sgmiisys_1: sgmiisys@11305000 {
		compatible = "mediatek,colgin-sgmiisys_1", "syscon";
		reg = <0 0x11305000 0 0x1000>;
		#clock-cells = <1>;
		mediatek,physpeed = "2500";
	};

	sgmiisys_phy_0: sgmiiphy@11E50000 {
		compatible = "mediatek,colgin-sgmiisys_phy_0", "syscon";
		reg = <0 0x11E50000 0 0x10000>;
		#clock-cells = <1>;
	};

	sgmiisys_phy_1: sgmiiphy@11E60000 {
		compatible = "mediatek,colgin-sgmiisys_phy_1", "syscon";
		reg = <0 0x11E60000 0 0x10000>;
		#clock-cells = <1>;
	};

	sgmiisys_uxphy_0: sgmiiphy@11306000 {
		compatible = "mediatek,colgin-sgmiisys_uxphy_0", "syscon";
		reg = <0 0x11306000 0 0x1000>;
		#clock-cells = <1>;
	};

	sgmiisys_uxphy_1: sgmiiphy@11307000 {
		compatible = "mediatek,colgin-sgmiisys_uxphy_1", "syscon";
		reg = <0 0x11307000 0 0x1000>;
		#clock-cells = <1>;
	};

	sgmiisys_pll: sgmiipll@10014000 {
		compatible = "mediatek,colgin-sgmiisys_pll", "syscon";
		reg = <0 0x10014000 0 0x1000>;
		#clock-cells = <1>;
	};

	ethsys: ethsys@15000000 {
		#address-cells = <1>;
		#size-cells = <1>;
		compatible = "mediatek,leopard-ethsys", "syscon", "simple-mfd";
		reg = <0 0x15000000 0 0x1000>;
		#clock-cells = <1>;
		#reset-cells = <1>;

		ethsysrst: reset-controller {
			compatible = "ti,syscon-reset";
			#reset-cells = <1>;
			ti,reset-bits = <
				0x34 4 0x34 4 0x34 4 (ASSERT_SET | DEASSERT_CLEAR   | STATUS_SET) /* 4: wocpu_rst */
			>;
		};
	};

	hnat: hnat@15102200 {
		compatible = "mediatek,hnat", "syscon";
		reg = <0 0x15102200 0 0x1000>;
	};

	netsys@15100000 {
		compatible = "mediatek,mt6990-netsys";
		reg = <0 0x15100000 0 0x20000>;
		interrupts-extended = <&gic GIC_SPI 428 IRQ_TYPE_LEVEL_HIGH>,
				<&gic GIC_SPI 432 IRQ_TYPE_LEVEL_HIGH>,
				<&gic GIC_SPI 436 IRQ_TYPE_LEVEL_HIGH>,
				<&gic GIC_SPI 429 IRQ_TYPE_LEVEL_HIGH>,
				<&gic GIC_SPI 433 IRQ_TYPE_LEVEL_HIGH>,
				<&gic GIC_SPI 437 IRQ_TYPE_LEVEL_HIGH>,
				<&gic GIC_SPI 430 IRQ_TYPE_LEVEL_HIGH>,
				<&gic GIC_SPI 434 IRQ_TYPE_LEVEL_HIGH>,
				<&gic GIC_SPI 438 IRQ_TYPE_LEVEL_HIGH>;
		interrupt-names = "netsys-edma0", "netsys-edma1", "netsys-edma2",
				"netsys-edma0-g1", "netsys-edma1-g1", "netsys-edma2-g1",
				"netsys-edma0-r1", "netsys-edma1-r1", "netsys-edma2-r1";
		clocks = <&topckgen_clk CLK_TOP_NETSYS_SEL>,
			 <&topckgen_clk CLK_TOP_NETSYS_500M_SEL>,
			 <&topckgen_clk CLK_TOP_NETSYS_MED_MCU_SEL>,
			 <&topckgen_clk CLK_TOP_NETSYS_WED_MCU_SEL>,
			 <&topckgen_clk CLK_TOP_NETSYS_2X_SEL>;
		clock-names = "net_sel", "net_500_sel",
				"med_mcu_sel", "wed_mcu_sel",
				"net_2x_sel";
		power-domains = <&scpsys MT6990_POWER_DOMAIN_NET>;

		ranges;

		eth: ethernet@15100000 {
			compatible = "mediatek,mt6990-eth",
				     "syscon";
			reg = <0 0x15100000 0 0x30000>;

			interrupts-extended =
				<&gic GIC_SPI 407 IRQ_TYPE_LEVEL_HIGH>,
				<&gic GIC_SPI 408 IRQ_TYPE_LEVEL_HIGH>,
				<&gic GIC_SPI 400 IRQ_TYPE_LEVEL_HIGH>,
				<&gic GIC_SPI 401 IRQ_TYPE_LEVEL_HIGH>,
				<&gic GIC_SPI 402 IRQ_TYPE_LEVEL_HIGH>,
				<&gic GIC_SPI 403 IRQ_TYPE_LEVEL_HIGH>,
#if defined(CONFIG_QUECTEL_ETHERNET_PHY)
				<&pio 50 IRQ_TYPE_EDGE_FALLING>,
				<&pio 52 IRQ_TYPE_EDGE_FALLING>;
#else
				<&pio 50 IRQ_TYPE_LEVEL_LOW>,
				<&pio 52 IRQ_TYPE_LEVEL_HIGH>;
#endif
			clocks = <&topckgen_clk CLK_TOP_SGMII_0_SEL>,
					 <&topckgen_clk CLK_TOP_SGMII_SBUS_0_SEL>,
					 <&topckgen_clk CLK_TOP_SGMII_1_SEL>,
					 <&topckgen_clk CLK_TOP_SGMII_SBUS_1_SEL>,
					 <&topckgen_clk CLK_TOP_USXGMII_SBUS_0_SEL>,
				<&topckgen_clk CLK_TOP_USXGMII_SBUS_1_SEL>;
			clock-names = "sgmii_0_sel", "sgmii_sbus_0_sel", "sgmii_1_sel", "sgmii_sbus_1_sel",
						  "usxgmii_sbus_0_sel",	"usxgmii_sbus_1_sel";
			mediatek,ethsys = <&ethsys>;
			mediatek,sgmiisys = <&sgmiisys_0>,<&sgmiisys_1>;
			mediatek,sgmiisys_phy = <&sgmiisys_phy_0>,<&sgmiisys_phy_1>;
			mediatek,sgmiisys_uxphy = <&sgmiisys_uxphy_0>,<&sgmiisys_uxphy_1>;
			mediatek,sgmii_pll = <&sgmiisys_pll>;
			#address-cells = <1>;
			#size-cells = <0>;
			status = "disabled";
		};
	};

	crypto: crypto@10320000 {
		/* compatible = "mediatek,eip97-crypto"; */
		/* compatible = "safexcel-ip-97-mob"; */
		/* compatible = "inside-secure,safexcel-eip97"; */
		compatible = "inside-secure,mt6990-safexcel-eip97", "mediatek,mt6990-eip97";
		reg = <0 0x10320000 0 0x40000>;
		interrupts = <GIC_SPI 217 IRQ_TYPE_LEVEL_HIGH>,
			     <GIC_SPI 218 IRQ_TYPE_LEVEL_HIGH>,
			     <GIC_SPI 219 IRQ_TYPE_LEVEL_HIGH>,
			     <GIC_SPI 220 IRQ_TYPE_LEVEL_HIGH>,
			     <GIC_SPI 221 IRQ_TYPE_LEVEL_HIGH>;
		interrupt-names = "ring0", "ring1", "ring2", "ring3";
		clocks = <&topckgen_clk CLK_TOP_EIP97_SEL>,
				<&topckgen_clk CLK_TOP_NET2PLL>,
				<&topckgen_clk CLK_TOP_MAINPLL_D5_D2>,
				<&infracfg_ao_clk CLK_IFRAO_EIP97>;
		clock-names = "clk-mux", "net2pll", "D5_D2", "infra";
		power-domains = <&scpsys MT6990_POWER_DOMAIN_EIP97>;
	};

	dramc_ch1_top0@10240000 {
		compatible = "mediatek,dramc_ch1_top0";
		reg = <0 0x10240000 0 0x2000>;
	};

	dramc_ch1_top1@10242000 {
		compatible = "mediatek,dramc_ch1_top1";
		reg = <0 0x10242000 0 0x2000>;
	};

	dramc_ch1_top2@10244000 {
		compatible = "mediatek,dramc_ch1_top2";
		reg = <0 0x10244000 0 0x1000>;
	};

	dramc_ch1_top3@10245000 {
		compatible = "mediatek,dramc_ch1_top3";
		reg = <0 0x10245000 0 0x1000>;
	};

	dramc_ch1_top4@10246000 {
		compatible = "mediatek,dramc_ch1_top4";
		reg = <0 0x10246000 0 0x2000>;
	};

	dramc_ch1_top5@10248000 {
		compatible = "mediatek,dramc_ch1_top5";
		reg = <0 0x10248000 0 0x2000>;
	};

	dramc_ch1_top6@1024a000 {
		compatible = "mediatek,dramc_ch1_top6";
		reg = <0 0x1024a000 0 0x2000>;
	};

	ap_ccif4@1024c000 {
		compatible = "mediatek,ap_ccif4";
		reg = <0 0x1024c000 0 0x1000>;
	};

	md_ccif4@1024d000 {
		compatible = "mediatek,md_ccif4";
		reg = <0 0x1024d000 0 0x1000>;
	};

	md_ccif4@1024e000 {
		compatible = "mediatek,md_ccif4";
		reg = <0 0x1024e000 0 0x1000>;
	};

	dramc_ch2_top0@10250000 {
		compatible = "mediatek,dramc_ch2_top0";
		reg = <0 0x10250000 0 0x2000>;
	};

	dramc_ch2_top1@10252000 {
		compatible = "mediatek,dramc_ch2_top1";
		reg = <0 0x10252000 0 0x2000>;
	};

	dramc_ch2_top2@10254000 {
		compatible = "mediatek,dramc_ch2_top2";
		reg = <0 0x10254000 0 0x1000>;
	};

	dramc_ch2_top3@10255000 {
		compatible = "mediatek,dramc_ch2_top3";
		reg = <0 0x10255000 0 0x1000>;
	};

	dramc_ch2_top4@10256000 {
		compatible = "mediatek,dramc_ch2_top4";
		reg = <0 0x10256000 0 0x2000>;
	};

	dramc_ch2_top5@10258000 {
		compatible = "mediatek,dramc_ch2_top5";
		reg = <0 0x10258000 0 0x2000>;
	};

	dramc_ch2_top6@1025a000 {
		compatible = "mediatek,dramc_ch2_top6";
		reg = <0 0x1025a000 0 0x2000>;
	};

	ap_ccif5@1025c000 {
		compatible = "mediatek,ap_ccif5";
		reg = <0 0x1025c000 0 0x1000>;
	};

	md_ccif5@1025d000 {
		compatible = "mediatek,md_ccif5";
		reg = <0 0x1025d000 0 0x1000>;
	};

	mm_vpu_m0_sub_common@1025e000 {
		compatible = "mediatek,mm_vpu_m0_sub_common";
		reg = <0 0x1025e000 0 0x1000>;
	};

	mm_vpu_m1_sub_common@1025f000 {
		compatible = "mediatek,mm_vpu_m1_sub_common";
		reg = <0 0x1025f000 0 0x1000>;
	};

	dramc_ch3_top0@10260000 {
		compatible = "mediatek,dramc_ch3_top0";
		reg = <0 0x10260000 0 0x2000>;
	};

	dramc_ch3_top1@10262000 {
		compatible = "mediatek,dramc_ch3_top1";
		reg = <0 0x10262000 0 0x2000>;
	};

	dramc_ch3_top2@10264000 {
		compatible = "mediatek,dramc_ch3_top2";
		reg = <0 0x10264000 0 0x1000>;
	};

	dramc_ch3_top3@10265000 {
		compatible = "mediatek,dramc_ch3_top3";
		reg = <0 0x10265000 0 0x1000>;
	};

	dramc_ch3_top4@10266000 {
		compatible = "mediatek,dramc_ch3_top4";
		reg = <0 0x10266000 0 0x2000>;
	};

	dramc_ch3_top5@10268000 {
		compatible = "mediatek,dramc_ch3_top5";
		reg = <0 0x10268000 0 0x2000>;
	};

	dramc_ch3_top6@1026a000 {
		compatible = "mediatek,dramc_ch3_top6";
		reg = <0 0x1026a000 0 0x2000>;
	};

	bcrm_peri@10272000 {
		compatible = "mediatek,bcrm_peri";
		reg = <0 0x10272000 0 0x1000>;
	};

	bcrm_peri2@10273000 {
		compatible = "mediatek,bcrm_peri2";
		reg = <0 0x10273000 0 0x1000>;
	};

	devapc_peri@10274000 {
		compatible = "mediatek,devapc_peri";
		reg = <0 0x10274000 0 0x1000>;
	};

	devapc_peri2@10275000 {
		compatible = "mediatek,devapc_peri2";
		reg = <0 0x10275000 0 0x1000>;
	};

	bcrm_fmem@10276000 {
		compatible = "mediatek,bcrm_fmem";
		reg = <0 0x10276000 0 0x1000>;
	};

	falcon_pmic_en: regulator-falcon-1v8 {
		compatible = "regulator-fixed";
		regulator-name = "falcon-pmic-en";
//		regulator-boot-on;
		enable-active-high;
	};

	pcie0: pcie@11280000 {
		compatible = "mediatek,mt6990-pcie";
		reg = <0 0x11280000 0 0x2000>;
		reg-names = "pcie-mac";
		linux,pci-domain = <0>;
		#address-cells = <3>;
		#size-cells = <2>;
		interrupts = <GIC_SPI 288 IRQ_TYPE_LEVEL_HIGH>;
		bus-range = <0x00 0xff>;
		ranges = <0x82000000 0 0x30000000
			  0x0 0x30000000 0 0x10000000>;
		phys = <&pciephy0>;
		phy-names = "pcie-phy";
		status = "disabled";

		clocks = <&pericfg_ao_clk CLK_PERAO_PERI2PCIE0__TX>,
			<&vlpcfg_clk CLK_VLPCFG_PCIE_TL_32K>,
			<&vlpcfg_clk CLK_VLPCFG_PCIE_TL_26M>,
			<&vlpcfg_clk CLK_VLPCFG_PCIE_TL_96M>,
			<&vlpcfg_clk CLK_VLPCFG_PCIE_TL_ULPOSC>,
			<&vlpcfg_clk CLK_VLPCFG_PCIE_REF_CK_26M>,
			<&vlpcfg_clk CLK_VLPCFG_PCIE_AXI250>,
			<&vlpcfg_clk CLK_VLPCFG_PCIE_SRAM_26M>,
			<&vlp_cksys_clk CLK_VLP_CK_TL_VLP_SEL>;

		power-domains = <&scpsys MT6990_POWER_DOMAIN_PCIE0>;

		#interrupt-cells = <1>;
		interrupt-map-mask = <0 0 0 7>;
		interrupt-map = <0 0 0 1 &pcie_intc0 0>,
				<0 0 0 2 &pcie_intc0 1>,
				<0 0 0 3 &pcie_intc0 2>,
				<0 0 0 4 &pcie_intc0 3>;
		pcie_intc0: interrupt-controller {
			interrupt-controller;
			#address-cells = <0>;
			#interrupt-cells = <1>;
		};
	};

	pcie1: pcie@11288000 {
		compatible = "mediatek,mt6990-pcie";
		reg = <0 0x11288000 0 0x2000>;
		reg-names = "pcie-mac";
		linux,pci-domain = <1>;
		#address-cells = <3>;
		#size-cells = <2>;
		interrupts = <GIC_SPI 278 IRQ_TYPE_LEVEL_HIGH>;
		bus-range = <0x00 0xff>;
		ranges = <0x82000000 0 0x40000000
			  0x0 0x40000000 0 0x04000000>;
		phys = <&pciephy1>;
		phy-names = "pcie-phy";
		status = "disabled";

		clocks = <&pericfg_ao_clk CLK_PERAO_PCIE_2LX1_TL>,
			 <&pericfg_ao_clk CLK_PERAO_PCIE_2LX1_REF>,
			<&pericfg_ao_clk CLK_PERAO_PCIE_2LX1_AXI>,
			<&pericfg_ao_clk CLK_PERAO_PCIE_2LX1_AHB>,
			<&pericfg_ao_clk CLK_PERAO_PCIE_2LX1_26M>,
			<&topckgen_clk CLK_TOP_TL_SEL>,
			<&topckgen_clk CLK_TOP_PCIE_250M_SEL>;

		power-domains = <&scpsys MT6990_POWER_DOMAIN_PCIE1>;

		#interrupt-cells = <1>;
		interrupt-map-mask = <0 0 0 7>;
		interrupt-map = <0 0 0 1 &pcie_intc1 0>,
				<0 0 0 2 &pcie_intc1 1>,
				<0 0 0 3 &pcie_intc1 2>,
				<0 0 0 4 &pcie_intc1 3>;
		pcie_intc1: interrupt-controller {
			interrupt-controller;
			#address-cells = <0>;
			#interrupt-cells = <1>;
		};
	};

	pcie2: pcie@11290000 {
		compatible = "mediatek,mt6990-pcie";
		reg = <0 0x11290000 0 0x2000>;
		reg-names = "pcie-mac";
		linux,pci-domain = <2>;
		#address-cells = <3>;
		#size-cells = <2>;
		interrupts = <GIC_SPI 279 IRQ_TYPE_LEVEL_HIGH>;
		bus-range = <0x00 0xff>;
		ranges = <0x82000000 0 0x44000000
			  0x0 0x44000000 0 0x04000000>;
		phys = <&pciephy2>;
		phy-names = "pcie-phy";
		status = "disabled";

		clocks = <&pericfg_ao_clk CLK_PERAO_PCIE_2LX2_TL>,
			<&pericfg_ao_clk CLK_PERAO_PCIE_2LX2_REF>,
			<&pericfg_ao_clk CLK_PERAO_PCIE_2LX2_AXI>,
			<&pericfg_ao_clk CLK_PERAO_PCIE_2LX2_AHB>,
			<&pericfg_ao_clk CLK_PERAO_PCIE_2LX2_26M>,
			<&topckgen_clk CLK_TOP_TL_SEL>,
			<&topckgen_clk CLK_TOP_PCIE_250M_SEL>;

		power-domains = <&scpsys MT6990_POWER_DOMAIN_PCIE2>;

		#interrupt-cells = <1>;
		interrupt-map-mask = <0 0 0 7>;
		interrupt-map = <0 0 0 1 &pcie_intc2 0>,
				<0 0 0 2 &pcie_intc2 1>,
				<0 0 0 3 &pcie_intc2 2>,
				<0 0 0 4 &pcie_intc2 3>;
		pcie_intc2: interrupt-controller {
			interrupt-controller;
			#address-cells = <0>;
			#interrupt-cells = <1>;
		};
	};

	pciephy0: phy0@11310000 {
		compatible = "mediatek,mt6980-pcie-phy";
		#address-cells = <2>;
		#size-cells = <2>;
		#phy-cells = <0>;
		reg = <0 0x11310000 0 0x10000>;
		reg-names = "sif";
		phy-id = <0>;
		status = "disabled";

		power-domains = <&scpsys MT6990_POWER_DOMAIN_PCIE0>;
	};

	pciephy1: phy1@0x11e00000 {
		compatible = "mediatek,mt6980-pcie-phy";
		#address-cells = <2>;
		#size-cells = <2>;
		#phy-cells = <0>;
		reg = <0 0x11e00000 0 0x10000>;
		reg-names = "sif";
		phy-id = <1>;
		status = "disabled";

		 power-domains = <&scpsys MT6990_POWER_DOMAIN_PCIE1>;
	};

	pciephy2: phy2@0x11e20000 {
		compatible = "mediatek,mt6980-pcie-phy";
		#address-cells = <2>;
		#size-cells = <2>;
		#phy-cells = <0>;
		reg = <0 0x11e20000 0 0x10000>;
		reg-names = "sif";
		phy-id = <2>;
		status = "disabled";

		power-domains = <&scpsys MT6990_POWER_DOMAIN_PCIE2>;
	};

	mm_vpu_m0_sub_common@10309000 {
		compatible = "mediatek,mm_vpu_m0_sub_common";
		reg = <0 0x10309000 0 0x1000>;
	};

	mm_vpu_m1_sub_common@1030a000 {
		compatible = "mediatek,mm_vpu_m1_sub_common";
		reg = <0 0x1030a000 0 0x1000>;
	};

	mm_vpu_m1_sub_common@1030b000 {
		compatible = "mediatek,mm_vpu_m1_sub_common";
		reg = <0 0x1030b000 0 0x1000>;
	};

	mm_vpu_m1_sub_common@1030c000 {
		compatible = "mediatek,mm_vpu_m1_sub_common";
		reg = <0 0x1030c000 0 0x1000>;
	};

	mm_vpu_m1_sub_common@1030d000 {
		compatible = "mediatek,mm_vpu_m1_sub_common";
		reg = <0 0x1030d000 0 0x1000>;
	};

	sys_cirq1@10312000 {
		compatible = "mediatek,sys_cirq1";
		reg = <0 0x10312000 0 0x1000>;
	};

	sys_cirq2@10313000 {
		compatible = "mediatek,sys_cirq2";
		reg = <0 0x10313000 0 0x1000>;
	};

	dbg_tracker@10314000 {
		compatible = "mediatek,dbg_tracker";
		reg = <0 0x10314000 0 0x1000>;
	};

	pwrmcu@10400000 {
		compatible = "mediatek,pwrmcu";
		reg = <0 0x10400000 0 0x100000>;
	};

	sspm@12300000 {
		compatible = "mediatek,sspm";
		reg = <0 0x12300000 0 0x28000>,
			<0 0x12340000 0 0x10000>,
			<0 0x12350000 0 0x100>,
			<0 0x12351000 0 0x4>,
			<0 0x12351004 0 0x4>,
			<0 0x12360000 0 0x100>,
			<0 0x12361000 0 0x4>,
			<0 0x12361004 0 0x4>,
			<0 0x12370000 0 0x100>,
			<0 0x12371000 0 0x4>,
			<0 0x12371004 0 0x4>,
			<0 0x12380000 0 0x100>,
			<0 0x12381000 0 0x4>,
			<0 0x12381004 0 0x4>,
			<0 0x12390000 0 0x100>,
			<0 0x12391000 0 0x4>,
			<0 0x12391004 0 0x4>;

		reg-names = "sspm_base",
			"cfgreg",
			"mbox0_base",
			"mbox0_set",
			"mbox0_clr",
			"mbox1_base",
			"mbox1_set",
			"mbox1_clr",
			"mbox2_base",
			"mbox2_set",
			"mbox2_clr",
			"mbox3_base",
			"mbox3_set",
			"mbox3_clr",
			"mbox4_base",
			"mbox4_set",
			"mbox4_clr";

		interrupts = <GIC_SPI 143 IRQ_TYPE_LEVEL_HIGH>,
			<GIC_SPI 145 IRQ_TYPE_LEVEL_HIGH>,
			<GIC_SPI 146 IRQ_TYPE_LEVEL_HIGH>,
			<GIC_SPI 147 IRQ_TYPE_LEVEL_HIGH>,
			<GIC_SPI 148 IRQ_TYPE_LEVEL_HIGH>,
			<GIC_SPI 149 IRQ_TYPE_LEVEL_HIGH>;

		interrupt-names = "ipc",
			"mbox0",
			"mbox1",
			"mbox2",
			"mbox3",
			"mbox4";

		sspm_res_ram_start = <0x0>;
#if defined(CONFIG_MTK_GMO_RAM_OPTIMIZE) || defined(CONFIG_MTK_MET_MEM_ALLOC)
		sspm_res_ram_size = <0x210000>; /* 2M + 64K */
#else
		sspm_res_ram_size = <0x610000>; /* 6M + 64K */
#endif
	};

	tinsys@10500000 {
		compatible = "mediatek,tinsys";
		reg = <0 0x10500000 0 0x0>;
	};

	dramc_ch1_rsv0@10900000 {
		compatible = "mediatek,dramc_ch1_rsv0";
		reg = <0 0x10900000 0 0x40000>;
	};

	dramc_ch1_rsv1@10940000 {
		compatible = "mediatek,dramc_ch1_rsv1";
		reg = <0 0x10940000 0 0xc0000>;
	};

	mali: mali@13000000 {
		compatible = "mediatek,mali", "arm,mali-midgard", "arm,mali-bifrost";
		reg = <0 0x13000000 0 0x4000>;
		interrupts =
			<GIC_SPI 328 IRQ_TYPE_LEVEL_HIGH>,
			<GIC_SPI 329 IRQ_TYPE_LEVEL_HIGH>,
			<GIC_SPI 330 IRQ_TYPE_LEVEL_HIGH>,
			<GIC_SPI 331 IRQ_TYPE_LEVEL_HIGH>;
		interrupt-names =
			"GPU",
			"MMU",
			"JOB",
			"EVENT";
		operating-points-v2 = <&gpu_mali_opp>;
		#cooling-cells = <2>;
		gpufreq-supply = <&gpufreq>;
	};

	gpu_mali_opp: opp-table0 {
		compatible = "operating-points-v2";
		opp00 {
			opp-hz = /bits/ 64 <820000000>;
			opp-microvolt = <750000>;
		};
		opp01 {
			opp-hz = /bits/ 64 <550000000>;
			opp-microvolt = <650000>;
		};
		opp02 {
			opp-hz = /bits/ 64 <360000000>;
			opp-microvolt = <600000>;
		};
		opp03 {
			opp-hz = /bits/ 64 <300000000>;
			opp-microvolt = <575000>;
		};
	};

	gpufreq: gpufreq {
		compatible = "mediatek,gpufreq";
		clocks =
			<&topckgen_clk CLK_TOP_MFG_SEL>,
			<&topckgen_clk CLK_TOP_MFGPLL>,
			<&topckgen_clk CLK_TOP_MFG_REF_SEL>,
			<&mfg_top_clk CLK_MFG_TOP_BG3D>;
		clock-names =
			"clk_mux",	/* switch main/sub */
			"clk_main_parent",	/* main pll freq */
			"clk_sub_parent",	/* default 218.4 MHz */
			"cg_bg3d";
		power-domains = <&scpsys MT6990_POWER_DOMAIN_MFG0>;
	};

	disp_pwm: disp_pwm0@1100e000 {
		compatible = "mediatek,disp_pwm0",
				"mediatek,mt6890-disp-pwm";
		reg = <0 0x1100e000 0 0x1000>;
		interrupts = <GIC_SPI 266 IRQ_TYPE_LEVEL_HIGH>;
		#pwm-cells = <2>;
		clocks = <&pericfg_ao_clk CLK_PERAO_DISP_PWM_BCLK>,
			<&topckgen_clk CLK_TOP_DISP_PWM_SEL>,
			<&topckgen_clk CLK_TOP_OSC_D4>;
		clock-names = "main", "mm", "pwm_src";
	};

	efuse: efuse@11d50000 {
		compatible = "mediatek,devinfo";
		reg = <0 0x11d50000 0 0x10000>;
		#address-cells = <1>;
		#size-cells = <1>;
		efuse_segment: segment@78 {
			reg = <0x78 0x4>;
		};

        lvts_e_data1: data1 {
			reg = <0x1E0 0x28>;
        };

		lvts_e_data2: data2 {
			reg = <0x258 0xC>;
        };

		u2_efuse_segment: u2data {
			reg = <0x288 0x4>;
		};

		u3_efuse_segment: u3data {
			reg = <0x28C 0x4>;
		};
	};

	lvts: lvts@1100b000 {
		compatible = "mediatek,mt6980-lvts";
		#thermal-sensor-cells = <1>;
		reg = <0 0x1100b000 0 0x1000>,
			  <0 0x1100c000 0 0x1000>;
		interrupts = <GIC_SPI 264 IRQ_TYPE_LEVEL_HIGH>,
					 <GIC_SPI 265 IRQ_TYPE_LEVEL_HIGH>;

		clocks = <&pericfg_ao_clk CLK_PERAO_PTP_THERM_MCU_BCLK>,
			<&pericfg_ao_clk CLK_PERAO_PTP_THERM_MCU_SYS>,
			<&pericfg_ao_clk CLK_PERAO_PTP_THERM_BCLK>,
			<&pericfg_ao_clk CLK_PERAO_PTP_THERM_SYS>;
		clock-names = "lvts_clk1", "lvts_clk2", "lvts_clk3", "lvts_clk4";

		nvmem-cells = <&lvts_e_data1 &lvts_e_data2>;
		nvmem-cell-names = "e_data1","e_data2";
	};

	g3d_dvfs@13fbc000 {
		compatible = "mediatek,g3d_dvfs";
		reg = <0 0x13fbc000 0 0x1000>;
	};

	g3d_testbench@13fbd000 {
		compatible = "mediatek,g3d_testbench";
		reg = <0 0x13fbd000 0 0x1000>;
	};

	g3d_config@13fbf000 {
		compatible = "mediatek,g3d_config";
		reg = <0 0x13fbf000 0 0x1000>;
	};

	mmsys_config: mmsys_config@14000000 {
		compatible = "mediatek,mt6990-mmsys";
		reg = <0 0x14000000 0 0x1000>;
		mediatek,larb = <&smi_larb0>;
		power-domains = <&scpsys MT6990_POWER_DOMAIN_DISP>;

		mediatek,gce = <&gce_mbox>;

 		/* define threads, see mt6890-gce.h */   // refer to 6890 from R0.

 		mediatek,mailbox-gce = <&gce_mbox>;
 		gce-cpr-range = <0 GCE_CPR_COUNT>;

 		mboxes = <&gce_mbox 0 0 CMDQ_THR_PRIO_4>,
 			<&gce_mbox 1 0 CMDQ_THR_PRIO_4>,
 			<&gce_mbox 2 0 CMDQ_THR_PRIO_4>,
 			<&gce_mbox 3 CMDQ_NO_TIMEOUT CMDQ_THR_PRIO_2>,
 			<&gce_mbox 5 CMDQ_NO_TIMEOUT CMDQ_THR_PRIO_2>,
 			<&gce_mbox 4 0 CMDQ_THR_PRIO_4>,
 			<&gce_mbox 6 0 CMDQ_THR_PRIO_3>;

 		gce-client-names = "CLIENT_CFG0",
 			"CLIENT_CFG1",
 			"CLIENT_CFG2",
 			"CLIENT_TRIG_LOOP0",
 			"CLIENT_TRIG_LOOP1",
 			"CLIENT_SUB_CFG0",
 			"CLIENT_DSI_CFG0";
	};

	//add for testing
	dbi_panel@0 {
		compatible = "sitronix,st7796s";
		reg = <0>;
		pm-enable-gpios = <&pio 8 0>;
		reset-gpios = <&pio 214 0>;
		bias-gpios = <&pio 10 0>;
	};

	disp_mutex0@14001000 {
		compatible = "mediatek,mt6990-disp-mutex0";
		reg = <0 0x14001000 0 0x1000>;
		interrupts = <GIC_SPI 296 IRQ_TYPE_LEVEL_HIGH>;
		clocks = <&mdpsys_config_clk CLK_MDP_MUTEX0>;
	};

	disp_ovl0@14006000 {
		compatible = "mediatek,mt6990-disp-ovl0";
		reg = <0 0x14006000 0 0x1000>;
		interrupts = <GIC_SPI 301 IRQ_TYPE_LEVEL_HIGH>;
		mediatek,larb = <&smi_larb0>;
		clocks = <&mdpsys_config_clk CLK_MDP_DISP_OVL0>;
		gce-subsys = <&gce_mbox 0x14006000 SUBSYS_1400XXXX>;
		#gce-subsys-cells = <2>;
		iommus = <&iommu0 M4U_PORT_OVL_RDMA0>;
	};

	disp_rdma0@14007000 {
		compatible = "mediatek,mt6990-disp-rdma0";
		reg = <0 0x14007000 0 0x1000>;
		interrupts = <GIC_SPI 302 IRQ_TYPE_LEVEL_HIGH>;
		mediatek,larb = <&smi_larb0>;
		clocks = <&mdpsys_config_clk CLK_MDP_DISP_RDMA0>;
		gce-subsys = <&gce_mbox 0x14007000 SUBSYS_1400XXXX>;
		#gce-subsys-cells = <2>;
	};

	disp_color0@14008000 {
		compatible = "mediatek,disp_color0";
		reg = <0 0x14008000 0 0x1000>;
		interrupts = <GIC_SPI 303 IRQ_TYPE_LEVEL_HIGH>;
		clocks = <&mdpsys_config_clk CLK_MDP_DISP_COLOR0>;
	};

	disp_ccorr0@14009000 {
		compatible = "mediatek,disp_ccorr0";
		reg = <0 0x14009000 0 0x1000>;
		interrupts = <GIC_SPI 304 IRQ_TYPE_LEVEL_HIGH>;
		clocks = <&mdpsys_config_clk CLK_MDP_DISP_CCORR0>;
	};

	disp_aal0@1400a000 {
		compatible = "mediatek,disp_aal0";
		reg = <0 0x1400a000 0 0x1000>;
		interrupts = <GIC_SPI 305 IRQ_TYPE_LEVEL_HIGH>;
		clocks = <&mdpsys_config_clk CLK_MDP_DISP_AAL0>;
	};

	disp_gamma0@1400b000 {
		compatible = "mediatek,disp_gamma0";
		reg = <0 0x1400b000 0 0x1000>;
		interrupts = <GIC_SPI 306 IRQ_TYPE_LEVEL_HIGH>;
		clocks = <&mdpsys_config_clk CLK_MDP_DISP_GAMMA0>;
	};

	disp_dither0@1400c000 {
		compatible = "mediatek,disp_dither0";
		reg = <0 0x1400c000 0 0x1000>;
		interrupts = <GIC_SPI 307 IRQ_TYPE_LEVEL_HIGH>;
		clocks = <&mdpsys_config_clk CLK_MDP_DISP_DITHER0>;
	};

	disp_wdma0@1400d000 {
		compatible = "mediatek,disp_wdma0";
		reg = <0 0x1400d000 0 0x1000>;
		interrupts = <GIC_SPI 308 IRQ_TYPE_LEVEL_HIGH>;
		mediatek,larb = <&smi_larb0>;
	};

	dsi0: dsi0@1400e000 {
		compatible = "mediatek,mt6990-dsi0";
		reg = <0 0x1400e000 0 0x1000>;
		interrupts = <GIC_SPI 309 IRQ_TYPE_LEVEL_HIGH>;
		clocks = <&mdpsys_config_clk CLK_MDP_DISP_DSI0>,
				<&mdpsys_config_clk CLK_MDP_SMI_COMMON>,
				<&clk32k>,
				<&mdpsys_config_clk CLK_MDP_DISP_DSI0_1>,
				<&mipi_tx_config0>;
		clock-names = "CLK_DSI0_MM_CK",
				"CLK_MMSYS_SMI_COMMON",
				"CLK_32K",
				"CLK_MM_DSI",
				"hs";
		phys = <&mipi_tx_config0>;
		phy-names = "dphy";
	};

	iocfg_rt8: iocfg_rt8@0x11c00000 {
		compatible = "mediatek,iocfg_rt8";
		reg = <0 0x11c00000 0 0x1000>;
	};

	iocfg_rt9: iocfg_rt9@0x11c10000 {
		compatible = "mediatek,iocfg_rt9";
		reg = <0 0x11c10000 0 0x1000>;
	};

	nli_arb: nli_arb@0x11f50000 {
		compatible = "mediatek,nli_arb";
		reg = <0 0x11f50000 0 0x1000>;
	};

	dbi0: dbi0@1400f000 {
		compatible = "mediatek,mt6990-dbi0";
		reg = <0 0x1400f000 0 0x1000>;
		interrupts = <GIC_SPI 310 IRQ_TYPE_LEVEL_HIGH>;
		clocks = <&mdpsys_config_clk CLK_MDP_DISP_DBPI0>,
			//<&infracfg_ao_clk CLK_PERAO_NFI_BCLK>,	//NFI and DBI-B co-exist
			<&clk_null>,
			<&topckgen_clk CLK_TOP_NFI1X_SEL>,	    //NFI and DBI-B co-exist
			<&topckgen_clk CLK_TOP_TCK_26M_MX9>,    //26M
			<&topckgen_clk CLK_TOP_UNIVPLL_D5_D4>,  //125M
			<&topckgen_clk CLK_TOP_MAINPLL_D7_D4>,  //78M
			<&topckgen_clk CLK_TOP_MAINPLL_D6_D4>,  //91M
			<&topckgen_clk CLK_TOP_UNIVPLL_D6_D4>,  //104M
			<&topckgen_clk CLK_TOP_MAINPLL_D4_D4>,  //137M
			<&topckgen_clk CLK_TOP_UNIVPLL_D4_D4>,  //156M
			<&topckgen_clk CLK_TOP_MAINPLL_D6_D2>,  //182M
			<&mdpsys_config_clk CLK_MDP_SMI_COMMON>,
			<&mdpsys_config_clk CLK_MDP_DISP_DBPI0_1>,
			<&topckgen_clk CLK_TOP_DBI_SEL>;		//Separate DBI-B data pin
		clock-names = "clk_mm_dbpi",
			"clk_infra_nfi",
			"clk_engine",
			"clk_top_26",
			"clk_top_125",
			"clk_top_78",
			"clk_top_91",
			"clk_top_104",
			"clk_top_137",
			"clk_top_156",
			"clk_top_182",
			"clk_smi_common",
			"clk_mm_dbi",
			"clk_dbi_sel";
	};

	dsi_te: dsi_te {
		compatible = "mediatek, dsi_te-eint";
		status = "disabled";
	};

 	dispsys: dispsys {
 		compatible = "mediatek,dispsys";

//  Need to update to MT6990 clock, modified by Pei-hsuan Cheng
		power-domains = <&scpsys MT6990_POWER_DOMAIN_DISP>;

	    clocks = <&mdpsys_config_clk CLK_MDP_MUTEX0>,
	          <&mdpsys_config_clk CLK_MDP_APB_BUS>,
	          <&mdpsys_config_clk CLK_MDP_RSZ0>,
	          <&mdpsys_config_clk CLK_MDP_DISP_GAMMA0>,
	          <&mdpsys_config_clk CLK_MDP_WROT0>,
	          <&mdpsys_config_clk CLK_MDP_DISP_COLOR0>,
	          <&mdpsys_config_clk CLK_MDP_DISP_CCORR0>,
	          <&mdpsys_config_clk CLK_MDP_DISP_AAL0>,
	          <&mdpsys_config_clk CLK_MDP_DISP_RDMA0>,
	          <&mdpsys_config_clk CLK_MDP_RDMA0>,
	          <&mdpsys_config_clk CLK_MDP_FAKE_ENG0>,
	          <&mdpsys_config_clk CLK_MDP_DISP_DITHER0>,
	          <&mdpsys_config_clk CLK_MDP_DISP_WDMA0>,
	          <&mdpsys_config_clk CLK_MDP_TDSHP0>,
	          <&mdpsys_config_clk CLK_MDP_DISP_OVL0>,
	          <&mdpsys_config_clk CLK_MDP_DISP_DBPI0>,
	          <&mdpsys_config_clk CLK_MDP_DISP_DSI0>,
	          <&mdpsys_config_clk CLK_MDP_SMI_COMMON>,

	          <&clk26m>,
	          <&clk32k>;


	    clock-names = "CLK_MMSYS_MUTEX0",
	          "CLK_MMSYS_APB_BUS",
	          "CLK_DISP_RSZ",
	          "CLK_DISP_GAMMA0",
	          "CLK_MM_MDP_WROT0",
	          "CLK_DISP_COLOR0",
	          "CLK_DISP_CCORR0",
	          "CLK_DISP_AAL0",
	          "CLK_DISP_RDMA0",
	          "CLK_MM_MDP_RDMA0",
	          "CLK_MMSYS_FAKE_ENG0",
	          "CLK_DISP_DITHER0",
	          "CLK_DISP_WDMA0",
	          "CLK_MM_MDP_TDSHP0",
	          "CLK_DISP_OVL0",
	          "CLK_MM_DBPI0",
	          "CLK_DSI0_MM_CK",
	          "CLK_MMSYS_SMI_COMMON",

	          "CLK_26M",
	          "CLK_32K";
 	};

	mipi_tx_config0: mipi_tx_config@11c20000 {
		compatible = "mediatek,mipi_tx_config0",
					"mediatek,mt6990-mipi-tx";
		reg = <0 0x11c20000 0 0x1000>;
		clocks = <&clk26m>;
		#clock-cells = <0>;
		#phy-cells = <0>;
		clock-output-names = "mipi_tx0_pll";
	};

	smi_sub_common0@14010000 {
		//compatible = "mediatek,smi_sub_common0";
		compatible = "mediatek,mt6880-smi-common";
		reg = <0 0x14010000 0 0x1000>;
	};


	smi_common: smi@14016000 {
		// compatible = "mediatek,smi_common0";    // use it to avoid crash.
		compatible = "mediatek,mt6880-smi-common";
		reg = <0 0x14016000 0 0x1000>;
	};

	smi_larb0: smi_larb0@14017000 {
		//compatible = "mediatek,smi_larb0";
		compatible = "mediatek,mt6880-smi-larb";
		mediatek,smi = <&smi_common>;  // suggestion from Yi Kuo
		reg = <0 0x14017000 0 0x1000>;
		mediatek,larb-id = <0>;
	};

	iommu0: iommu@14011000 {
		compatible = "mediatek,mt6880-m4u";
		reg = <0 0x14011000 0 0x1000>;
		mediatek,larbs = <&smi_larb0>;
		interrupts = <GIC_SPI 312 IRQ_TYPE_LEVEL_HIGH>;
#if 0
		clocks = <&dispsys_config MM_SMI_INFRA>,
		       <&dispsys_config MM_SMI_IOMMU>,
		       <&scpsys SCP_SYS_DIS>;
		clock-names = "disp-infra-ck", "disp-iommu-ck", "power";
#endif
		#iommu-cells = <1>;
	};

	mtk_iommu_debug {
		compatible = "mediatek,mt6880-iommu-debug";
#if 0
		iommus = <&iommu0 M4U_PORT_OVL_RDMA0>,
			 <&iommu0 M4U_PORT_DISP_RDMA0>,
			 <&iommu0 M4U_PORT_MDP_RDMA0>,
			 <&iommu0 M4U_PORT_DISP_WDMA0>,
 			 <&iommu0 M4U_PORT_MDP_WROT0>,
			 <&iommu0 M4U_PORT_DISP_FAKE0>;
#endif
	};

	gps: gps@18C00000 {
		compatible = "mediatek,mt6990-gps";
		reg = <0 0x18000000 0 0x100000>,
			<0 0x18C00000 0 0x100000>,
			<0 0x18D00000 0 0x100000>,
			<0 0x10003304 0 0x4>,
			<0 0x1001C000 0 0x4>,
			<0 0x1001C030 0 0x4>;
		reg-names = "conn_infra_base", "conn_gps_base", "conn_dyn_base",
			"status_dummy_cr", "tia2_gps_on", "tia2_gps_rc_sel";
		interrupts = <GIC_SPI 380 IRQ_TYPE_LEVEL_HIGH>,
			<GIC_SPI 381 IRQ_TYPE_LEVEL_HIGH>,
			<GIC_SPI 382 IRQ_TYPE_LEVEL_HIGH>,
			<GIC_SPI 383 IRQ_TYPE_LEVEL_HIGH>,
			<GIC_SPI 384 IRQ_TYPE_LEVEL_HIGH>,
			<GIC_SPI 385 IRQ_TYPE_LEVEL_HIGH>,
			<GIC_SPI 386 IRQ_TYPE_LEVEL_HIGH>,
			<GIC_SPI 387 IRQ_TYPE_LEVEL_HIGH>,
			<GIC_SPI 388 IRQ_TYPE_LEVEL_HIGH>,
			<GIC_SPI 389 IRQ_TYPE_EDGE_RISING>, /* gps mcu wdt irq */
			<GIC_SPI 390 IRQ_TYPE_LEVEL_HIGH>;
		memory-region = <&gps_mem>;
		pmic = <&pmic_efuse>;
		/*mtk-vcore-supply = <&dvfsrc_vcore>;*/
		emi-addr = <0>;
	};

	spi0: spi0@11010000 {
		compatible = "mediatek,mt6990-spi";
		mediatek,pad-select = <0>;
		reg = <0 0x11010000 0 0x100>;
		interrupts = <GIC_SPI 252 IRQ_TYPE_LEVEL_HIGH>;
		clocks = <&topckgen_clk CLK_TOP_UNIVPLL_D6_D2>,
			<&topckgen_clk CLK_TOP_SPI_SEL>,
			<&pericfg_ao_clk CLK_PERAO_SPI0_BCLK>;
		clock-names = "parent-clk", "sel-clk", "spi-clk";
	};

	spi1: spi1@11011000 {
		compatible = "mediatek,mt6990-spi";
		mediatek,pad-select = <0>;
		reg = <0 0x11011000 0 0x100>;
		interrupts = <GIC_SPI 253 IRQ_TYPE_LEVEL_HIGH>;
		clocks = <&topckgen_clk CLK_TOP_UNIVPLL_D6_D2>,
			<&topckgen_clk CLK_TOP_SPI_SEL>,
			<&pericfg_ao_clk CLK_PERAO_SPI1_BCLK>;
		clock-names = "parent-clk", "sel-clk", "spi-clk";
	};

	spi2: spi2@11012000 {
		compatible = "mediatek,mt6990-spi";
		mediatek,pad-select = <0>;
		reg = <0 0x11012000 0 0x100>;
		interrupts = <GIC_SPI 254 IRQ_TYPE_LEVEL_HIGH>;
		clocks = <&topckgen_clk CLK_TOP_UNIVPLL_D6_D2>,
			<&topckgen_clk CLK_TOP_SPI_SEL>,
			<&pericfg_ao_clk CLK_PERAO_SPI2_BCLK>;
		clock-names = "parent-clk", "sel-clk", "spi-clk";
	};

	spi3: spi3@11013000 {
		compatible = "mediatek,mt6990-spi";
		mediatek,pad-select = <0>;
		reg = <0 0x11013000 0 0x100>;
		interrupts = <GIC_SPI 255 IRQ_TYPE_LEVEL_HIGH>;
		clocks = <&topckgen_clk CLK_TOP_UNIVPLL_D6_D2>,
			<&topckgen_clk CLK_TOP_SPI_SEL>,
			<&pericfg_ao_clk CLK_PERAO_SPI3_BCLK>;
		clock-names = "parent-clk", "sel-clk", "spi-clk";
	};

	odm: odm {
		compatible = "simple-bus";
		/* reserved for overlay by odm */
	};

	pmic_clock_buffer_ctrl: pmic_clock_buffer_ctrl {
		compatible = "mediatek,pmic_clock_buffer";
		mediatek,clkbuf-quantity = <7>;
		mediatek,clkbuf-config = <2 1 1 2 0 0 2>;
		mediatek,clkbuf-output-impedance = <3 4 3 4 0 0 3>;
		mediatek,clkbuf-controls-for-desense = <0 4 0 3 0 0 0>;
		mediatek,bblpm-support = "enable";

		pwrap-dcxo-en = <0x24 4 0x28 1 0x28 0>;
		pwrap-dcxo-conn = <0x5c 0 0x5c 16 0x60 0 0x60 16>;
		pwrap-dcxo-nfc = <0x64 0 0x64 16 0x68 0 0x68 16>;

		spm-pwr-status = <0x16c 0 0x16c 1>;
		spm-io-en = <0x2c 7>;
		spm-power-on-val = <0x8 21 0x8 14>;
		spm-sck-con = <0xc 24>;
		pcm-reg7-rf = <0x10c 21>;

		pwrap = <&spmi_bus>;
		sleep = <&sleep>;
	};

	afe: mt6990-afe-pcm@11210000 {
		compatible = "mediatek,mt6990-sound";
		reg = <0 0x11210000 0 0x1000>;
		interrupts = <GIC_SPI 277 IRQ_TYPE_LEVEL_HIGH>;
		topckgen = <&topckgen_clk>;
		power-domains = <&scpsys MT6990_POWER_DOMAIN_AUDIO>;
		apmixedsys = <&apmixedsys_clk>;
		infracfg = <&infracfg_ao_clk>;
		clocks = <&afe_clk CLK_AFE_AFE>,
			 <&afe_clk CLK_AFE_DAC>,
			 <&afe_clk CLK_AFE_DAC_PREDIS>,
			 <&afe_clk CLK_AFE_ADC>,
			 <&afe_clk CLK_AFE_22M>,
			 <&afe_clk CLK_AFE_24M>,
			 <&afe_clk CLK_AFE_APLL_TUNER>,
			 <&afe_clk CLK_AFE_APLL2_TUNER>,
			 <&afe_clk CLK_AFE_TDM>,
			 <&afe_clk CLK_AFE_TML>,
			 <&afe_clk CLK_AFE_I2S0_BCLK>,
			 <&afe_clk CLK_AFE_I2S1_BCLK>,
			 <&afe_clk CLK_AFE_I2S2_BCLK>,
			 <&afe_clk CLK_AFE_I2S4_BCLK>,
			 <&afe_clk CLK_AFE_I2S5_BCLK>,
			 <&afe_clk CLK_AFE_I2S6_BCLK>,
			 <&afe_clk CLK_AFE_GENERAL2_ASRC>,
			 <&afe_clk CLK_AFE_ETDM_OUT0_BCLK>,
			 <&afe_clk CLK_AFE_CONNSYS_I2S_ASRC>,
			 <&afe_clk CLK_AFE_AFE_SRC_PCM_TX>,
			 <&afe_clk CLK_AFE_AFE_SRC_PCM_TX2>,
			 <&afe_clk CLK_AFE_AFE_SRC_PCM_TX3>,
			 <&afe_clk CLK_AFE_AFE_SRC_PCM_RX>,
			 <&afe_clk CLK_AFE_AFE_SRC_I2SIN>,
			 <&afe_clk CLK_AFE_AFE_SRC_I2SOUT>,
			 <&pericfg_ao_clk CLK_PERAO_AUDIO_QAXI>,
			 <&pericfg_ao_clk CLK_PERAO_AUDIO_26M>,
			 <&apmixedsys_clk CLK_APMIXED_APLL1>,
			 <&apmixedsys_clk CLK_APMIXED_APLL2>,
			 <&topckgen_clk CLK_TOP_AUDIO_SEL>,
			 <&topckgen_clk CLK_TOP_AUD_INTBUS_SEL>,
			 <&topckgen_clk CLK_TOP_MMPLL_D4_D4>,
			 <&topckgen_clk CLK_TOP_AUD_1_SEL>,
			 <&topckgen_clk CLK_TOP_APLL1>,
			 <&topckgen_clk CLK_TOP_AUD_2_SEL>,
			 <&topckgen_clk CLK_TOP_APLL2>,
			 <&topckgen_clk CLK_TOP_AUD_ENGEN1_SEL>,
			 <&topckgen_clk CLK_TOP_APLL1_D8>,
			 <&topckgen_clk CLK_TOP_AUD_ENGEN2_SEL>,
			 <&topckgen_clk CLK_TOP_APLL2_D8>,
			 <&topckgen_clk CLK_TOP_APLL_I2S0_MCK_SEL>,
			 <&topckgen_clk CLK_TOP_APLL_I2S1_MCK_SEL>,
			 <&topckgen_clk CLK_TOP_APLL_I2S2_MCK_SEL>,
			 <&topckgen_clk CLK_TOP_APLL_I2S4_MCK_SEL>,
			 <&topckgen_clk CLK_TOP_APLL_I2S_TDMOUT_MCK_SEL>,
			 <&topckgen_clk CLK_TOP_APLL_I2S5_MCK_SEL>,
			 <&topckgen_clk CLK_TOP_APLL_I2S6_MCK_SEL>,
			 <&topckgen_clk CLK_TOP_APLL12_CK_DIV0>,
			 <&topckgen_clk CLK_TOP_APLL12_CK_DIV1>,
			 <&topckgen_clk CLK_TOP_APLL12_CK_DIV2>,
			 <&topckgen_clk CLK_TOP_APLL12_CK_DIV4>,
			 <&topckgen_clk CLK_TOP_APLL12_CK_DIV_TDMOUT_M>,
			 <&topckgen_clk CLK_TOP_APLL12_CK_DIV_TDMOUT_B>,
			 <&topckgen_clk CLK_TOP_APLL12_CK_DIV5>,
			 <&topckgen_clk CLK_TOP_APLL12_CK_DIV6>,
			 <&topckgen_clk CLK_TOP_TCK_26M_MX9>;
		clock-names = "aud_afe_clk",
			      "aud_dac_clk",
			      "aud_dac_predis_clk",
			      "aud_adc_clk",
			      "aud_apll22m_clk",
			      "aud_apll24m_clk",
			      "aud_apll1_tuner_clk",
			      "aud_apll2_tuner_clk",
			      "aud_tdm_clk",
			      "aud_tml_clk",
			      "aud_i2s0_clk",
			      "aud_i2s1_clk",
			      "aud_i2s2_clk",
			      "aud_i2s4_clk",
			      "aud_i2s5_clk",
			      "aud_i2s6_clk",
			      "aud_src2_clk",
			      "aud_etdm0_clk",
			      "aud_connsys_i2s_clk",
			      "aud_src_pcm_tx_clk",
			      "aud_src_pcm_tx2_clk",
			      "aud_src_pcm_tx3_clk",
			      "aud_src_pcm_rx_clk",
			      "aud_src_i2s_in_clk",
			      "aud_src_i2s_out_clk",
			      "aud_infra_clk",
			      "mtkaif_26m_clk",
			      "aud_clk_apmixed_apll1",
			      "aud_clk_apmixed_apll2",
			      "top_mux_audio",
			      "top_mux_audio_int",
			      "top_mainpll_d2_d4",
			      "top_mux_aud_1",
			      "top_apll1_ck",
			      "top_mux_aud_2",
			      "top_apll2_ck",
			      "top_mux_aud_eng1",
			      "top_apll1_d8",
			      "top_mux_aud_eng2",
			      "top_apll2_d8",
			      "top_i2s0_m_sel",
			      "top_i2s1_m_sel",
			      "top_i2s2_m_sel",
			      "top_i2s4_m_sel",
			      "top_tdm_m_sel",
			      "top_i2s5_m_sel",
			      "top_i2s6_m_sel",
			      "top_apll12_div0",
			      "top_apll12_div1",
			      "top_apll12_div2",
			      "top_apll12_div4",
			      "top_apll12_divm",
			      "top_apll12_divb",
			      "top_apll12_div5",
			      "top_apll12_div6",
			      "top_clk26m_clk";
	};

#ifndef CONFIG_QL_FCM360W_WIFI
	sound: sound {
		compatible = "mediatek,mt6990-slic-sound";
		mediatek,platform = <&afe>;
		mediatek,ext-codec {
			sound-dai = <&proslic_spi>;
		};
		mediatek,ext-codec1 {
			sound-dai = <&proslic_spi0>;
		};
	};
#endif

	audio_sram@11211000 {
		compatible = "mediatek,audio_sram";
		reg = <0 0x11211000 0 0x10000>;
		prefer_mode = <1>;
		mode_size = <0xC000 0x10000>;
		block_size = <0x1000>;
	};

	touch: touch {
	};

	rt9465_slave_chr: rt9465_slave_chr {
	};

	accdet: accdet {
	};

	smart_pa: smart_pa {
	};

	consys: consys@18000000 {
		compatible = "mediatek,mt6990-consys-atf";
		#thermal-sensor-cells = <0>;
		reg = <0 0x10001000 0 0xf68>, /* 0. infracfg_ao */
			<0 0x10004000 0 0xa7c>, /* 1. GPIO */
			<0 0x11d20000 0 0xa04>, /* 2. IOCFG_BM_6 */
			<0 0x12001000 0 0xfb0>, /* 3. spm */
			<0 0x18000000 0 0x470>, /* 4. conn_infra_rgu_on */
			<0 0x18001000 0 0x658>, /* 5. conn_infra_cfg_on */
			<0 0x18003000 0 0x204>, /* 6. conn_wt_slp_ctl_reg */
			<0 0x1800e000 0 0x124>, /* 7. conn_infra_bus_cr_on */
			<0 0x18011000 0 0x138>, /* 8. conn_infra_cfg */
			<0 0x18012000 0 0x98>,  /* 9. conn_infra_clkgen_top */
			<0 0x18020000 0 0x4c>,  /* 10. conn_von_bus_bcrm */
			<0 0x18023000 0 0xe28>, /* 11. conn_dbg_ctl */
			<0 0x1803b000 0 0x18>,  /* 12. conn_infra_on_bus_bcrm */
			<0 0x18040000 0 0x2c>,  /* 13. conn_therm_ctl */
			<0 0x18041000 0 0x140>, /* 14. conn_afe_ctl */
			<0 0x18042000 0 0x324>, /* 15. conn_rf_spi_mst_reg */
			<0 0x1804b000 0 0x414>, /* 16. conn_infra_bus_cr */
			<0 0x1804d000 0 0x41c>, /* 17. conn_infra_off_debug_ctrl_ao */
			<0 0x1804f000 0 0x148>, /* 18. conn_infra_off_bus_bcrm */
			<0 0x18051000 0 0x1000>,/* 19. conn_infra_sysram_sw_cr */
			<0 0x18060000 0 0xbf8>, /* 20. conn_host_csr_top */
			<0 0x18070000 0 0x7004>;/* 21. conn_semaphore */
		power-domains = <&scpsys MT6990_POWER_DOMAIN_CONN_ON>;
		emi-addr = <0>;
		emi-size = <0>;
		fw-binary-size = <0x80000>;
		fw-data-size = <0>;
		ap-shared-size = <0x78000>;
		ap-no-perm-size = <0>;
		gps-emi-offset = <0x80000>;
		emi-alignment = <0x10000>;
		emi-max-addr = <0xffffffff>;
		radio-support = "gps";
		tcxo_support = "false";
	};

        firmware {
                optee {
                        compatible = "linaro,optee-tz";
                        method = "smc";
                };
        };

	met {
	met_emi: met_emi {
		compatible = "mediatek,met_emi";
		emi_num = <1>;
		dram_num = <2>;
		dramc_ver = <2>;
		/* 0: dram ebg, 1:emi_freq, 2: DRAMC_DCM_CTRL 3:chn_emi_low_effi */
		/* 4: SLC */
		met_emi_support_list = <0x5>;
		cen_emi_reg_base = <0x10217000>;
		cen_emi_reg_size = <0x1000>;
		chn_emi_reg_base = <0x10235000 0x10245000>;
		chn_emi_reg_size = <0x1000>;
		dramc_nao_reg_base = <0x10234000 0x10244000>;
		dramc_nao_reg_size = <0x1000>;
		dramc_ao_reg_base = <0x10230000 0x10240000>;
		dramc_ao_reg_size = <0x2000>;
		ddrphy_ao_reg_base = <0x10238000 0x10248000>;
		ddrphy_ao_reg_size = <0x2000>;
		ddrphy_ao_misc_cg_ctrl0 = <0x70C>;
		ddrphy_ao_misc_cg_ctrl2 = <0x714>;
		dram_freq_default = <6400>;
		ddr_ratio_default = <8>;
		dram_type_default = <8>;
		apmixedsys_reg_base = <0x1000C000>;
		apmixedsys_reg_size = <0x410>;
		slc_pmu_reg_base = <0x10342000 0x10343000>;
		slc_pmu_reg_size = <0x1000>;
	};
};
};


&spmi_bus {
	/* TODO: temp change slv from 4 to 6 for mt6330 co-exist */
	pmic: mt6361@4 {
		compatible = "mediatek,mt6361";
		reg = <0x4 SPMI_USID 0xb SPMI_GSID>;
		interrupts = <4>;
		#address-cells = <1>;
		#size-cells = <0>;
		interrupt-controller;
		#interrupt-cells = <1>;
		pmic_auxadc: adc {
			compatible = "mediatek,mt6361-adc";
			#io-channel-cells = <1>;
		};
		pmic_efuse: efuse {
			compatible = "mediatek,mt6361-efuse";
			#address-cells = <1>;
			#size-cells = <1>;
			thermal_efuse_data1: t_e_6361@0 {
				reg = <0 12>;
			};
		};
		led-controller {
			compatible = "mediatek,mt6361-isink";
			#address-cells = <1>;
			#size-cells = <0>;
			interrupts = <MT6361_FLAG_ISINK1_SHORT>,
				     <MT6361_FLAG_ISINK1_OPEN>,
				     <MT6361_FLAG_ISINK2_SHORT>,
				     <MT6361_FLAG_ISINK2_OPEN>,
				     <MT6361_FLAG_ISINK3_SHORT>,
				     <MT6361_FLAG_ISINK3_OPEN>;
			interrupt-names = "isink1_short", "isink1_open",
					  "isink2_short", "isink2_open",
					  "isink3_short", "isink3_open";

			led@0 {
				reg = <0>;
				label = "5g_evb_air_plane";
				led-max-microamp = <12000>;
				linux,default-trigger = "none";
				default-state = "off";
				soft-start-en = <1>;
			};
			led@1 {
				reg = <1>;
				label = "5g_evb_net_status";
				led-max-microamp = <12000>;
				linux,default-trigger = "none";
				default-state = "off";
				soft-start-en = <1>;
			};
			/*	modified by quectel,RG620T-SBK use gpio16 to control system led replace isink3
			led@2 {
				reg = <2>;
				label = "5g_evb_system";
				led-max-microamp = <12000>;
				linux,default-trigger = "none";
				default-state = "off";
				soft-start-en = <1>;

			};*/
		};
		keys {
			compatible = "mediatek,mt6361-keys";
			interrupts = <MT6361_FLAG_PWRKEY>,
				     <MT6361_FLAG_PWRKEY_LP>,
				     <MT6361_FLAG_PWRKEY_SP>,
				     <MT6361_FLAG_PMIC_RESETB_LP>,
				     <MT6361_FLAG_PMIC_RESETB_SP>;
			interrupt-names = "pwrkey", "pwrkey_lp", "pwrkey_sp",
					  "pmic_resetb_lp", "pmic_resetb_sp";
			resetb_sp_tsel = <1>; /* 0.5/1/2/3 sec */
			resetb_sp_mode = <2>;
			/* [short press mode]
			 * 0: interupt only
			 * 1: pmic rg reset
			 * 2: sysrstb: low -> 8ms -> high
			 * 3: warm reset: pmic rg reset and sysrstb: low -> 8ms -> high
			 */
			resetb_lp_tsel = <3>; /* 4/6/8/10/12/14/16/18 sec */
			resetb_lp_mode = <0>;
			/* [long press mode]
			 * 0: interupt only
			 * 1: exception shutdown and pmic rg reset
			 * 2: seq-off -> reset pmic rg
			 * 3: cold reset:
			 *    seq-off and reset pmic rg -> min-off time -> reboot
			 * 4: sysrstb: low -> 8ms -> high
			 */
			pwrkey_sp_tsel = <0>; /* 0.5/1/2/3 sec */
			pwrkey_sp_mode = <0>;
			pwrkey_lp_tsel = <2>; /* 4/6/8/10/12/14/16/18 sec */
			pwrkey_lp_mode = <1>;
		};
		dbg {
			compatible = "mediatek,mt6361-dbg";
		};
		pinctrl: pinctrl {
			compatible = "mediatek,mt6361-pinctrl";
			gpio-controller;
			#gpio-cells = <2>;
			gpio-ranges = <&pinctrl 0 0 12>;
		};

		mt6361-consys {
			compatible = "mediatek,mt6361-consys";
		};

		regulator {
			compatible = "mediatek,mt6361-regulator";
			mt6361_ldo1_vcn15_reg: LDO1 {
				regulator-name = "vcn15";
				regulator-min-microvolt = <600000>;
				regulator-max-microvolt = <2200000>;
				interrupts = <MT6361_FLAG_LDO01_VCN15_PGB>,
					     <MT6361_FLAG_LDO01_VCN15_OC>;
				interrupt-names = "pgb", "oc";
				regulator-allowed-modes = <MT6361_OPMODE_NORMAL
							   MT6361_OPMODE_LP>;
			};
			mt6361_ldo2_vrfio18_reg: LDO2 {
				regulator-name = "vrfio18";
				regulator-min-microvolt = <600000>;
				regulator-max-microvolt = <2200000>;
				regulator-always-on;
				interrupts = <MT6361_FLAG_LDO02_VRFIO18_PGB>,
					     <MT6361_FLAG_LDO02_VRFIO18_OC>;
				interrupt-names = "pgb", "oc";
			};
			mt6361_ldo3_vio18_reg: LDO3 {
				regulator-name = "vio18";
				regulator-min-microvolt = <600000>;
				regulator-max-microvolt = <2200000>;
				regulator-always-on;
				interrupts = <MT6361_FLAG_LDO03_VIO18_PGB>,
					     <MT6361_FLAG_LDO03_VIO18_OC>;
				interrupt-names = "pgb", "oc";
			};
			mt6361_ldo4_vrf18_reg: LDO4 {
				regulator-name = "vrf18";
				regulator-min-microvolt = <600000>;
				regulator-max-microvolt = <2200000>;
				interrupts = <MT6361_FLAG_LDO04_VRF18_PGB>,
					     <MT6361_FLAG_LDO04_VRF18_OC>;
				interrupt-names = "pgb", "oc";
			};
			mt6361_ldo5_vrf18aif_reg: LDO5 {
				regulator-name = "vrf18aif";
				regulator-min-microvolt = <600000>;
				regulator-max-microvolt = <2200000>;
				interrupts = <MT6361_FLAG_LDO05_VRF18AIF_PGB>,
					     <MT6361_FLAG_LDO05_VRF18AIF_OC>;
				interrupt-names = "pgb", "oc";
			};
			mt6361_ldo6_va15_reg: LDO6 {
				regulator-name = "va15";
				regulator-min-microvolt = <600000>;
				regulator-max-microvolt = <2200000>;
				regulator-always-on;
				interrupts = <MT6361_FLAG_LDO06_VA15_PGB>,
					     <MT6361_FLAG_LDO06_VA15_OC>;
				interrupt-names = "pgb", "oc";
			};
			mt6361_ldo7_vio075_reg: LDO7 {
				regulator-name = "vio075";
				regulator-min-microvolt = <600000>;
				regulator-max-microvolt = <1100000>;
				regulator-always-on;
				interrupts = <MT6361_FLAG_LDO07_VIO075_PGB>,
					     <MT6361_FLAG_LDO07_VIO075_OC>;
				interrupt-names = "pgb", "oc";
			};
			mt6361_ldo8_va12_1_reg: LDO8 {
				regulator-name = "va12_1";
				regulator-min-microvolt = <600000>;
				regulator-max-microvolt = <2200000>;
				regulator-always-on;
				interrupts = <MT6361_FLAG_LDO08_VA12_1_PGB>,
					     <MT6361_FLAG_LDO08_VA12_1_OC>;
				interrupt-names = "pgb", "oc";
			};
			mt6361_ldo9_va12_2_reg: LDO9 {
				regulator-name = "va12_2";
				regulator-min-microvolt = <600000>;
				regulator-max-microvolt = <2200000>;
				regulator-always-on;
				interrupts = <MT6361_FLAG_LDO09_VA12_2_PGB>,
					     <MT6361_FLAG_LDO09_VA12_2_OC>;
				interrupt-names = "pgb", "oc";
			};
			mt6361_ldo10_vsram_proc_reg: LDO10 {
				regulator-name = "vsram_proc";
				regulator-min-microvolt = <400000>;
				regulator-max-microvolt = <1193750>;
				regulator-always-on;
				interrupts = <MT6361_FLAG_LDO10_VSRAM_PROC_PGB>,
					     <MT6361_FLAG_LDO10_VSRAM_PROC_OC>;
				interrupt-names = "pgb", "oc";
			};
			mt6361_ldo11_vrf13_reg: LDO11 {
				regulator-name = "vrf13";
				regulator-min-microvolt = <900000>;
				regulator-max-microvolt = <1910000>;
				interrupts = <MT6361_FLAG_LDO11_VRF13_PGB>,
					     <MT6361_FLAG_LDO11_VRF13_OC>;
				interrupt-names = "pgb", "oc";
			};
			mt6361_ldo12_vrf13aif_reg: LDO12 {
				regulator-name = "vrf13aif";
				regulator-min-microvolt = <900000>;
				regulator-max-microvolt = <1910000>;
				interrupts = <MT6361_FLAG_LDO12_VRF13AIF_PGB>,
					     <MT6361_FLAG_LDO12_VRF13AIF_OC>;
				interrupt-names = "pgb", "oc";
			};
			mt6361_ldo13_vrf12_reg: LDO13 {
				regulator-name = "vrf12";
				regulator-min-microvolt = <600000>;
				regulator-max-microvolt = <2200000>;
				regulator-always-on;
				interrupts = <MT6361_FLAG_LDO13_VRF12_PGB>,
					     <MT6361_FLAG_LDO13_VRF12_OC>;
				interrupt-names = "pgb", "oc";
			};
			mt6361_ldo14_vmdd2h_reg: LDO14 {
				regulator-name = "vmdd2h";
				regulator-min-microvolt = <550000>;
				regulator-max-microvolt = <1900000>;
				interrupts = <MT6361_FLAG_LDO14_VMDD2H_PGB>,
					     <MT6361_FLAG_LDO14_VMDD2H_OC>;
				interrupt-names = "pgb", "oc";
			};
			mt6361_ldo14_vmdd2h_e2_reg: LDO14_E2 {
				regulator-name = "vmdd2h";
				regulator-min-microvolt = <550000>;
				regulator-max-microvolt = <1850000>;
				interrupts = <MT6361_FLAG_LDO14_VMDD2H_PGB>,
					     <MT6361_FLAG_LDO14_VMDD2H_OC>;
				interrupt-names = "pgb", "oc";
			};
			mt6361_ldo15_vmdd2l_reg: LDO15 {
				regulator-name = "vmdd2l";
				regulator-min-microvolt = <550000>;
				regulator-max-microvolt = <1900000>;
				regulator-always-on;
				interrupts = <MT6361_FLAG_LDO15_VMDD2L_PGB>,
					     <MT6361_FLAG_LDO15_VMDD2L_OC>;
				interrupt-names = "pgb", "oc";
			};
			mt6361_ldo15_vmdd2l_e2_reg: LDO15_E2 {
				regulator-name = "vmdd2l";
				regulator-min-microvolt = <550000>;
				regulator-max-microvolt = <1850000>;
				regulator-always-on;
				interrupts = <MT6361_FLAG_LDO15_VMDD2L_PGB>,
					     <MT6361_FLAG_LDO15_VMDD2L_OC>;
				interrupt-names = "pgb", "oc";
			};
			mt6361_ldo16_vrf09_reg: LDO16 {
				regulator-name = "vrf09";
				regulator-min-microvolt = <900000>;
				regulator-max-microvolt = <1910000>;
				interrupts = <MT6361_FLAG_LDO16_VRF09_PGB>,
					     <MT6361_FLAG_LDO16_VRF09_OC>;
				interrupt-names = "pgb", "oc";
			};
			mt6361_ldo16_vrf09_e2_reg: LDO16_E2 {
				regulator-name = "vrf09";
				regulator-min-microvolt = <800000>;
				regulator-max-microvolt = <1800000>;
				interrupts = <MT6361_FLAG_LDO16_VRF09_PGB>,
					     <MT6361_FLAG_LDO16_VRF09_OC>;
				interrupt-names = "pgb", "oc";
			};
			mt6361_ldo17_vrf09aif_reg: LDO17 {
				regulator-name = "vrf09aif";
				regulator-min-microvolt = <900000>;
				regulator-max-microvolt = <1910000>;
				interrupts = <MT6361_FLAG_LDO17_VRF09AIF_PGB>,
					     <MT6361_FLAG_LDO17_VRF09AIF_OC>;
				interrupt-names = "pgb", "oc";
			};
			mt6361_ldo17_vrf09aif_e2_reg: LDO17_E2 {
				regulator-name = "vrf09aif";
				regulator-min-microvolt = <800000>;
				regulator-max-microvolt = <1800000>;
				interrupts = <MT6361_FLAG_LDO17_VRF09AIF_PGB>,
					     <MT6361_FLAG_LDO17_VRF09AIF_OC>;
				interrupt-names = "pgb", "oc";
			};
			mt6361_ldo18_vsram_digrf_reg: LDO18 {
				regulator-name = "vsram_digrf";
				regulator-min-microvolt = <400000>;
				regulator-max-microvolt = <1193750>;
				regulator-always-on;
				interrupts = <MT6361_FLAG_LDO18_VSRAM_DIGRF_PGB>,
					     <MT6361_FLAG_LDO18_VSRAM_DIGRF_OC>;
				interrupt-names = "pgb", "oc";
			};
			mt6361_ldo19_vsram_modem_reg: LDO19 {
				regulator-name = "vsram_modem";
				regulator-min-microvolt = <400000>;
				regulator-max-microvolt = <1193750>;
				regulator-always-on;
				interrupts = <MT6361_FLAG_LDO19_VSRAM_MODEM_PGB>,
					     <MT6361_FLAG_LDO19_VSRAM_MODEM_OC>;
				interrupt-names = "pgb", "oc";
			};
			mt6361_ldo21_vsram_core_reg: LDO21 {
				regulator-name = "vsram_core";
				regulator-min-microvolt = <400000>;
				regulator-max-microvolt = <1193750>;
				regulator-always-on;
				interrupts = <MT6361_FLAG_LDO21_VSRAM_CORE_PGB>,
					     <MT6361_FLAG_LDO21_VSRAM_CORE_OC>;
				interrupt-names = "pgb", "oc";
			};
			mt6361_ldo22_vmddr_reg: LDO22 {
				regulator-name = "vmddr";
				regulator-min-microvolt = <400000>;
				regulator-max-microvolt = <1193750>;
				regulator-always-on;
				interrupts = <MT6361_FLAG_LDO22_VMDDR_PGB>,
					     <MT6361_FLAG_LDO22_VMDDR_OC>;
				interrupt-names = "pgb", "oc";
			};
			mt6361_ldo23_vmddq_reg: LDO23 {
				regulator-name = "vmddq";
				regulator-min-microvolt = <266000>;
				regulator-max-microvolt = <794320>;
				interrupts = <MT6361_FLAG_LDO23_VMDDQ_PGB>,
					     <MT6361_FLAG_LDO23_VMDDQ_OC>;
				interrupt-names = "pgb", "oc";
			};
			mt6361_ldo23_vmddq_e2_reg: LDO23_E2 {
				regulator-name = "vmddq";
				regulator-min-microvolt = <250000>;
				regulator-max-microvolt = <1043750>;
				interrupts = <MT6361_FLAG_LDO23_VMDDQ_PGB>,
					     <MT6361_FLAG_LDO23_VMDDQ_OC>;
				interrupt-names = "pgb", "oc";
			};
			mt6361_ldo24_vaux18_reg: LDO24 {
				regulator-name = "vaux18";
				regulator-min-microvolt = <1800000>;
				regulator-max-microvolt = <3400000>;
				regulator-always-on;
				interrupts = <MT6361_FLAG_LDO24_VAUX18_PGB>,
					     <MT6361_FLAG_LDO24_VAUX18_OC>;
				interrupt-names = "pgb", "oc";
			};
			mt6361_ldo25_vsim1_reg: LDO25 {
				regulator-name = "vsim1";
				regulator-min-microvolt = <0>;
				/* regulator-min-microvolt = <1200000>; */
				regulator-max-microvolt = <3600000>;
				interrupts = <MT6361_FLAG_LDO25_VSIM1_PGB>,
					     <MT6361_FLAG_LDO25_VSIM1_OC>;
				interrupt-names = "pgb", "oc";
			};
			mt6361_ldo26_vsim2_reg: LDO26 {
				regulator-name = "vsim2";
				regulator-min-microvolt = <0>;
				/* regulator-min-microvolt = <1200000>; */
				regulator-max-microvolt = <3600000>;
				interrupts = <MT6361_FLAG_LDO26_VSIM2_PGB>,
					     <MT6361_FLAG_LDO26_VSIM2_OC>;
				interrupt-names = "pgb", "oc";
			};
			mt6361_ldo27_vusb_reg: LDO27 {
				regulator-name = "vusb";
				regulator-min-microvolt = <1200000>;
				regulator-max-microvolt = <3600000>;
				interrupts = <MT6361_FLAG_LDO27_VUSB_PGB>,
					     <MT6361_FLAG_LDO27_VUSB_OC>;
				interrupt-names = "pgb", "oc";
			};
			mt6361_ldo28_vmc_reg: LDO28 {
				regulator-name = "vmc";
				regulator-min-microvolt = <1200000>;
				regulator-max-microvolt = <3600000>;
				interrupts = <MT6361_FLAG_LDO28_VMC_PGB>,
					     <MT6361_FLAG_LDO28_VMC_OC>;
				interrupt-names = "pgb", "oc";
			};
			mt6361_ldo29_vefuse_reg: LDO29 {
				regulator-name = "vefuse";
				regulator-min-microvolt = <1200000>;
				regulator-max-microvolt = <3600000>;
				interrupts = <MT6361_FLAG_LDO29_VEFUSE_PGB>,
					     <MT6361_FLAG_LDO29_VEFUSE_OC>;
				interrupt-names = "pgb", "oc";
			};
			mt6361_ldo30_vproc15_reg: LDO30 {
				regulator-name = "vproc15";
				regulator-min-microvolt = <1500000>;
				regulator-max-microvolt = <3100000>;
				interrupts = <MT6361_FLAG_LDO30_VPROC15_PGB>,
					     <MT6361_FLAG_LDO30_VPROC15_OC>;
				interrupt-names = "pgb", "oc";
			};
			mt6361_buck1_vs1_reg: BUCK1 {
				regulator-name = "vs1";
				regulator-min-microvolt = <12500>;
				regulator-max-microvolt = <3187500>;
				regulator-always-on;
				interrupts = <MT6361_FLAG_BUCK1_VS1_PGB>,
					     <MT6361_FLAG_BUCK1_VS1_OC>;
				interrupt-names = "pgb", "oc";
			};
			mt6361_buck2_vs2_reg: BUCK2 {
				regulator-name = "vs2";
				regulator-min-microvolt = <12500>;
				regulator-max-microvolt = <3187500>;
				regulator-always-on;
				interrupts = <MT6361_FLAG_BUCK2_VS2_PGB>,
					     <MT6361_FLAG_BUCK2_VS2_OC>;
				interrupt-names = "pgb", "oc";
			};
			mt6361_buck3_vs3_reg: BUCK3 {
				regulator-name = "vs3";
				regulator-min-microvolt = <6250>;
				regulator-max-microvolt = <1593750>;
				regulator-always-on;
				interrupts = <MT6361_FLAG_BUCK3_VS3_PGB>,
					     <MT6361_FLAG_BUCK3_VS3_OC>;
				interrupt-names = "pgb", "oc";
			};
			mt6361_buck4_vcore_reg: BUCK4 {
				regulator-name = "vcore";
				regulator-min-microvolt = <6250>;
				regulator-max-microvolt = <1593750>;
				regulator-always-on;
				regulator-allowed-modes = <MT6361_OPMODE_NORMAL
							   MT6361_OPMODE_LP
							   MT6361_OPMODE_FCCM>;
				interrupts = <MT6361_FLAG_BUCK4_VCORE_PGB>,
					     <MT6361_FLAG_BUCK4_VCORE_OC>;
				interrupt-names = "pgb", "oc";
			};
			mt6361_buck5_vdd2h_reg: BUCK5 {
				regulator-name = "vdd2h";
				regulator-min-microvolt = <6250>;
				regulator-max-microvolt = <1593750>;
				regulator-always-on;
				interrupts = <MT6361_FLAG_BUCK5_VDD2H_PGB>,
					     <MT6361_FLAG_BUCK5_VDD2H_OC>;
				interrupt-names = "pgb", "oc";
			};
			mt6361_buck6_cpu_reg: BUCK6 {
				regulator-name = "cpu";
				regulator-min-microvolt = <6250>;
				regulator-max-microvolt = <1593750>;
				regulator-always-on;
				interrupts = <MT6361_FLAG_BUCK6_CPU_PGB>,
					     <MT6361_FLAG_BUCK6_CPU_OC>;
				interrupt-names = "pgb", "oc";
			};
			mt6361_buck7_vddq_reg: BUCK7 {
				regulator-name = "vddq";
				regulator-min-microvolt = <6250>;
				regulator-max-microvolt = <1593750>;
				regulator-always-on;
				interrupts = <MT6361_FLAG_BUCK7_VDDQ_PGB>,
					     <MT6361_FLAG_BUCK7_VDDQ_OC>;
				interrupt-names = "pgb", "oc";
			};
			mt6361_buck8_vrfdig_reg: BUCK8 {
				regulator-name = "vrfdig";
				regulator-min-microvolt = <6250>;
				regulator-max-microvolt = <1593750>;
				regulator-always-on;
				interrupts = <MT6361_FLAG_BUCK8_VRFDIG_PGB>,
					     <MT6361_FLAG_BUCK8_VRFDIG_OC>;
				interrupt-names = "pgb", "oc";
			};
		};
	};
	mt6319_6: mt6319@6 {
		compatible = "mediatek,mt6319", "mtk,spmi-pmic";
		reg = <0x6 SPMI_USID 0xb SPMI_GSID>;
		extbuck_debug {
			compatible = "mediatek,extbuck-debug";
		};

		mt6319_6_regulator: mt6319_6_regulator {
			compatible = "mediatek,mt6319_6-regulator";

			buck-size = <3>;
			buck1-modeset-mask = <0x1>;
			buck2-modeset-mask = <0x2>;
			buck3-modeset-mask = <0x4>;

			mt6319_6_vbuck1: 6_vbuck1 {
				regulator-compatible = "vbuck1";
				regulator-name = "6_vbuck1";
				regulator-min-microvolt = <300000>;
				regulator-max-microvolt = <1193750>;
				regulator-allowed-modes = <0 1 2 4>;
				regulator-always-on;
			};

			mt6319_6_vbuck2: 6_vbuck2 {
				regulator-compatible = "vbuck2";
				regulator-name = "6_vbuck2";
				regulator-min-microvolt = <300000>;
				regulator-max-microvolt = <1193750>;
				regulator-allowed-modes = <0 1 2 4>;
				regulator-always-on;
				};

			mt6319_6_vbuck3: 6_vbuck3 {
				regulator-compatible = "vbuck3";
				regulator-name = "6_vbuck3";
				regulator-min-microvolt = <300000>;
				regulator-max-microvolt = <1193750>;
				regulator-allowed-modes = <0 1 2 4>;
				regulator-always-on;
			};

		};
	};

	md1_sim1_hot_plug_eint: md1_sim1_hot_plug_eint {
	};

	md1_sim2_hot_plug_eint: md1_sim2_hot_plug_eint {
	};

	md1_pmic1_eint: md1_pmic1_eint {
	};

	mt6685:	mt6685_mfd {
		compatible = "mediatek,mt6685";
		reg = <0x9 SPMI_USID>;
		mt6685_rtc: mt6685_rtc {
			compatible = "mediatek,mt6685-rtc";
			interrupts = <0x9 IRQ_TYPE_NONE>;
			interrupt-names = "rtc";
			base = <0x580>;

			#address-cells = <1>;
			#size-cells = <1>;

			fg_init: fg_init {
				reg = <0 0x1>;
			};
			fg_soc: fg_soc {
				reg = <1 0x1>;
			};
			ext_32k: ext_32k {
				reg = <2 0x1>;
				bits = <6 1>;
			};
		};
		mt6685_consys: mt6685_consys {
			compatible = "mediatek,mt6685-consys";
		};
		mt6685_clock_buffer: mt6685_clock_buffer {
			compatible = "mediatek,clock_buffer";
			mediatek,xo-mode-num = <3>;
			mediatek,xo-buf-support = <1 1 0 1 1> /* BBCK */,
						<1 0 0> /* RFCK1 */,
						<1 1 0> /* RFCK2 */,
						<0 0> /* CONCK */;
			mediatek,xo-buf-allow-control = <0 1 1 0 1>,
						<1 1 1>,
						<1 1 1>,
						<1 1>;
			mediatek,xo-buf-name = "XO_BBCK1", "XO_BBCK2",
					"XO_BBCK3", "XO_BBCK4", "XO_BBCK5",
					"XO_RFCK1A", "XO_RFCK1B", "XO_RFCK1C",
					"XO_RFCK2A", "XO_RFCK2B", "XO_RFCK2C",
					"XO_CONCK1", "XO_CONCK2";
			mediatek,bblpm-support;
			mediatek,xo-voter-support;
			mediatek,dcxo-de-sense-support;
			mediatek,dcxo-impedance-support;
			mediatek,dcxo-spmi-rw;
			mediatek,pmrc-en-support;

			mediatek,enable;

			clkbuf_ctl = <&clock_buffer_ctrl>;
		};

	};
};
#include "cust_mt6990_msdc.dtsi"
#include "mt6990-clkitg.dtsi"
#include "mt6990-disable-unused.dtsi"
