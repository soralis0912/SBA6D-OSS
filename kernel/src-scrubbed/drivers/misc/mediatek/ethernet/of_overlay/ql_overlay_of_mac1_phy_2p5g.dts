
/dts-v1/;
/plugin/;	/* allow undefined label references and record them */

/ {
	fragment@0 {
		target-path="/netsys@15100000/ethernet@15100000/mac@1";
		__overlay__ {
			compatible = "mediatek,eth-mac";
			reg = <1>;
			phy-mode = "2500base-x";
			fixed-link {
				speed = <2500>;
				full-duplex;
				pause;
			};
		};
	};
};