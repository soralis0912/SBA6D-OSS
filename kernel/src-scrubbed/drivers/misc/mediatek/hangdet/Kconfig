## kernel/src-scrubbed/drivers/misc/mediatek/hangdet/Kconfig
```kconfig
config MTK_AEE_HANGDET
	tristate "Enable AEE Kernel Hang Detector"
	help
	  MTK_AEE_HANGDET is the kernel config of hang detector feature
	  designed by MTK, which is the mechanism to check if each cpu
	  is alived. When cpu hang is detected, raise excetpion.
```

## kernel/src-scrubbed/drivers/misc/mediatek/hsm/Kconfig
```kconfig
#
# HSM configuration
#
config MTK_HSM_SUPPORT
	bool "Enable MTK HSM Support"
	default n
	help
	  Enable MTK HSM Support.
```

## kernel/src-scrubbed/drivers/misc/mediatek/mmstat/Kconfig
```kconfig
config MMSTAT_TRACER
	tristate "Trace memory status periodically"
	depends on TRACING
	help
	  Periodic tracing of memory status.

	  Mmstat tracer will track memory usage periodically according to
	  indicated timer interval, which includes meminfo, buddy system,
	  hardware memory(if possible) and process memory.

config MMSTAT_PAGE_DETAIL
	tristate "Mmstat trace enhancement for page allocation"
	depends on MMSTAT_TRACER
	help
	  Add DMA/PAGE_FRAG allocation status.

	  Since direct page allocation is difficult to analysis, add two
	  sub categories DMA / PAGE_FRAG to divide direct page allocation
	  into hardware driver(DMA), network driver(page_frag) or others.
```

## kernel/src-scrubbed/drivers/misc/mediatek/pcie/Kconfig
```kconfig
config MTK_PCIE
	bool "Mediatek PCIe misc setting"
	help
	  Set Y to add support for the misc settings of MediaTek PCIe.
	  If unsure, Set N.

config MTK_PCIE_EP
	bool "Mediatek PCIe EP mode"
	depends on MTK_PCIE
	help
	  Set Y to support PCIe EP mode.
	  If unsure, Set N.

config MTK_PCIE_DIPC
	bool "Mediatek PCIe Dual IPC"
	depends on MTK_PCIE_EP
	select MTK_MHCCIF
	help
	  Set Y to add PCIe dual IPC support,
	  If unsure, Set N.

config MTK_PCIE_SMT_SUPPORT
	bool "Mediatek PCIe SMT test"
	depends on MTK_PCIE
	help
	  PCIe loopback test for SMT.
	  Set Y to enable this feature.
	  If unsure, Set N.

config PCIE_MEDIATEK_COLGIN
	tristate "MediaTek COLGIN PCIe MAC controller"
	depends on ARCH_MEDIATEK || COMPILE_TEST
	depends on OF
	depends on PCI_MSI_IRQ_DOMAIN
	help
	  Say Y here if you want to enable PCIe GEN3 MAC controller
	  support on MediaTek SoCs.
```

## kernel/src-scrubbed/drivers/misc/mediatek/pidmap/Kconfig
```kconfig
config MTK_PID_MAP
	tristate "Map of PID and Task Name"
	depends on MTK_AEE_FEATURE && TRACEPOINTS
	help
	  Enable task name recorder to
	  provide more pid and task name mappings.
	  More memory will be required for this feature,
	  so please consider the trade-off.
```

## kernel/src-scrubbed/drivers/misc/mediatek/ppe/Kconfig
```kconfig
config MTK_PPE
	tristate "MediaTek SoC PPE support"
	---help---
	  This driver supports PPE for linux flowtable
```

## kernel/src-scrubbed/drivers/misc/mediatek/scdk/Kconfig
```kconfig
config MTK_SCDK
	tristate "MTK SCD kernel module"
	help
		SCDK is a MediaTek kernel module for SCD(System Control Daemon) on openwrt platform.
		SCDK provide ATF accessibility for SCD which do system related settings.
```

## kernel/src-scrubbed/drivers/misc/mediatek/sensor/iio/Kconfig
```kconfig
config MTK_BMP380_IIO_SUPPORT
	bool "MTK_BMP380_IIO_SUPPORT for MediaTek package"
	default n
	help
	  Enable MTK BMP380 IIO subsystem support.
	  BMP380 is a low-power and low-noise
	  barometric pressure sensor.
	  If in doubt, say N here.

source "drivers/misc/mediatek/sensor/iio/smi230/accel/Kconfig"
source "drivers/misc/mediatek/sensor/iio/smi230/gyro/Kconfig"
```

## kernel/src-scrubbed/drivers/net/phy/rtl8251/Kconfig
```kconfig
config QUEC_REALTEK_RTL8251
	bool "Quec support Realtek PHYs"
	---help---
	  Supports the Realtek 8251 PHY.
```

## kernel/src-scrubbed/drivers/quectel-drivers/Kconfig
```kconfig
config QUECTEL_DRIVERS
	bool "Quectel drivers Supports"
	---help---
	  Supports quectel drivers.


config QL_GPIO_SYSFS
	bool "Quectel gpio sysfs Supports"
	---help---
	  Supports quectel gpio sysfs.

config QL_PWM_FANS
	bool "Quectel pwm fan Supports"
	---help---
	  Supports quectel pwm fan.

source "drivers/quectel-drivers/rawdata/Kconfig"
source "drivers/quectel-drivers/power/Kconfig"
source "drivers/quectel-drivers/fcm360w/Kconfig"
source "drivers/quectel-drivers/br_trigger/Kconfig"
```

## kernel/src-scrubbed/drivers/quectel-drivers/br_trigger/Kconfig
```kconfig
config QUECTEL_BR_TRIG
	tristate "Quectel br link trigger Supports"
    depends on QUECTEL_DRIVERS
	---help---
	  Supports quectel br link trigger drivers.
```

## kernel/src-scrubbed/drivers/quectel-drivers/fcm360w/Kconfig
```kconfig
config QL_FCM360W_WIFI
    bool "Quectel FCM360W Wi-Fi"
    default n
    help
      FCM360W Wi-Fi Device Tree Setting(SPI and IRQ GPIO)
```

## kernel/src-scrubbed/drivers/quectel-drivers/power/Kconfig
```kconfig
config QUECTEL_PWR_DRV
	bool "Quectel power drivers Supports"
    depends on QUECTEL_DRIVERS
	---help---
	  Supports quectel power drivers.
```

## kernel/src-scrubbed/drivers/thermal/mediatek/Kconfig
```kconfig
config MTK_THERMAL
	tristate "Mediatek thermal drivers"
	depends on THERMAL_OF
	help
	  This is the option for Mediatek thermal software
	  solutions. Please enable corresponding options to
	  get temperature information from thermal sensors or
	  turn on throttle mechaisms for thermal mitigation.

if MTK_THERMAL

config MTK_SOC_THERMAL
	tristate "Temperature sensor driver for Mediatek SoCs"
	depends on HAS_IOMEM
	depends on NVMEM || NVMEM=n
	depends on RESET_CONTROLLER
	help
	  Enable this option if you want to get SoC temperature
	  information for Mediatek platforms. This driver
	  configures thermal controllers to collect temperature
	  via AUXADC interface.

config MTK_SOC_THERMAL_LVTS
	tristate "LVTS (Low voltage thermal sensor) driver for Mediatek SoCs"
	depends on HAS_IOMEM
	depends on NVMEM
	depends on RESET_TI_SYSCON
	help
	  Enable this option if you want to get SoC temperature
	  information for Mediatek platforms. This driver
	  configures LVTS thermal controllers to collect temperatures
	  via ASIF interface.

config MTK_BOARD_THERMAL
	tristate "On-board NTC thermistor driver for Mediatek SoCs"
	help
	  Enable this option if you want to get PCB temperature
	  via on-board NTC for Mediatek platforms.
	  This driver reads the voltage value from TIA hardware
	  which is responsible for reading all PMIC AUXADC channels
	  sequentially. The address of TIA register for each channel
	  and temperature convert table should be specified in
	  device tree.

config MTK_PMIC_THERMAL
	tristate "PMIC thermal sensor driver for Mediatek SoCs"
	help
	  Enable this option if you want to get PMIC temperature
	  for Mediatek platforms.
	  This driver reads the voltage value from PMIC AUXADC channels,
	  and converts raw value to PMIC temperature via PMIC efuse data.

config MTK_MD_THERMAL
	tristate "Mediatek Modem cooling framework"
	depends on MTK_ECCCI_DRIVER
	help
	  Enable this option to turn on modem throttle mechanisms
	  for Mediatek platforms.
	  This option depends on MTK_ECCCI_DRIVER which is the
	  IPC interface between AP SoC and modem.

if MTK_MD_THERMAL

config MTK_MD_THERMAL_MUTT
	tristate "Mediatek modem uplink throughput throttle driver"
	help
	  Enable this option if you want to use modem
	  uplink throughput throttle cooler for Mediatek
	  platforms.
	  The throttling levels are defined in modem.

config MTK_MD_THERMAL_TX_POWER
	tristate "Mediatek modem TX power throttle driver"
	help
	  Enable this option if you want use modem TX power
	  throttle cooler for Mediatek platforms.
	  This feature is only supported for mt6297 or later
	  modem platforms.

config MTK_MD_THERMAL_SCG_OFF
	tristate "Mediatek modem SCG cell off driver"
	help
	  Enable this option if you want use modem SCG cell
	  throttle cooler for Mediatek platforms.
	  This feature is only supported for mt6297 or later
	  modem platforms.

config MTK_MD_THERMAL_SYSFS
	tristate "Mediatek modem throttle sysfs driver"
	default n
	help
	  Enable this option if you want to use sysfs debug
	  interface for Mediatek modem coolers.
	  This option should be enabled only for HW power
	  evaluation purpose.
endif

config MTK_MD_RF_THERMAL
	tristate "Mediatek modem RF thermal zone driver"
	depends on MTK_ECCCI_DRIVER
	help
	  Enable this option if you want to get modem RF
	  temperature information for Mediatek platforms.
	  This driver queries temperature via CCCI interface
	  and handles the feedback from modem in the callback
	  function which is registered to CCCI driver at
	  driver initialization stage.

config MTK_THERMAL_IPI
	tristate "Mediatek thermal IPI interface driver"
	depends on MTK_TINYSYS_SSPM_SUPPORT
	help
	  Enable this option if you want to use and communicate
	  with tinysys microprocessors for Mediatek platforms.
	  This driver defines thermal ipi commands and provides an
	  API to send a ipi command to tinysys microprocessors.

if MTK_THERMAL_IPI
config MTK_THERMAL_TRM
	tristate "Mediatek thermal risk monitor (TRM) driver"
	help
	  Enable this option if you want to offload Linux thermal
	  framework (LTF) onto a tinysys microprocesssor when AP MCU
	  suspended. TRM will take it over and keep monitoring
	  temperatures. If a device is going to overheat, TRM will
	  wake AP MCU up and give the control back to LTF.
endif
endif
```

## kernel/src-scrubbed/drivers/usb/mtu3/Kconfig
```kconfig
# SPDX-License-Identifier: GPL-2.0
#
# For MTK USB3.0 IP

config USB_MTU3
	tristate "MediaTek USB3 Dual Role controller"
	depends on USB || USB_GADGET
	depends on ARCH_MEDIATEK || COMPILE_TEST
	depends on EXTCON || !EXTCON
	select USB_XHCI_MTK if USB_SUPPORT && USB_XHCI_HCD
	help
	  Say Y or M here if your system runs on MediaTek SoCs with
	  Dual Role SuperSpeed USB controller. You can select usb
	  mode as peripheral role or host role, or both.

	  If you don't know what this is, please say N.

	  Choose M here to compile this driver as a module, and it
	  will be called mtu3.ko.


if USB_MTU3
choice
	bool "MTU3 Mode Selection"
	default USB_MTU3_DUAL_ROLE if (USB && USB_GADGET)
	default USB_MTU3_HOST if (USB && !USB_GADGET)
	default USB_MTU3_GADGET if (!USB && USB_GADGET)

config USB_MTU3_HOST
	bool "Host only mode"
	depends on USB=y || USB=USB_MTU3
	help
	  Select this when you want to use MTU3 in host mode only,
	  thereby the gadget feature will be regressed.

config USB_MTU3_GADGET
	bool "Gadget only mode"
	depends on USB_GADGET=y || USB_GADGET=USB_MTU3
	help
	  Select this when you want to use MTU3 in gadget mode only,
	  thereby the host feature will be regressed.

config USB_MTU3_DUAL_ROLE
	bool "Dual Role mode"
	depends on ((USB=y || USB=USB_MTU3) && (USB_GADGET=y || USB_GADGET=USB_MTU3))
	depends on (EXTCON=y || EXTCON=USB_MTU3)
	select USB_ROLE_SWITCH
	help
	  This is the default mode of working of MTU3 controller where
	  both host and gadget features are enabled.

endchoice

config USB_MTU3_DEBUG
	bool "Enable Debugging Messages"
	help
	  Say Y here to enable debugging messages in the MTU3 Driver.

config MTU3_MD_USB_EP0_CTRL
	bool "MD USB EP0 Control"
	depends on USB_MTU3
	default n
	help
	  EP0 will be controlled by MD USB with this option enabled.

config MTU3_USB_LOW_POWER
	bool "USB LOW POWER MODE"
	depends on USB_MTU3
	default n
	help
	  Low power mode set Y will turn off USB clock and release
	  wakelock by mtu3 when suspend.
	  If you don't know what this is, please set N.
endif

config QL_CNT_USB_IDDIG
	bool "quectel controlled usb otg id pin"
	default n
	help
	  set y could enable quectel controlled usb otg id pin function.
```
