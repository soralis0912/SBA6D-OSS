## buildroot/feeds/mtk/system/wlan_daemon/wappd/Config.in
```kconfig
menu "Configuration"
        depends on PACKAGE_wapp

config WAPP_WPACTRL_SUPPORT
	bool "Support WPACTRL in wapp"
	default n

endmenu
```
