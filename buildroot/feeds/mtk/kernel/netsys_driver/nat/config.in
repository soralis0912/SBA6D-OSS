## kernel/src-scrubbed/drivers/input/touchscreen/GT1151/Kconfig
```kconfig
#
# Touchscreen driver configuration
#
menu "GT1151 support"
	depends on TOUCHSCREEN_MTK_GT1151

config GT1151_CONFIG
	string "GT1151 for Mediatek config"
	help
	  this string is used for cfg update
endmenu
```

## kernel/src-scrubbed/drivers/input/touchscreen/focaltech_touch/Kconfig
```kconfig
#
# Focaltech Touchscreen driver configuration
#

menu "Fts Touch chip type"
	depends on TOUCHSCREEN_FTS

config FTS_CHIPTYPE
	hex "FTS Chip Type"
	default 0
	help
	   select FTS chip type(0x6336,0x5446,...)

endmenu
```

## kernel/src-scrubbed/drivers/misc/mediatek/Kconfig
```kconfig
# SPDX-License-Identifier: GPL-2.0
config MTK_CORE_NUM
        int "MTK CPU Core Num"
        default 4
        help
          Set the total cpu of the platform.
          Possible value are 2, 4.
          Default configuration is 4.

menu "Config File"
config BUILD_CONFIG_FILE
	string "build config file"
	help
	  Specify the build.config file which record toolchain environment
	  Such as "build.config.mtk.aarch64"
endmenu # Config

menu "Power, PMIC, Battery & Low Power"
source "drivers/misc/mediatek/clkbuf/Kconfig"
source "drivers/misc/mediatek/cpufreq_v1/Kconfig"
source "drivers/misc/mediatek/dvfsrc/Kconfig"
source "drivers/misc/mediatek/leakage_table/Kconfig"
source "drivers/misc/mediatek/lpm/Kconfig"
source "drivers/misc/mediatek/mcupm/Kconfig"
source "drivers/misc/mediatek/subpmic/Kconfig"
source "drivers/misc/mediatek/pmsr/Kconfig"
endmenu # Power

menu "MultiMedia, Display, Camera"
source "drivers/misc/mediatek/iommu/Kconfig"
source "drivers/misc/mediatek/cmdq/Kconfig"
source "drivers/misc/mediatek/leds/Kconfig"
endmenu # MultiMedia, Display, Camera

menu "Security"
source "drivers/misc/mediatek/security/Kconfig"
endmenu # Security


menu "Modem & Connectivity"
source "drivers/misc/mediatek/ccci_util/Kconfig"
source "drivers/misc/mediatek/ccmni/Kconfig"
source "drivers/misc/mediatek/eccci/Kconfig"
source "drivers/misc/mediatek/hsapif/Kconfig"
source "drivers/misc/mediatek/memory-amms/Kconfig"
source "drivers/misc/mediatek/connectivity/Kconfig"
endmenu # Modem

menu "Debug, log, trace"

config MTK_MET
	tristate "MET FEATURE ENABLE"
	help
	  This selects the MET profile function for MET device.
	  If you want MET feature, say m here.
	  This is needed if support for MET devices is required.
	  If unsure, say N.

config MTK_MET_PLF
	string "MET PLATFORM"
	help
	  This config is set as platform name which met driver
	  used for.

source "drivers/misc/mediatek/atf/Kconfig"
source "drivers/misc/mediatek/mtprof/Kconfig"
source "drivers/misc/mediatek/locking/Kconfig"
source "drivers/misc/mediatek/dbgtop/Kconfig"
source "drivers/misc/mediatek/aee/Kconfig"
source "drivers/misc/mediatek/hangdet/Kconfig"
source "drivers/misc/mediatek/mmstat/Kconfig"
source "drivers/misc/mediatek/sda/Kconfig"
source "drivers/misc/mediatek/monitor_hang/Kconfig"
source "drivers/misc/mediatek/pidmap/Kconfig"
source "drivers/misc/mediatek/log_store/Kconfig"
source "drivers/misc/mediatek/mtprintk/Kconfig"
source "drivers/misc/mediatek/scdk/Kconfig"
source "drivers/misc/mediatek/selinux_warning/Kconfig"
source "drivers/misc/mediatek/slt/Kconfig"
endmenu # Debug

menu "Frame Engine"
source "drivers/misc/mediatek/frame_engine/Kconfig"
endmenu # Frame Engine

menu "ETHERNET"
source "drivers/misc/mediatek/ethernet/Kconfig"
endmenu # MEDMCU

menu "MEDMCU"
source "drivers/misc/mediatek/medmcu/Kconfig"
endmenu # MEDMCU

menu "Other Peripherals"
source "drivers/misc/mediatek/typec/Kconfig"
source "drivers/misc/mediatek/extcon/Kconfig"
source "drivers/misc/mediatek/mhccif/Kconfig"
source "drivers/misc/mediatek/sensor/Kconfig"
endmenu # Other Peripheral

menu "SSPM"
source "drivers/misc/mediatek/sspm/Kconfig"
endmenu # SSPM

menu "PCIe"
source "drivers/misc/mediatek/pcie/Kconfig"
endmenu # PCIe

menu "HSM"
source "drivers/misc/mediatek/hsm/Kconfig"
endmenu # HSM

menu "CPU_BUCK"
source "drivers/misc/mediatek/cpu_buck/Kconfig"
endmenu # CPU_BUCK

menu "PPE"
source "drivers/misc/mediatek/ppe/Kconfig"
endmenu # PPE

menu "WED"
source "drivers/misc/mediatek/wed/Kconfig"
endmenu # WED
```

## kernel/src-scrubbed/drivers/misc/mediatek/ccmni/Kconfig
```kconfig
config MTK_NET_CCMNI
	tristate "MediaTek CCMNI driver"
	depends on MTK_CCCI_DEVICES
	help
	  Cross Core Multi Network Interface:
	  This option enables CCMNI driver, if yes,
	  then CCMNI driver is used
	  to communicate with CCCI
	  driver by Kernel network, if no,
	  Kernel network uses ccci port_net
	  to send and recevie data.
	  The option default depends on MTK_CCCI_DEVICES.
config MTK_ETHERNET_PDU
	tristate "Specify CCMNI support Ethernet PDU"
	default n
	help
	  Whether CCMNI MTU is enlarged to fit
	  Ethernet PDU requirement
	  driver by Kernel network, if no,
	  Set Y to enable this feature.
	  If unsure,
	  Set N to stay with legacy feature.
```

## kernel/src-scrubbed/drivers/misc/mediatek/dbgtop/Kconfig
```kconfig
config MTK_DBGTOP
	tristate "MediaTek DBGTOP driver"
	help
	  This selects the Mediatek(R) dbgtop driver.
	  Provide APIs for enabling debuggers such as the DDR
	  reserved mode (retention of DRAM after reset).
	  Provide APIs for interactions between debuggers
	  and some hardware modules.
```

## kernel/src-scrubbed/drivers/misc/mediatek/ethernet/Kconfig
```kconfig
# SPDX-License-Identifier: GPL-2.0-only
config MTK_ETHERNET
	bool "CPE/mifi ethernet driver"
	default n
	depends on ARCH_MEDIATEK
	---help---
	  If you have a Mediatek SoC with ethernet, say Y.

if MTK_ETHERNET

config MTK_ETHERNET_SOC
	tristate "MediaTek SoC Gigabit Ethernet support"
	select PHYLINK
	---help---
	  This driver supports the gigabit ethernet MACs in the
	  MediaTek SoC family.

config MTK_ETHERNET_DBG
	bool "Mediatek Ethernet debug interface"
	depends on MTK_ETHERNET_SOC

config MEDIATEK_NETSYS_V2
	bool "Mediatek Netsys Version 2"
	default n

config MTK_ETHERNET_DYNAMIC_SGMII
	bool "Dynamic Mediatek Ethernet SGMII support"
	default n

config MTK_ETHERNET_RSS
	bool "Mediatek Ethernet Receive Side Scaling (RSS) support"
	default n

config QUECTEL_ETHERNET_PHY
	bool "Quectel 3rd Ethernet Phy support"
	default n

config QUECTEL_ETHERNET_PHY_ADAPT_SUPPORT
	bool "Quectel 3rd Ethernet Phy auto adapter support(mt7531 only support mac0<-->sgmii/usxgmii<-->phy)"
	default n
	depends on QUECTEL_ETHERNET_PHY

source "drivers/misc/mediatek/ethernet/rtl8221/Kconfig"
source "drivers/misc/mediatek/ethernet/aqr113/Kconfig"

config QL_WAN_LAN_AUTO_ADAPT_SUPPORT
	bool "Quectel WAN_LAN AUTO ADAPT SUPPORT"
	default n

endif #MTK_ETHERNET

config MTK_SGMII_NETSYS
	bool "sgmii for netsys"
	default n
	help
	  Set the PHY sgmii for netsys

	  This selects the sgmii as Netsys ethernet driver
	  interface. SNPS ethernet driver can only use rgmii
	  with this configuration.

config MTK_SGMII_SNPS
	bool "sgmii for snps"
	default n
	help
	  Set the PHY sgmii for snps

	  This selects the sgmii as SNPS ethernet driver
	  interface. Netsys ethernet driver can only use
	  another sgmii with this configuration.

config MTK_USXGMII
	bool "usxgmii for 10g"
	default n
	help
	  Set the PHY usxgmii enabled
```

## kernel/src-scrubbed/drivers/misc/mediatek/ethernet/aqr113/Kconfig
```kconfig
config QUEC_MARVELL_AQR113C
	bool "Quec support Marvell Aqr113c PHYs"
	---help---
	  Supports the Marvell Aqr113c PHY.
```
