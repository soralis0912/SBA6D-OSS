## buildroot/feeds/mtk/kernel/netsys_driver/nat/config.in
```kconfig
if PACKAGE_kmod-hw_nat

choice
        prompt "HW_NAT version"
	default HNAT_V1
	help
	Select HNAT version.

config  HNAT_V2
        bool "HNAT_V2"
	help
	Select hnat version2

config  HNAT_V1
        bool "HNAT_V1"
	help
	Select hnat version1
endchoice

config HW_NAT_SW_DVFS
        bool
        default y
        help
        Say Y here if would like to enable SW Based DVFS feature

config HW_NAT_SW_DVFS_DEFAULT_OPP
        int "HWNAT S/W DVFS Default OPP"
	depends on HW_NAT_SW_DVFS
        range 0 3
        default 3

endif
```

## buildroot/feeds/mtk/system/adbd_usb/Config.in
```kconfig
if PACKAGE_adbd_usb
config MTK_ADB_ENABLE
	bool "Enable ADB(Android Debug Bridge) functions"
	default n
	depends on PACKAGE_adbd_usb
endif #PACKAGE_adbd_usb#
```

## buildroot/feeds/mtk/system/connectivity/gps/Config.in
```kconfig
if PACKAGE_mnld

config MTK_GPS_DBG_SOCKET_SUPPORT
	bool "Support GPS DBG SOCKET"
	default n
	help
		Support GPS DBG SOCKET

endif
```

## buildroot/feeds/mtk/system/connectivity/lppe_service/Config.in
```kconfig
if PACKAGE_lppe_service
config MTK_LPPE_NLP_SUPPORT
	bool "Support 3rd party NLP(Network Location Provider) functions"
	default n
	depends on PACKAGE_lppe_service
endif #PACKAGE_lppe_service#
```

## buildroot/feeds/mtk/system/netagent/Config.in
```kconfig
menu "Configuration"

config NO_IP_ASSIGNMENT
    bool "Disable IPv4/v6 assignment"
    default n
    help
        For ODU project, the cellular IP address will be assigned to IDU.
        There is no need to assign IPv4/v6 address in Netagent module.

config ETHERNET_PDU
    bool "Enable Ethernet PDU"
    default n
    help
        Support VLAN over 5G WAN

endmenu
```

## buildroot/openwrt/target/linux/gem6xxx/files-5.4/drivers/misc/mediatek/cpu_buck/Kconfig
```kconfig
#
# CPU Buck
#
config MTK_MT6980_CPU_BUCK
	tristate "Enable MTK CPU vsram_proc Buck Support"
	help
	  Enable MTK CPU vsram_proc Buck Support.
```

## buildroot/openwrt/target/linux/gem6xxx/files-5.4/drivers/misc/mediatek/extcon/Kconfig
```kconfig
choice
	help
	  Choose MTK Extcon USB Type here.
	  EXTCON_MTK_USB is for USB TypeC
	  EXTCON_MITK_USB_MICRO_B is for USB MicroB
	prompt "MTK Extcon USB Type Selection"
	default EXTCON_MTK_USB
config EXTCON_MTK_USB
	tristate "MediaTek EXTCON USB Support"
	select EXTCON
	select USB_ROLE_SWITCH
	help
	  Say Y here to enable extcon support for USB cable detection
	  on the Mediatek PMIC.

config EXTCON_MTK_USB_MICRO_B
	help
	  Say Y here to enable extcon support for Micro TypeB USB cable
	  detection on the Mediatek PMIC.
	tristate "MediaTek EXTCON USB Micro TypeB Support"
	select EXTCON
	select USB_ROLE_SWITCH
endchoice
```

## buildroot/openwrt/target/linux/gem6xxx/files-5.4/drivers/misc/mediatek/frame_engine/Kconfig
```kconfig
config FE_MEDIATEK_SOC
	tristate "MediaTek SoC Netsys FrameEngine support"
	help
	  This driver supports Netsys FrameEngine in the
	  MediaTek SoC family.

config MTK_HNAT_FAST_SUPPORT
	bool "edma offload"
	default n
	help
	  This selects EDMA as the fast path offload.
```

## buildroot/openwrt/target/linux/gem6xxx/files-5.4/drivers/misc/mediatek/leds/Kconfig
```kconfig
config MTK_LEDS
	tristate "MediaTek LED Support"
	depends on LEDS_CLASS
	help
	  This selects the MediaTek(R) LEDs connected to MediaTek chips.
	  If you want to use MediaTek(R) LEDs support, say Y or M here.
	  If unsure, say N.
	  Mediatek LED module includes backlight, indicate LED, keypad LED, button LED etc.

config LEDS_MT6330
	tristate "LED Support for Mediatek MT6330 PMIC"
	depends on LEDS_CLASS
	help
	  This option enables support for on-chip LED drivers found on
	  Mediatek MT6330 PMIC.
	  If you want to use MediaTek(R) LEDs support, say Y or M here.
	  If unsure, say N.

config LEDS_MT6361
	tristate "LED Support for Mediatek MT6361 PMIC"
	depends on LEDS_CLASS
	help
	  This option enables support for on-chip LED drivers found on
	  Mediatek MT6361 PMIC.
	  If you want to use MediaTek(R) LEDs support, say Y or M here.
	  If unsure, say N.

config LEDS_MTK_PWM
    tristate "Mediatek pwm LED support"
    depends on LEDS_CLASS
    depends on PWM_MTK_DISP
    help
      This option enables support for Mediatek pwm LEDs.
      say 'y' to enable this
```

## buildroot/openwrt/target/linux/gem6xxx/files-5.4/drivers/misc/mediatek/mhccif/Kconfig
```kconfig
config MTK_MHCCIF
	bool "MediaTek MHCCIF driver"
	help
	  The MHCCIF driver is an irq chip driver, which used to
	  send/receive interrupts between PCIe RC and EP.
	  Say Y to support MHCCIF interrupts.
	  If unsure, say N.
```

## buildroot/openwrt/target/linux/gem6xxx/files-5.4/drivers/misc/mediatek/security/Kconfig
```kconfig
config MTK_SECURITY_EXTENSION
	bool "Mediatek security extension suite support"
	default n
	help
		Mediatek security extension suite
		If configures to be y, It can enable the security extension suite
		in kernel.
		If configures to be n, Other modules cannot use the exported APIs.

config MTK_SECURE_DATA_PROTECTION
	bool "Mediatek secure data protection support"
	select MTK_SECURITY_EXTENSION
	default n
	help
		Mediatek Secure Data Protection module can protect data such as password.
		If configures to be y, It can use encrypt/decrypt API to protect data by hw
		in kernel.
		If configures to be n, Other modules cannot use the exported APIs.

config MTK_SECURE_STATUS_QUERY
	bool "Mediatek secure status query support"
	select MTK_SECURITY_EXTENSION
	default n
	help
		Mediatek Secure Status Query API acquire the status of secure device.
		If configures to be y, You can use query API to acquire status.
		If configures to be n, Other modules cannot use the exported APIs.
```

## buildroot/openwrt/target/linux/gem6xxx/files-5.4/drivers/misc/mediatek/sensor/Kconfig
```kconfig
# SPDX-License-Identifier: GPL-2.0

config MTK_SENSOR_SUPPORT
	tristate "MTK SENSOR SUPPORT"
	help
	  Sensor config for sensor feature in project.
	  Please say Y here if you want to support and sensors
	  with mediatek sensor architecture.
	  If unsure, say N.

source "drivers/misc/mediatek/sensor/iio/Kconfig"
```

## buildroot/openwrt/target/linux/gem6xxx/files-5.4/drivers/misc/mediatek/wed/Kconfig
```kconfig
config NET_MEDIATEK_SOC_WED
	tristate "MediaTek SoC WED support"
	---help---
	  This supports mt6990 upstream Warp driver
```

## buildroot/openwrt/target/linux/gem6xxx/files-5.4/drivers/net/phy/mtk/mt753x/Kconfig
```kconfig
config MT753X_GSW
	depends on PHYLIB
	tristate "Driver for the MediaTek MT753x switch"
```

## buildroot/openwrt/target/linux/gem6xxx/files-5.4/drivers/soc/mediatek/devapc/Kconfig
```kconfig
config MTK_DEVAPC
	tristate "Mediatek Device APC Support"
	help
	  Device APC is a kernel driver controlling internal device security.
	  If someone tries to access a device, which is not allowed by the
	  device, it cannot access the device and will get a violation
	  interrupt. Device APC prevents malicious access to internal devices.

config DEVAPC_ARCH_MULTI
	tristate "Mediatek Device APC driver architecture multi"
	help
	  Say yes here to enable support Mediatek
	  Device APC driver which is based on HW
	  architecture version 2.
	  This architecture supports multiple Infra AO.

config DEVAPC_COMMON_V1
	tristate "Mediatek Device APC driver common v1"
	help
	  Say yes here to enable support Mediatek
	  Device APC driver which is based on common HW
	  architecture version 1.
	  This architecture supports multiple Infra AO.

config DEVAPC_MT6880
	bool "Mediatek MT6880 Device APC driver"
	select MTK_DEVAPC
	select DEVAPC_ARCH_MULTI
	help
	  Say yes here to enable support Mediatek MT6880
	  Device APC driver.
	  This driver is combined with DEVAPC_ARCH_MULTI for
	  common handle flow.
config DEVAPC_MT69XX
	bool "Mediatek MT69XX Device APC driver"
	select MTK_DEVAPC
	select DEVAPC_COMMON_V1
	help
	  Say yes here to enable support Mediatek MT69XX
	  Device APC driver.
	  This driver is combined with DEVAPC_COMMON_V1 for
	  common handle flow.
```

## kernel/src-scrubbed/Documentation/devicetree/bindings/pinctrl/mediatek,mt6361-pinctrl.yaml
```yaml
# SPDX-License-Identifier: (GPL-2.0 OR BSD-2-Clause)
%YAML 1.2
---
$id: http://devicetree.org/schemas/pinctrl/mediatek,mt6361-pinctrl.yaml#
$schema: http://devicetree.org/meta-schemas/core.yaml#

title: Mediatek MT6361 pin controller Device Tree Bindings

maintainers:
  - ChiYuan Huang <cy_huang@richtek.com>

description: |
  Mediatek MT6361 integrates total 12 pins, functions can be configured
  as level shift  or GPIO.

properties:
  compatible:
    const: mediatek,mt6361-pinctrl

  gpio-controller: true

  '#gpio-cells':
    const: 2

  gpio-ranges:
    maxItems: 1

patternProperties:
  '^(.*-)?(default|gpio)$':
    type: object
    patternProperties:
      '^mux':
        type: object
        description:
          Pinctrl node's client devices use subnodes for pin muxes,
          which in turn use below standard properties.
        $ref: pinmux-node.yaml#

        properties:
          function:
            description:
              Specify the alternative function to be configured for the
              given pin groups.
            enum: [lvsf, gpio]

          groups:
            description:
              List of groups to select (either this or "pins" must be
              specified), available groups for this subnode.
            items:
              enum: [lvsf1_grp, lvsf2_grp, lvsf3_grp, lvsf4_grp,
                     lvsf5_grp, lvsf6_grp]
            maxItems: 6

        required:
          - groups
          - function

        additionalProperties: false

      '^conf':
        type: object
        description:
          Pinctrl node's client devices use subnodes for pin configurations,
          which in turn use the standard properties below.
        $ref: pincfg-node.yaml#

        properties:
          pins:
            description:
              List of pin names to select in this subnode.
            items:
              pattern: '^(A|B)[1-6]$'
            maxItems: 12

          bias-pull-up: true
          bias-pull-down: true
          bias-disable: true
          input-enable: true
          output-low: true
          output-high: true
          output-enable: true
          power-source:
            enum: [0, 1]

        required:
          - pins

        additionalProperties: false

    additionalProperties: false

required:
  - compatible
  - gpio-controller
  - '#gpio-cells'
  - gpio-ranges

additionalProperties: false

examples:
  - |
    pinctrl: pinctrl {
      comptaible = "mediatek.mt6361-pinctrl";
      gpio-controller;
      #gpio-cells = <2>;
      gpio-ranges = <&pinctrl 0 0 12>;
    };
```
